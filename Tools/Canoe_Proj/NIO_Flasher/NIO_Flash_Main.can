/*@!Encoding:936*/
/*=============================================================================
 * NIO_Flash_Main.can
 * NIO NT3 UDS 刷写上位机 - 主状态机 (Tester节点)
 *
 * 流程严格按 NIO-TS-0000005 图6-3 (带RTOS的ECU, 标准CAN):
 *   Pre : 22读DID -> 10 83(功能) -> 31 01 02 03前置条件 -> 85 82 FFFFFF(功能)
 *         -> 28 81 03(功能)
 *   Major: 10 02(物理) -> 延时500ms -> 27 07/27 08(Level4) -> 2E F1 5A指纹
 *         -> [可选: 下载Flash驱动 34/36/37 + 31 01 02 02]
 *         -> 31 01 FF 00擦除 -> 逐段 34/36.../37 -> 31 01 02 02验签
 *         -> 31 01 FF 01依赖检查 -> 11 01硬复位 -> 延时1s
 *   Post: 10 83(功能) -> 28 80 03(功能) -> 85 81 FFFFFF(功能) -> 10 81(功能)
 *   全程 3E 80(功能) 每2s保活
 *
 * 触发: 系统变量 NIO_Flasher::StartFlash 置1; NIO_Flasher::AbortFlash 置1中止
 *===========================================================================*/

includes
{
  #include "NIO_Flash_Config.cin"
  #include "NIO_ISO_TP.cin"
  #include "NIO_UDS_Services.cin"
  #include "NIO_SecurityAccess.cin"
  #include "NIO_HexParser.cin"
}

variables
{
  /*------ 状态定义 ------*/
  const dword FS_IDLE            = 0;
  const dword FS_PREPARE         = 1;    // 解析文件/签名
  const dword FS_READ_DID        = 10;
  const dword FS_PRE_EXT_SESSION = 11;
  const dword FS_PRE_CHECK_COND  = 12;
  const dword FS_PRE_DTC_OFF     = 13;
  const dword FS_PRE_CC_OFF      = 14;
  const dword FS_PROG_SESSION    = 15;
  const dword FS_DELAY_500       = 16;
  const dword FS_GET_SEED        = 17;
  const dword FS_SEND_KEY        = 18;
  const dword FS_SEC_DELAY       = 19;
  const dword FS_WRITE_FP        = 20;
  const dword FS_ERASE           = 30;
  const dword FS_REQ_DOWNLOAD    = 31;
  const dword FS_TRANSFER_DATA   = 32;
  const dword FS_TRANSFER_EXIT   = 33;
  const dword FS_CHECK_MEMORY    = 35;
  const dword FS_NEXT_PASS       = 36;
  const dword FS_CHECK_DEPS      = 40;
  const dword FS_RESET           = 41;
  const dword FS_DELAY_1S        = 42;
  const dword FS_POST_EXT        = 43;
  const dword FS_POST_CC_ON      = 44;
  const dword FS_POST_DTC_ON     = 45;
  const dword FS_POST_DEF        = 46;
  const dword FS_RECOVER_CC      = 50;
  const dword FS_RECOVER_DTC     = 51;
  const dword FS_RECOVER_DEF     = 52;
  const dword FS_DONE            = 100;
  const dword FS_FAIL            = 101;

  byte   gReqBuf[4200];        // 请求组包缓冲
  byte   gStepPhase;           // 0=需发送请求, 1=等待响应
  dword  gDidIdx;              // DID读取索引
  dword  gDownloadPass;        // 0=Flash驱动, 1=应用程序
  dword  gTdSegIdx;            // 当前下载段索引
  dword  gTdOffset;            // 段内偏移
  byte   gTdBsc;               // TransferData块序号
  dword  gChunkSize;           // 36单块数据长度(=MaxNumberOfBlockLength-2)
  dword  gDelayNext;           // 延时结束后跳转的状态
}

/*=============================================================================
 * 工具函数
 *===========================================================================*/

FlashStateName(dword st, char out[])
{
  switch (st)
  {
    case FS_IDLE:            strncpy(out, "空闲", elCount(out)); return;
    case FS_PREPARE:         strncpy(out, "解析刷写文件", elCount(out)); return;
    case FS_READ_DID:        strncpy(out, "Pre: 读取ECU标识(22)", elCount(out)); return;
    case FS_PRE_EXT_SESSION: strncpy(out, "Pre: 扩展会话 10 83(功能)", elCount(out)); return;
    case FS_PRE_CHECK_COND:  strncpy(out, "Pre: 前置条件检查 31 01 02 03", elCount(out)); return;
    case FS_PRE_DTC_OFF:     strncpy(out, "Pre: 关DTC 85 82(功能)", elCount(out)); return;
    case FS_PRE_CC_OFF:      strncpy(out, "Pre: 停通信 28 81 03(功能)", elCount(out)); return;
    case FS_PROG_SESSION:    strncpy(out, "Major: 编程会话 10 02", elCount(out)); return;
    case FS_DELAY_500:       strncpy(out, "Major: 延时500ms", elCount(out)); return;
    case FS_GET_SEED:        strncpy(out, "Major: 请求种子 27 07", elCount(out)); return;
    case FS_SEND_KEY:        strncpy(out, "Major: 发送密钥 27 08", elCount(out)); return;
    case FS_SEC_DELAY:       strncpy(out, "Major: 安全延时10s(NRC37)", elCount(out)); return;
    case FS_WRITE_FP:        strncpy(out, "Major: 写指纹 2E F1 5A", elCount(out)); return;
    case FS_ERASE:           strncpy(out, "Major: 擦除 31 01 FF 00", elCount(out)); return;
    case FS_REQ_DOWNLOAD:    strncpy(out, "Major: 请求下载 34", elCount(out)); return;
    case FS_TRANSFER_DATA:   strncpy(out, "Major: 传输数据 36", elCount(out)); return;
    case FS_TRANSFER_EXIT:   strncpy(out, "Major: 退出传输 37", elCount(out)); return;
    case FS_CHECK_MEMORY:    strncpy(out, "Major: 校验 31 01 02 02", elCount(out)); return;
    case FS_NEXT_PASS:       strncpy(out, "Major: 切换下载目标", elCount(out)); return;
    case FS_CHECK_DEPS:      strncpy(out, "Major: 依赖检查 31 01 FF 01", elCount(out)); return;
    case FS_RESET:           strncpy(out, "Major: 硬复位 11 01", elCount(out)); return;
    case FS_DELAY_1S:        strncpy(out, "Major: 复位后延时1s", elCount(out)); return;
    case FS_POST_EXT:        strncpy(out, "Post: 扩展会话 10 83(功能)", elCount(out)); return;
    case FS_POST_CC_ON:      strncpy(out, "Post: 恢复通信 28 80 03(功能)", elCount(out)); return;
    case FS_POST_DTC_ON:     strncpy(out, "Post: 开DTC 85 81(功能)", elCount(out)); return;
    case FS_POST_DEF:        strncpy(out, "Post: 默认会话 10 81(功能)", elCount(out)); return;
    case FS_DONE:            strncpy(out, "刷写完成", elCount(out)); return;
    case FS_FAIL:            strncpy(out, "刷写失败", elCount(out)); return;
    default:                 strncpy(out, "恢复通信", elCount(out)); return;
  }
}

FlashSetState(dword st)
{
  char nm[64];
  FlashStateName(st, nm);
  gFlashState = st;
  gStepPhase  = 0;
  sysSetVariableInt("NIO_Flasher", "State", (int)st);
  sysSetVariableString("NIO_Flasher", "CurrentStep", nm);
  write("==> 状态: %s", nm);
}

FlashSetProgress(dword pct)
{
  gProgress = pct;
  sysSetVariableInt("NIO_Flasher", "Progress", (int)pct);
}

FlashError(char msg[])
{
  strncpy(gLastError, msg, elCount(gLastError));
  sysSetVariableString("NIO_Flasher", "ErrorText", msg);
  write("!! 错误: %s", msg);
}

/*---------------------------------------------------------------------------
 * FlashFail: 失败处理 -> 进入恢复序列 (28 80 03 / 85 81 / 10 81)
 *-------------------------------------------------------------------------*/
FlashFail(char msg[])
{
  char full[300];
  char nm[64];
  TesterPresentStop();
  FlashStateName(gFlashState, nm);
  snprintf(full, elCount(full), "%s (状态=%s, NRC=0x%02X)", msg, nm, gUdsNrc);
  FlashError(full);
  gRetryCount = 0;
  FlashSetState(FS_RECOVER_CC);
  sysSetVariableInt("NIO_Flasher", "Status", 3);   // 3=失败
}

/*---------------------------------------------------------------------------
 * StepResultOrRetry: 等待当前请求结果; 失败时按 gMaxRetry 重试
 *   返回: 0=仍等待, 1=肯定响应, -1=已重发请求, 2=彻底失败(已进恢复)
 * 安全相关状态不使用本函数(单独处理NRC 35/36/37)。
 *-------------------------------------------------------------------------*/
int StepResultOrRetry(byte reqSid, char stepName[])
{
  char msg[300];

  if (gUdsStatus == UDS_ST_BUSY) return 0;

  if (gUdsStatus == UDS_ST_DONE && UdsExpectSid(reqSid)) return 1;

  // 失败
  gRetryCount++;
  if (gRetryCount <= gMaxRetry)
  {
    write("-- %s 失败(status=%d,NRC=0x%02X), 第%d次重试", stepName, gUdsStatus, gUdsNrc, gRetryCount);
    gStepPhase = 0;    // 重新发送
    return -1;
  }
  snprintf(msg, elCount(msg), "%s 失败, 重试%d次后放弃", stepName, gMaxRetry);
  FlashFail(msg);
  return 2;
}

/*---------------------------------------------------------------------------
 * 发送各类请求(组包)
 *-------------------------------------------------------------------------*/
SendReadDid(word did)
{
  gReqBuf[0] = 0x22;
  gReqBuf[1] = (byte)(did >> 8);
  gReqBuf[2] = (byte)(did & 0xFF);
  UdsSendRequest(gReqBuf, 3);
}

SendFunctional3(byte b0, byte b1, byte b2, byte b3, byte b4, dword len)
{
  byte buf[7];
  buf[0] = b0; buf[1] = b1; buf[2] = b2; buf[3] = b3; buf[4] = b4;
  UdsSendFunctional(buf, len);
}

SendEraseMemory(dword addr, dword len)
{
  dword i;
  gReqBuf[0] = 0x31;
  gReqBuf[1] = 0x01;        // startRoutine
  gReqBuf[2] = 0xFF;
  gReqBuf[3] = 0x00;        // EraseMemory
  gReqBuf[4] = 0x44;        // ALFI: 4字节地址+4字节长度 (<=4GB)
  for (i = 0; i < 4; i++) gReqBuf[5 + i]     = (byte)(addr >> (24 - i * 8));
  for (i = 0; i < 4; i++) gReqBuf[9 + i]     = (byte)(len  >> (24 - i * 8));
  UdsSendRequest(gReqBuf, 13);
}

SendRequestDownload(dword addr, dword len)
{
  dword i;
  gReqBuf[0] = 0x34;
  gReqBuf[1] = 0x00;        // DataFormatIdentifier: 无压缩无加密
  gReqBuf[2] = 0x44;        // ALFI: 4字节地址+4字节长度
  for (i = 0; i < 4; i++) gReqBuf[3 + i] = (byte)(addr >> (24 - i * 8));
  for (i = 0; i < 4; i++) gReqBuf[7 + i] = (byte)(len  >> (24 - i * 8));
  UdsSendRequest(gReqBuf, 11);
}

SendTransferData()
{
  dword i, chunk, remain, segOfs;
  segOfs = gSegOfs[gTdSegIdx];
  remain = gSegLen[gTdSegIdx] - gTdOffset;
  chunk  = (remain > gChunkSize) ? gChunkSize : remain;

  gReqBuf[0] = 0x36;
  gReqBuf[1] = gTdBsc;
  for (i = 0; i < chunk; i++)
    gReqBuf[2 + i] = gFlashData[segOfs + gTdOffset + i];
  UdsSendRequest(gReqBuf, 2 + chunk);
  // 36写Flash耗时可能超过普通P2(150ms)且部分ECU不回NRC78, 放宽本服务响应超时
  cancelTimer(tP2);
  setTimer(tP2, gP2TransferMs);
}

SendCheckMemory()
{
  dword i;
  gReqBuf[0] = 0x31;
  gReqBuf[1] = 0x01;
  gReqBuf[2] = 0x02;
  gReqBuf[3] = 0x02;        // CheckMemory
  for (i = 0; i < gSignatureLen; i++)
    gReqBuf[4 + i] = gSignature[i];   // RSA签名 (NT3: 384字节, SHA256+RSA3072/PSS)
  UdsSendRequest(gReqBuf, 4 + gSignatureLen);
}

/*=============================================================================
 * 主状态机 (由 tPoll 周期驱动)
 *===========================================================================*/
FlashSeqRun()
{
  dword i, lfBytes, maxBlock, remain;
  char  msg[300];

  // 启动触发
  if (gFlashState == FS_IDLE)
  {
    if (sysGetVariableInt("NIO_Flasher", "StartFlash") != 0)
    {
      sysSetVariableInt("NIO_Flasher", "StartFlash", 0);
      CfgLoadFromPanel();   // 读取面板的诊断ID/文件路径配置
      sysSetVariableInt("NIO_Flasher", "Status", 1);   // 1=运行中
      sysSetVariableString("NIO_Flasher", "ErrorText", "");
      gRetryCount = 0;
      FlashSetProgress(0);
      FlashSetState(FS_PREPARE);
    }
    return;
  }

  // 中止请求
  if (gFlashState != FS_DONE && gFlashState != FS_FAIL &&
      gFlashState < FS_RECOVER_CC &&
      sysGetVariableInt("NIO_Flasher", "AbortFlash") != 0)
  {
    sysSetVariableInt("NIO_Flasher", "AbortFlash", 0);
    FlashFail("用户中止");
    return;
  }

  UdsPoll();

  switch (gFlashState)
  {
  /*-------------------------------------------------------------------------
   * 准备: 解析应用程序文件 + 签名
   *-----------------------------------------------------------------------*/
  case FS_PREPARE:
    if (gDownloadFlashDriver)
    {
      if (!HexParseFile(gFlashDriverFile)) { FlashFail("Flash驱动文件解析失败"); return; }
      if (!HexLoadSignature(gFlashDriverSigFile, gSignatureLen)) { FlashFail("驱动签名读取失败"); return; }
      gDownloadPass = 0;
    }
    else
    {
      if (!HexParseFile(gFlashFile)) { FlashFail("刷写文件解析失败"); return; }
      if (!HexLoadSignature(gSignatureFile, gSignatureLen)) { FlashFail("签名文件读取失败"); return; }
      gDownloadPass = 1;
    }
    gDidIdx = 0;
    FlashSetState(FS_READ_DID);
    break;

  /*-------------------------------------------------------------------------
   * Pre: 读取ECU HW/SW标识 (物理寻址22, 逐个DID)
   *-----------------------------------------------------------------------*/
  case FS_READ_DID:
    if (gStepPhase == 0)
    {
      SendReadDid(gReadDidList[gDidIdx]);
      gStepPhase = 1;
      break;
    }
    if (gUdsStatus == UDS_ST_BUSY) break;
    if (gUdsStatus == UDS_ST_DONE && UdsExpectSid(0x22))
    {
      write("DID 0x%04X 读取成功, %d字节", gReadDidList[gDidIdx], gUdsRespLen - 3);
      for (i = 3; i < gUdsRespLen; i++) write("  data[%d] = 0x%02X", i - 3, gUdsRespBuf[i]);
    }
    else
    {
      write("DID 0x%04X 读取失败(status=%d,NRC=0x%02X), 继续", gReadDidList[gDidIdx], gUdsStatus, gUdsNrc);
    }
    gDidIdx++;
    gStepPhase = 0;
    if (gDidIdx >= gReadDidCount)
    {
      gRetryCount = 0;
      FlashSetState(FS_PRE_EXT_SESSION);
    }
    break;

  /*-------------------------------------------------------------------------
   * Pre: 10 83 功能寻址扩展会话 (不检查响应)
   *-----------------------------------------------------------------------*/
  case FS_PRE_EXT_SESSION:
    SendFunctional3(0x10, 0x83, 0, 0, 0, 2);
    TesterPresentStart();               // 开始S3保活
    FlashSetState(FS_PRE_CHECK_COND);
    break;

  /*-------------------------------------------------------------------------
   * Pre: 31 01 02 03 前置条件检查 (物理) -> 71 01 02 03 00 通过
   *-----------------------------------------------------------------------*/
  case FS_PRE_CHECK_COND:
    if (gStepPhase == 0)
    {
      gReqBuf[0] = 0x31; gReqBuf[1] = 0x01; gReqBuf[2] = 0x02; gReqBuf[3] = 0x03;
      UdsSendRequest(gReqBuf, 4);
      gStepPhase = 1;
      break;
    }
    i = StepResultOrRetry(0x31, "前置条件检查");
    if (i == 0 || i == -1) break;
    if (i == 2) return;
    if (gUdsRespLen >= 5 && gUdsRespBuf[2] == 0x02 && gUdsRespBuf[3] == 0x03)
    {
      if (gUdsRespBuf[4] == 0x00)
      {
        write("前置条件检查通过");
        gRetryCount = 0;
        FlashSetState(FS_PRE_DTC_OFF);
      }
      else
      {
        snprintf(msg, elCount(msg), "前置条件不满足, routineStatus=0x%02X, 刷写停止", gUdsRespBuf[4]);
        FlashFail(msg);
      }
    }
    else FlashFail("前置条件检查响应格式错误");
    break;

  /*-------------------------------------------------------------------------
   * Pre: 85 82 FF FF FF 关DTC (功能), 28 81 03 停应用+NM报文 (功能)
   *-----------------------------------------------------------------------*/
  case FS_PRE_DTC_OFF:
    SendFunctional3(0x85, 0x82, 0xFF, 0xFF, 0xFF, 5);
    FlashSetState(FS_PRE_CC_OFF);
    break;

  case FS_PRE_CC_OFF:
    SendFunctional3(0x28, 0x81, 0x03, 0, 0, 3);
    FlashSetState(FS_PROG_SESSION);
    break;

  /*-------------------------------------------------------------------------
   * Major: 10 02 编程会话 (物理) -> 50 02; 然后延时500ms
   *-----------------------------------------------------------------------*/
  case FS_PROG_SESSION:
    if (gStepPhase == 0)
    {
      gReqBuf[0] = 0x10; gReqBuf[1] = 0x02;
      UdsSendRequest(gReqBuf, 2);
      gStepPhase = 1;
      break;
    }
    i = StepResultOrRetry(0x10, "编程会话");
    if (i == 0 || i == -1) break;
    if (i == 2) return;
    if (gUdsRespLen >= 2 && gUdsRespBuf[1] == 0x02)
    {
      gRetryCount  = 0;
      gDelayNext   = FS_GET_SEED;
      FlashSetState(FS_DELAY_500);
    }
    else FlashFail("编程会话响应格式错误");
    break;

  case FS_DELAY_500:
    if (gStepPhase == 0)
    {
      setTimer(tDelay, gDelayAfterProgSessionMs);
      gStepPhase = 1;
      break;
    }
    break;   // on timer tDelay 中跳转

  /*-------------------------------------------------------------------------
   * Major: 27 07 取种子 -> 27 08 发密钥 (Level 4)
   * NRC 35(invalidKey)/36(超次数) -> 直接失败; NRC 37 -> 等10s重来
   *-----------------------------------------------------------------------*/
  case FS_GET_SEED:
    if (gStepPhase == 0)
    {
      SecAccessBuildSeedRequest(gReqBuf);
      UdsSendRequest(gReqBuf, 2);
      gStepPhase = 1;
      break;
    }
    if (gUdsStatus == UDS_ST_BUSY) break;
    if (gUdsStatus == UDS_ST_NRC && gUdsNrc == 0x37)
    {
      gDelayNext = FS_GET_SEED;
      FlashSetState(FS_SEC_DELAY);
      break;
    }
    i = StepResultOrRetry(0x27, "请求种子");
    if (i == 0 || i == -1) break;
    if (i == 2) return;
    i = SecAccessParseSeed(gUdsRespBuf, gUdsRespLen);
    if (i == 2)
    {
      // 全0种子: 该安全等级已解锁 (TS-0000019 6.3), 跳过SendKey
      write("种子全0, 安全等级4已是解锁状态, 跳过SendKey");
      gRetryCount = 0;
      FlashSetState(FS_WRITE_FP);
    }
    else if (i == 1)
    {
      gRetryCount = 0;
      FlashSetState(FS_SEND_KEY);
    }
    else FlashFail("种子响应格式错误");
    break;

  case FS_SEND_KEY:
    if (gStepPhase == 0)
    {
      i = SecAccessBuildKeyRequest(gReqBuf);
      UdsSendRequest(gReqBuf, i);
      gStepPhase = 1;
      break;
    }
    if (gUdsStatus == UDS_ST_BUSY) break;
    if (gUdsStatus == UDS_ST_NRC)
    {
      if (gUdsNrc == 0x35) { FlashFail("密钥无效(NRC 35 invalidKey), 请检查Seed&Key算法"); return; }
      if (gUdsNrc == 0x36) { FlashFail("超过安全访问尝试次数(NRC 36), ECU已锁定, 需等待/重新上电"); return; }
      if (gUdsNrc == 0x37)
      {
        gDelayNext = FS_GET_SEED;   // 延时后重新取种子
        FlashSetState(FS_SEC_DELAY);
        break;
      }
    }
    i = StepResultOrRetry(0x27, "发送密钥");
    if (i == 0 || i == -1) break;
    if (i == 2) return;
    if (gUdsRespLen >= 2 && gUdsRespBuf[1] == 0x08)
    {
      write("安全访问 Level 4 解锁成功");
      gRetryCount = 0;
      FlashSetState(FS_WRITE_FP);
    }
    else FlashFail("发送密钥响应格式错误");
    break;

  case FS_SEC_DELAY:
    if (gStepPhase == 0)
    {
      write("ECU安全延时定时器激活, 等待10s...");
      setTimer(tDelay, 10000);
      gStepPhase = 1;
      break;
    }
    break;

  /*-------------------------------------------------------------------------
   * Major: 2E F1 5A 写指纹 (12字节: 3字节BCD日期 + 9字节维修站码)
   *-----------------------------------------------------------------------*/
  case FS_WRITE_FP:
    if (gStepPhase == 0)
    {
      gReqBuf[0] = 0x2E; gReqBuf[1] = 0xF1; gReqBuf[2] = 0x5A;
      gReqBuf[3] = gFpYear; gReqBuf[4] = gFpMonth; gReqBuf[5] = gFpDay;
      for (i = 0; i < 9; i++) gReqBuf[6 + i] = gRepairShopCode[i];
      UdsSendRequest(gReqBuf, 15);
      gStepPhase = 1;
      break;
    }
    i = StepResultOrRetry(0x2E, "写指纹");
    if (i == 0 || i == -1) break;
    if (i == 2) return;
    write("指纹写入完成");
    gRetryCount = 0;
    gTdSegIdx   = 0;
    if (gDownloadPass == 0)
      FlashSetState(FS_REQ_DOWNLOAD);   // 驱动下载到RAM, 无擦除
    else
      FlashSetState(FS_ERASE);
    break;

  /*-------------------------------------------------------------------------
   * Major: 31 01 FF 00 擦除 (ALFI=44) -> 71 01 FF 00 00
   *-----------------------------------------------------------------------*/
  case FS_ERASE:
    if (gStepPhase == 0)
    {
      SendEraseMemory(gEraseAddr, gEraseLen);
      gStepPhase = 1;
      break;
    }
    i = StepResultOrRetry(0x31, "擦除");
    if (i == 0 || i == -1) break;
    if (i == 2) return;
    if (gUdsRespLen >= 5 && gUdsRespBuf[2] == 0xFF && gUdsRespBuf[3] == 0x00 && gUdsRespBuf[4] == 0x00)
    {
      write("擦除成功: 0x%08X + %d字节", gEraseAddr, gEraseLen);
      gRetryCount = 0;
      gTdSegIdx   = 0;
      FlashSetState(FS_REQ_DOWNLOAD);
    }
    else FlashFail("擦除失败或响应格式错误");
    break;

  /*-------------------------------------------------------------------------
   * Major: 34 请求下载 -> 74 LF MaxNumberOfBlockLength
   *-----------------------------------------------------------------------*/
  case FS_REQ_DOWNLOAD:
    if (gStepPhase == 0)
    {
      SendRequestDownload(gSegAddr[gTdSegIdx], gSegLen[gTdSegIdx]);
      gStepPhase = 1;
      break;
    }
    i = StepResultOrRetry(0x34, "请求下载");
    if (i == 0 || i == -1) break;
    if (i == 2) return;
    if (gUdsRespLen >= 3 && (gUdsRespBuf[1] & 0x0F) == 0x00)
    {
      lfBytes  = (gUdsRespBuf[1] >> 4) & 0x0F;   // LengthFormatIdentifier高nibble=字节数
      if (lfBytes == 0 || gUdsRespLen < 2 + lfBytes) { FlashFail("34响应LengthFormat错误"); return; }
      maxBlock = 0;
      for (i = 0; i < lfBytes; i++) maxBlock = (maxBlock << 8) | gUdsRespBuf[2 + i];
      if (maxBlock <= 2) { FlashFail("MaxNumberOfBlockLength过小"); return; }
      gChunkSize = maxBlock - 2;        // 含SID+BSC
      if (gMaxChunkSize > 0 && gChunkSize > gMaxChunkSize) gChunkSize = gMaxChunkSize;
      gTdOffset  = 0;
      gTdBsc     = 1;                   // BSC从1开始
      write("段%d: 34成功, MaxNumberOfBlockLength=%d, 块数据长=%d", gTdSegIdx, maxBlock, gChunkSize);
      gRetryCount = 0;
      FlashSetState(FS_TRANSFER_DATA);
    }
    else FlashFail("34响应格式错误");
    break;

  /*-------------------------------------------------------------------------
   * Major: 36 传输数据 (BSC 1..FF->00) -> 76 BSC
   *-----------------------------------------------------------------------*/
  case FS_TRANSFER_DATA:
    if (gStepPhase == 0)
    {
      SendTransferData();
      gStepPhase = 1;
      break;
    }
    if (gStepPhase == 2) break;   // 等待重发前延时 (on timer tDelay 到期后置0)
    if (gUdsStatus == UDS_ST_BUSY) break;
    if (gUdsStatus == UDS_ST_DONE && UdsExpectSid(0x36) &&
        gUdsRespLen >= 2 && gUdsRespBuf[1] == gTdBsc)
    {
      // 推进偏移
      remain = gSegLen[gTdSegIdx] - gTdOffset;
      if (remain > gChunkSize) gTdOffset += gChunkSize;
      else                     gTdOffset = gSegLen[gTdSegIdx];
      gTdBsc = (gTdBsc + 1) & 0xFF;     // 0xFF后回到0x00
      gRetryCount = 0;

      // 进度
      FlashSetProgress((dword)(((gSegOfs[gTdSegIdx] + gTdOffset) * 100) / gFlashDataUsed));

      if (gTdOffset >= gSegLen[gTdSegIdx])
        FlashSetState(FS_TRANSFER_EXIT);
      else
        gStepPhase = 0;                 // 发下一块
      break;
    }
    write("   [36] 块失败: 段%d, 已传%d/%d字节, BSC=0x%02X, TP发送%d/%d字节",
          gTdSegIdx, gTdOffset, gSegLen[gTdSegIdx], gTdBsc, gTpTxOffset, gTpTxLen);
    i = StepResultOrRetry(0x36, "传输数据");
    if (i == 2) return;
    if (i == -1 && gUdsStatus == UDS_ST_ERROR)
    {
      // 超时类失败: ECU可能仍在写Flash(未回76/不再发FC), 延时后再重发当前块
      gStepPhase = 2;
      setTimer(tDelay, gDelayBeforeRetry36Ms);
    }
    break;

  /*-------------------------------------------------------------------------
   * Major: 37 退出传输 -> 77; 多段则回 FS_REQ_DOWNLOAD
   *-----------------------------------------------------------------------*/
  case FS_TRANSFER_EXIT:
    if (gStepPhase == 0)
    {
      gReqBuf[0] = 0x37;
      UdsSendRequest(gReqBuf, 1);
      gStepPhase = 1;
      break;
    }
    i = StepResultOrRetry(0x37, "退出传输");
    if (i == 0 || i == -1) break;
    if (i == 2) return;
    write("段%d下载完成 (0x%08X, %d字节)", gTdSegIdx, gSegAddr[gTdSegIdx], gSegLen[gTdSegIdx]);
    gTdSegIdx++;
    gRetryCount = 0;
    if (gTdSegIdx < gSegCount)
      FlashSetState(FS_REQ_DOWNLOAD);
    else
      FlashSetState(FS_CHECK_MEMORY);
    break;

  /*-------------------------------------------------------------------------
   * Major: 31 01 02 02 + RSA签名 校验 -> 71 01 02 02 00
   *-----------------------------------------------------------------------*/
  case FS_CHECK_MEMORY:
    if (gStepPhase == 0)
    {
      SendCheckMemory();
      gStepPhase = 1;
      break;
    }
    i = StepResultOrRetry(0x31, "内存校验");
    if (i == 0 || i == -1) break;
    if (i == 2) return;
    if (gUdsRespLen >= 5 && gUdsRespBuf[2] == 0x02 && gUdsRespBuf[3] == 0x02 && gUdsRespBuf[4] == 0x00)
    {
      write("内存校验通过 (pass=%d)", gDownloadPass);
      gRetryCount = 0;
      FlashSetState(FS_NEXT_PASS);
    }
    else FlashFail("内存校验不通过(签名验证失败?)");
    break;

  /*-------------------------------------------------------------------------
   * Major: 驱动刷完 -> 解析应用文件再刷应用; 应用刷完 -> 依赖检查
   *-----------------------------------------------------------------------*/
  case FS_NEXT_PASS:
    if (gDownloadPass == 0)
    {
      if (!HexParseFile(gFlashFile)) { FlashFail("刷写文件解析失败"); return; }
      if (!HexLoadSignature(gSignatureFile, gSignatureLen)) { FlashFail("签名文件读取失败"); return; }
      gDownloadPass = 1;
      gTdSegIdx     = 0;
      FlashSetState(FS_ERASE);
    }
    else
    {
      FlashSetState(FS_CHECK_DEPS);
    }
    break;

  /*-------------------------------------------------------------------------
   * Major: 31 01 FF 01 依赖检查 -> 71 01 FF 01 00 (期间ECU周期回7F 31 78)
   *-----------------------------------------------------------------------*/
  case FS_CHECK_DEPS:
    if (gStepPhase == 0)
    {
      gReqBuf[0] = 0x31; gReqBuf[1] = 0x01; gReqBuf[2] = 0xFF; gReqBuf[3] = 0x01;
      UdsSendRequest(gReqBuf, 4);
      gStepPhase = 1;
      break;
    }
    i = StepResultOrRetry(0x31, "依赖检查");
    if (i == 0 || i == -1) break;
    if (i == 2) return;
    if (gUdsRespLen >= 5 && gUdsRespBuf[2] == 0xFF && gUdsRespBuf[3] == 0x01 && gUdsRespBuf[4] == 0x00)
    {
      write("依赖检查通过");
      gRetryCount = 0;
      FlashSetState(FS_RESET);
    }
    else FlashFail("依赖检查不通过");
    break;

  /*-------------------------------------------------------------------------
   * Major: 11 01 硬复位 -> 51 01, 然后延时1s
   *-----------------------------------------------------------------------*/
  case FS_RESET:
    if (gStepPhase == 0)
    {
      gReqBuf[0] = 0x11; gReqBuf[1] = 0x01;
      UdsSendRequest(gReqBuf, 2);
      gStepPhase = 1;
      break;
    }
    i = StepResultOrRetry(0x11, "硬复位");
    if (i == 0 || i == -1) break;
    if (i == 2) return;
    gRetryCount = 0;
    gDelayNext  = FS_POST_EXT;
    FlashSetState(FS_DELAY_1S);
    break;

  case FS_DELAY_1S:
    if (gStepPhase == 0)
    {
      setTimer(tDelay, gDelayAfterResetMs);
      gStepPhase = 1;
      break;
    }
    break;

  /*-------------------------------------------------------------------------
   * Post: 功能寻址恢复 (均不检查响应)
   *-----------------------------------------------------------------------*/
  case FS_POST_EXT:
    SendFunctional3(0x10, 0x83, 0, 0, 0, 2);
    FlashSetState(FS_POST_CC_ON);
    break;

  case FS_POST_CC_ON:
    SendFunctional3(0x28, 0x80, 0x03, 0, 0, 3);
    FlashSetState(FS_POST_DTC_ON);
    break;

  case FS_POST_DTC_ON:
    SendFunctional3(0x85, 0x81, 0xFF, 0xFF, 0xFF, 5);
    FlashSetState(FS_POST_DEF);
    break;

  case FS_POST_DEF:
    SendFunctional3(0x10, 0x81, 0, 0, 0, 2);
    TesterPresentStop();
    FlashSetProgress(100);
    FlashSetState(FS_DONE);
    sysSetVariableInt("NIO_Flasher", "Status", 2);   // 2=完成
    write("===== 刷写流程全部完成 =====");
    break;

  /*-------------------------------------------------------------------------
   * 失败恢复: 尽力恢复整车通信
   *-----------------------------------------------------------------------*/
  case FS_RECOVER_CC:
    SendFunctional3(0x28, 0x80, 0x03, 0, 0, 3);
    FlashSetState(FS_RECOVER_DTC);
    break;

  case FS_RECOVER_DTC:
    SendFunctional3(0x85, 0x81, 0xFF, 0xFF, 0xFF, 5);
    FlashSetState(FS_RECOVER_DEF);
    break;

  case FS_RECOVER_DEF:
    SendFunctional3(0x10, 0x81, 0, 0, 0, 2);
    FlashSetState(FS_FAIL);
    write("===== 刷写失败, 通信已尝试恢复 =====");
    break;

  case FS_DONE:
  case FS_FAIL:
  case FS_IDLE:
  default:
    break;
  }
}

/*=============================================================================
 * 事件处理
 *===========================================================================*/
on start
{
  gFlashState = FS_IDLE;
  gUdsStatus  = UDS_ST_IDLE;
  sysSetVariableInt("NIO_Flasher", "Status", 0);
  sysSetVariableInt("NIO_Flasher", "Progress", 0);
  sysSetVariableString("NIO_Flasher", "CurrentStep", "空闲");
  sysSetVariableString("NIO_Flasher", "ErrorText", "");
  write("NIO NT3 UDS刷写上位机就绪. 物理ID: 0x%03X/0x%03X, 功能ID: 0x%03X",
        gPhysReqId, gPhysRespId, gFuncReqId);
  setTimerCyclic(tPoll, 2);
}

on timer tPoll
{
  FlashSeqRun();
}

on timer tDelay
{
  // 通用延时结束 (FS_DELAY_500 / FS_DELAY_1S / FS_SEC_DELAY)
  if (gFlashState == FS_DELAY_500 || gFlashState == FS_DELAY_1S || gFlashState == FS_SEC_DELAY)
  {
    FlashSetState(gDelayNext);
  }
  else if (gFlashState == FS_TRANSFER_DATA && gStepPhase == 2)
  {
    gStepPhase = 0;   // 36重发前延时结束, 重发当前块
  }
}

on stopMeasurement
{
  TesterPresentStop();
}
