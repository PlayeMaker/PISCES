/*@!Encoding:936*/
/*=============================================================================
 * NIO_HexParser.cin
 * 刷写文件解析: Motorola S19 / Intel HEX -> 段表(地址+数据)
 * RSA签名文件读取 (二进制)
 *
 * 依据 TS-0000005 6.1.2: 一个逻辑块可含多个内存段, 每段一轮
 *   RequestDownload(34) -> TransferData(36) -> RequestTransferExit(37)
 * 本上位机将一个刷写文件视为一个逻辑块; 擦除范围=文件覆盖的
 *   最小起始地址到最大结束地址; 然后逐段执行34/36/37。
 *===========================================================================*/

variables
{
  const dword MAX_FLASH_BYTES = 1048576;   // 单个刷写文件最大支持1MB
  const dword MAX_SEGMENTS    = 64;

  byte   gFlashData[MAX_FLASH_BYTES];  // 全部段数据(连续存放)
  dword  gFlashDataUsed;               // 已用字节数
  dword  gSegCount;                    // 段数量
  dword  gSegAddr[MAX_SEGMENTS];       // 段起始地址
  dword  gSegOfs[MAX_SEGMENTS];        // 段数据在gFlashData中的偏移
  dword  gSegLen[MAX_SEGMENTS];        // 段长度
  dword  gEraseAddr;                   // 擦除起始地址(最小段地址)
  dword  gEraseLen;                    // 擦除长度(覆盖到最大段结束)
  byte   gSignature[512];              // RSA签名 (NT3=384字节)
  dword  gSignatureLenRead;
  dword  gHexBaseAddr;                 // Intel HEX 扩展线性/段地址基址
}

/*---------------------------------------------------------------------------
 * 十六进制字符/字节解析工具
 *-------------------------------------------------------------------------*/
int HexNibble(char c)
{
  if (c >= '0' && c <= '9') return c - '0';
  if (c >= 'A' && c <= 'F') return c - 'A' + 10;
  if (c >= 'a' && c <= 'f') return c - 'a' + 10;
  return -1;
}

int HexByte(char line[], dword pos)
{
  dword hi, lo;
  hi = HexNibble(line[pos]);
  lo = HexNibble(line[pos + 1]);
  if (hi < 0 || lo < 0) return -1;
  return (hi << 4) | lo;
}

/*---------------------------------------------------------------------------
 * SegAddData: 向段表追加一段数据(地址连续则并入最后一段)
 * 返回 1=成功, 0=超限/越界
 *-------------------------------------------------------------------------*/
dword SegAddData(dword addr, byte data[], dword len)
{
  dword i;

  if (len == 0) return 1;

  // 与最后一段地址连续 -> 合并
  if (gSegCount > 0 &&
      addr == gSegAddr[gSegCount - 1] + gSegLen[gSegCount - 1])
  {
    if (gFlashDataUsed + len > MAX_FLASH_BYTES) return 0;
    for (i = 0; i < len; i++) gFlashData[gFlashDataUsed + i] = data[i];
    gFlashDataUsed += len;
    gSegLen[gSegCount - 1] += len;
    return 1;
  }

  if (gSegCount >= MAX_SEGMENTS) return 0;
  if (gFlashDataUsed + len > MAX_FLASH_BYTES) return 0;
  gSegAddr[gSegCount] = addr;
  gSegOfs[gSegCount]  = gFlashDataUsed;
  gSegLen[gSegCount]  = len;
  for (i = 0; i < len; i++) gFlashData[gFlashDataUsed + i] = data[i];
  gFlashDataUsed += len;
  gSegCount++;
  return 1;
}

HexParserReset()
{
  gSegCount      = 0;
  gFlashDataUsed = 0;
  gEraseAddr     = 0;
  gEraseLen      = 0;
}

/*---------------------------------------------------------------------------
 * ParseS19Line: 解析一行Motorola S记录, 返回 1=数据行已处理, 0=非数据行, -1=错误
 *-------------------------------------------------------------------------*/
int ParseS19Line(char line[])
{
  dword addr, csum, i;
  int   count, dataLen, addrLen;
  byte  recData[255];
  char  type;

  if (line[0] != 'S') return 0;
  type = line[1];
  if (type != '1' && type != '2' && type != '3') return 0;   // S0/S5/S7/S8/S9跳过

  if (type == '1') addrLen = 2;
  else if (type == '2') addrLen = 3;
  else addrLen = 4;

  count = HexByte(line, 2);              // 长度 = 地址+数据+校验
  if (count < addrLen + 1) return -1;

  addr = 0;
  for (i = 0; i < addrLen; i++)
    addr = (addr << 8) | HexByte(line, 4 + i * 2);

  dataLen = count - addrLen - 1;
  for (i = 0; i < dataLen; i++)
  {
    recData[i] = (byte)HexByte(line, 4 + addrLen * 2 + i * 2);
  }

  // 校验和: 长度+地址+数据 之和取反低字节
  csum = count & 0xFF;
  for (i = 0; i < addrLen; i++) csum += HexByte(line, 4 + i * 2);
  for (i = 0; i < dataLen; i++) csum += recData[i];
  csum = (~csum) & 0xFF;
  if (csum != (dword)HexByte(line, 4 + addrLen * 2 + dataLen * 2)) return -1;

  if (!SegAddData(addr, recData, dataLen)) return -1;
  return 1;
}

/*---------------------------------------------------------------------------
 * ParseHexLine: 解析一行Intel HEX, 返回 1=数据行, 0=其他, -1=错误
 *-------------------------------------------------------------------------*/
int ParseHexLine(char line[])
{
  dword addr, csum, i;
  int   reclen, rectype;
  byte  recData[255];

  if (line[0] != ':') return 0;
  reclen  = HexByte(line, 1);
  addr    = (HexByte(line, 3) << 8) | HexByte(line, 5);
  rectype = HexByte(line, 7);

  for (i = 0; i < reclen; i++)
    recData[i] = (byte)HexByte(line, 9 + i * 2);

  // 校验和
  csum = reclen + (addr >> 8) + (addr & 0xFF) + rectype;
  for (i = 0; i < reclen; i++) csum += recData[i];
  csum = ((~csum) + 1) & 0xFF;
  if (csum != (dword)HexByte(line, 9 + reclen * 2)) return -1;

  if (rectype == 0x00)
  {
    if (!SegAddData(gHexBaseAddr + addr, recData, reclen)) return -1;
    return 1;
  }
  if (rectype == 0x01) return 0;                                   // EOF
  if (rectype == 0x04) { gHexBaseAddr = ((dword)recData[0] << 24) | ((dword)recData[1] << 16); return 0; }
  if (rectype == 0x02) { gHexBaseAddr = (((dword)recData[0] << 8) | recData[1]) << 4; return 0; }
  return 0;
}

/*---------------------------------------------------------------------------
 * HexParseFile: 解析刷写文件(S19或Intel HEX, 按首字符自动识别)
 * 成功后段表/擦除范围就绪。返回 1=成功, 0=失败(原因写日志)
 *-------------------------------------------------------------------------*/
dword HexParseFile(char filename[])
{
  dword fh;
  char  line[600];
  dword lineNo;
  long  rd;

  HexParserReset();
  gHexBaseAddr = 0;

  fh = openFileRead(filename, 0);
  if (fh == 0)
  {
    write("HexParser: 无法打开文件 %s", filename);
    return 0;
  }

  lineNo = 0;
  while (1)
  {
    rd = fileGetString(line, elCount(line), fh);
    if (rd <= 0) break;
    lineNo++;
    if (line[0] == 0) continue;

    if (line[0] == 'S')
    {
      if (ParseS19Line(line) < 0) { write("HexParser: %s 第%d行S记录解析失败", filename, lineNo); fileClose(fh); return 0; }
    }
    else if (line[0] == ':')
    {
      if (ParseHexLine(line) < 0) { write("HexParser: %s 第%d行HEX记录解析失败", filename, lineNo); fileClose(fh); return 0; }
    }
  }
  fileClose(fh);

  if (gSegCount == 0)
  {
    write("HexParser: %s 中没有有效数据段", filename);
    return 0;
  }

  HexCalcEraseRange();
  write("HexParser: %s 解析完成: %d段, 共%d字节, 擦除范围 0x%08X + %d",
        filename, gSegCount, gFlashDataUsed, gEraseAddr, gEraseLen);
  return 1;
}

/*---------------------------------------------------------------------------
 * HexCalcEraseRange: 计算擦除范围(最小地址..最大结束地址)
 *-------------------------------------------------------------------------*/
HexCalcEraseRange()
{
  dword i, minAddr, maxEnd;
  minAddr = 0xFFFFFFFF;
  maxEnd  = 0;
  for (i = 0; i < gSegCount; i++)
  {
    if (gSegAddr[i] < minAddr) minAddr = gSegAddr[i];
    if (gSegAddr[i] + gSegLen[i] > maxEnd) maxEnd = gSegAddr[i] + gSegLen[i];
  }
  gEraseAddr = minAddr;
  gEraseLen  = maxEnd - minAddr;
}

/*---------------------------------------------------------------------------
 * HexLoadSignature: 读取RSA签名文件 (NT3=384字节)
 * 自动识别两种格式:
 *   1. 文本格式: "0x60, 0x79, 0x35, ..." (NIO发布的.sig文件)
 *   2. 纯二进制格式 (384字节原始数据)
 * 返回 1=成功且长度匹配
 *-------------------------------------------------------------------------*/
dword HexLoadSignature(char filename[], dword expectedLen)
{
  dword fh;
  dword got;
  dword i, n;
  int   hi, lo;
  char  line[8192];
  long  rd;

  fh = openFileRead(filename, 0);   // 文本模式
  if (fh == 0)
  {
    write("HexParser: 无法打开签名文件 %s", filename);
    return 0;
  }

  // 先按文本格式解析: 扫描所有 "0xXX" 字节串
  n = 0;
  while (1)
  {
    rd = fileGetString(line, elCount(line), fh);
    if (rd <= 0) break;
    i = 0;
    while (line[i] != 0 && n < expectedLen)
    {
      if (line[i] == '0' && (line[i + 1] == 'x' || line[i + 1] == 'X'))
      {
        hi = HexNibble(line[i + 2]);
        lo = HexNibble(line[i + 3]);
        if (hi >= 0 && lo >= 0)
        {
          gSignature[n] = (byte)(hi * 16 + lo);
          n++;
          i += 4;
          continue;
        }
      }
      i++;
    }
  }
  fileClose(fh);

  if (n == 0)
  {
    // 文本解析无结果 -> 按纯二进制格式读取
    fh = openFileRead(filename, 1);   // 二进制模式
    if (fh == 0)
    {
      write("HexParser: 无法打开签名文件 %s", filename);
      return 0;
    }
    n = fileGetBinaryBlock(gSignature, expectedLen, fh);
    fileClose(fh);
  }

  gSignatureLenRead = n;
  if (n != expectedLen)
  {
    write("HexParser: 签名长度%d与期望%d不符 (%s)", n, expectedLen, filename);
    return 0;
  }
  write("HexParser: 签名文件 %s 读取完成 (%d字节)", filename, n);
  return 1;
}
