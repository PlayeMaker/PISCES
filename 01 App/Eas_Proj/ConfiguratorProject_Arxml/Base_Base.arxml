AUTOSAR XML (schema 00046)
package /EAS
  ecuc definition collection AUTOSARParameterDefinition: module=Base
