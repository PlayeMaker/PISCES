[part 1 of 2: package /EAS]
AUTOSAR XML (schema 00046)
package /EAS
  ecuc definition collection AUTOSARParameterDefinition: module=Com
  module config Com: implementation-config-variant=STD_CONFIG_VARIANTS_POSTBUILD, module_version_def=4.2.0, module_autosar_version=Ar470
    ComGeneral:
      VersionCheck = true
      ComConfigurationUseDet = true
      ComEnableMDTForCyclicTransmission = true
      ComRetryFailedTransmitRequests = false
      ComVersionInfoApi = false
      ComCancellationSupport = true
      ComEnableTriggerSendApi = false
      ComTxMixModeOption = OPTION1
      ComMultiCoreSupport = false
      ComEnableSignalGroupArrayApi = false
      ComMetaDataSupport = false
      ComUserCbkHeaderFile = 
      ComSupportedIPduGroups = 2
      PaddingSupport = false
      GroupAPIR3Support = true
      TimeOffsetAnalysisFromArxml = false
      ComUpdateBitClearDelaySupport = false
      ComE2ETxConfirmationCalloutSupport = false
      ComE2ERxIndicationCalloutSupport = false
      ComE2ETriggerTransmitCalloutSupport = false
      ComUpdateBitClearDelayCnt = 3
      ComMasterCoreId = 0
    Cfg_D (ComConfig): UserDefine=false
      17 x ComIPdu, all with ComIPduCallout=, ComIPduCancellationSupport=false, ComIPduSignalProcessing=DEFERRED, ComIPduTriggerTransmitCallout=, ComIPduType=NORMAL, IPduDLC=8, ComMetaDataDefault=, ComRxTimePeriod=0, AutoCreateComIPduCallout=false, UserDefine=false, NetworkName=:
        Cfg_D_Tx_BODY_LE1_CAN_MCM_D_1B6: ComIPduDirection=SEND, ComIPduHandleId=0, PduTimeoutSupport=false, ComPduTimeoutNotificationEnable=false, ComPduIdRef=Cfg_D_Tx_BODY_LE1_CAN_MCM_D_1B6, ComIPduGroupRef=BODY_LE1_CANTx, ComIPduSignalRef=Cfg_D_Tx_BODY_LE1_CAN_MCM_D_1B6_DrvKneadingMassgSkillsSts5, ComIPduSignalRef=Cfg_D_Tx_BODY_LE1_CAN_MCM_D_1B6_DrvKneadingMassgSkillsSts6, ComIPduSignalRef=Cfg_D_Tx_BODY_LE1_CAN_MCM_D_1B6_DrvKneadingMassglvlSts5, ComIPduSignalRef=Cfg_D_Tx_BODY_LE1_CAN_MCM_D_1B6_DrvKneadingMassglvlSts6, ComIPduSignalRef=Cfg_D_Tx_BODY_LE1_CAN_MCM_D_1B6_DrvKneadingMassglvlSts7, ComIPduSignalRef=Cfg_D_Tx_BODY_LE1_CAN_MCM_D_1B6_DrvKneadingMassglvlSts8, ComIPduSignalRef=Cfg_D_Tx_BODY_LE1_CAN_MCM_D_1B6_DrvKneadingMassgSkillsSts7, ComIPduSignalRef=Cfg_D_Tx_BODY_LE1_CAN_MCM_D_1B6_DrvKneadingMassgSkillsSts8, ComIPduSignalRef=Cfg_D_Tx_BODY_LE1_CAN_MCM_D_1B6_DrvKneadingMassgTime8, ComIPduSignalRef=Cfg_D_Tx_BODY_LE1_CAN_MCM_D_1B6_DrvKneadingMassgTime5, ComIPduSignalRef=Cfg_D_Tx_BODY_LE1_CAN_MCM_D_1B6_DrvKneadingMassgTime6, ComIPduSignalRef=Cfg_D_Tx_BODY_LE1_CAN_MCM_D_1B6_DrvKneadingMassgTime7
          ComTxIPdu: ComMinimumDelayTime=0, ComTxIPduClearUpdateBit=Confirmation, ComTxIPduUnusedAreasDefault=0x0
            ComTxModeTrue
              ComTxMode: ComTxModeMode=PERIODIC, ComTxModeNumberOfRepetitions=0, ComTxModeRepetitionPeriod=0, ComTxModeTimeOffset=0, ComTxModeTimePeriod=50
        Cfg_D_Tx_BODY_LE1_CAN_MCM_D_1DF: ComIPduDirection=SEND, ComIPduHandleId=1, PduTimeoutSupport=false, ComPduTimeoutNotificationEnable=false, ComPduIdRef=Cfg_D_Tx_BODY_LE1_CAN_MCM_D_1DF, ComIPduGroupRef=BODY_LE1_CANTx, ComIPduSignalRef=Cfg_D_Tx_BODY_LE1_CAN_MCM_D_1DF_DrvMassSwitchSts, ComIPduSignalRef=Cfg_D_Tx_BODY_LE1_CAN_MCM_D_1DF_DrvSeatmassgHeatCSts, ComIPduSignalRef=Cfg_D_Tx_BODY_LE1_CAN_MCM_D_1DF_DrvSeatLumbarValueSts, ComIPduSignalRef=Cfg_D_Tx_BODY_LE1_CAN_MCM_D_1DF_DrvSeatmassgValveSts, ComIPduSignalRef=Cfg_D_Tx_BODY_LE1_CAN_MCM_D_1DF_DrvSeatUpperValueSts, ComIPduSignalRef=Cfg_D_Tx_BODY_LE1_CAN_MCM_D_1DF_DrvSeatCushionValueSts, ComIPduSignalRef=Cfg_D_Tx_BODY_LE1_CAN_MCM_D_1DF_DrvSeatBlosterValueSts, ComIPduSignalRef=Cfg_D_Tx_BODY_LE1_CAN_MCM_D_1DF_DrvSeatLumbarTopPos, ComIPduSignalRef=Cfg_D_Tx_BODY_LE1_CAN_MCM_D_1DF_DrvSeatLumbarMidPos, ComIPduSignalRef=Cfg_D_Tx_BODY_LE1_CAN_MCM_D_1DF_DrvSeatLumbarBottomPos, ComIPduSignalRef=Cfg_D_Tx_BODY_LE1_CAN_MCM_D_1DF_DrvSeatBolsterValueBLPos, ComIPduSignalRef=Cfg_D_Tx_BODY_LE1_CAN_MCM_D_1DF_DrvSeatBolsterValueBRPos, ComIPduSignalRef=Cfg_D_Tx_BODY_LE1_CAN_MCM_D_1DF_DrvSeatCushionValue6Pos
          ComTxIPdu: ComMinimumDelayTime=0, ComTxIPduClearUpdateBit=Confirmation, ComTxIPduUnusedAreasDefault=0x0
            ComTxModeTrue
              ComTxMode: ComTxModeMode=PERIODIC, ComTxModeNumberOfRepetitions=0, ComTxModeRepetitionPeriod=0, ComTxModeTimeOffset=0, ComTxModeTimePeriod=50
        Cfg_D_Tx_BODY_LE1_CAN_MCM_D_1E0: ComIPduDirection=SEND, ComIPduHandleId=2, PduTimeoutSupport=false, ComPduTimeoutNotificationEnable=false, ComPduIdRef=Cfg_D_Tx_BODY_LE1_CAN_MCM_D_1E0, ComIPduGroupRef=BODY_LE1_CANTx, ComIPduSignalRef=Cfg_D_Tx_BODY_LE1_CAN_MCM_D_1E0_DrvSeatCushionValue5Pos, ComIPduSignalRef=Cfg_D_Tx_BODY_LE1_CAN_MCM_D_1E0_DrvSeatCushionValue4Pos, ComIPduSignalRef=Cfg_D_Tx_BODY_LE1_CAN_MCM_D_1E0_DrvSeatCushionValue2Pos, ComIPduSignalRef=Cfg_D_Tx_BODY_LE1_CAN_MCM_D_1E0_DrvSeatCushionValue1Pos, ComIPduSignalRef=Cfg_D_Tx_BODY_LE1_CAN_MCM_D_1E0_DrvSeatUpperValueLPos, ComIPduSignalRef=Cfg_D_Tx_BODY_LE1_CAN_MCM_D_1E0_DrvSeatUpperValueMPos, ComIPduSignalRef=Cfg_D_Tx_BODY_LE1_CAN_MCM_D_1E0_DrvSeatUpperValueRPos, ComIPduSignalRef=Cfg_D_Tx_BODY_LE1_CAN_MCM_D_1E0_DrvPumpSts
          ComTxIPdu: ComMinimumDelayTime=0, ComTxIPduClearUpdateBit=Confirmation, ComTxIPduUnusedAreasDefault=0x0
            ComTxModeTrue
              ComTxMode: ComTxModeMode=PERIODIC, ComTxModeNumberOfRepetitions=0, ComTxModeRepetitionPeriod=0, ComTxModeTimeOffset=0, ComTxModeTimePeriod=50
        Cfg_D_Tx_BODY_LE1_CAN_MCM_D_1E1: ComIPduDirection=SEND, ComIPduHandleId=3, PduTimeoutSupport=false, ComPduTimeoutNotificationEnable=false, ComPduIdRef=Cfg_D_Tx_BODY_LE1_CAN_MCM_D_1E1, ComIPduGroupRef=BODY_LE1_CANTx, ComIPduSignalRef=Cfg_D_Tx_BODY_LE1_CAN_MCM_D_1E1_DrvKneadingMassgSkillsSts9, ComIPduSignalRef=Cfg_D_Tx_BODY_LE1_CAN_MCM_D_1E1_DrvLumControlSts, ComIPduSignalRef=Cfg_D_Tx_BODY_LE1_CAN_MCM_D_1E1_DrvLumSwitchSts, ComIPduSignalRef=Cfg_D_Tx_BODY_LE1_CAN_MCM_D_1E1_DrvSystemFailr, ComIPduSignalRef=Cfg_D_Tx_BODY_LE1_CAN_MCM_D_1E1_DrvSeatMassFailr, ComIPduSignalRef=Cfg_D_Tx_BODY_LE1_CAN_MCM_D_1E1_DrvSeatCushionValue3Pos, ComIPduSignalRef=Cfg_D_Tx_BODY_LE1_CAN_MCM_D_1E1_DrvLumbarTopWorkSts, ComIPduSignalRef=Cfg_D_Tx_BODY_LE1_CAN_MCM_D_1E1_DrvLumbarMidWorkSts, ComIPduSignalRef=Cfg_D_Tx_BODY_LE1_CAN_MCM_D_1E1_DrvLumbarBottomWorkSts, ComIPduSignalRef=Cfg_D_Tx_BODY_LE1_CAN_MCM_D_1E1_DrvHeat1Sts, ComIPduSignalRef=Cfg_D_Tx_BODY_LE1_CAN_MCM_D_1E1_DrvHeat2Sts, ComIPduSignalRef=Cfg_D_Tx_BODY_LE1_CAN_MCM_D_1E1_DrvHeat3Sts, ComIPduSignalRef=Cfg_D_Tx_BODY_LE1_CAN_MCM_D_1E1_DrvHeat4Sts, ComIPduSignalRef=Cfg_D_Tx_BODY_LE1_CAN_MCM_D_1E1_DrvHeat5Sts, ComIPduSignalRef=Cfg_D_Tx_BODY_LE1_CAN_MCM_D_1E1_DrvHeat6Sts, ComIPduSignalRef=Cfg_D_Tx_BODY_LE1_CAN_MCM_D_1E1_DrvHeat5ErrSts, ComIPduSignalRef=Cfg_D_Tx_BODY_LE1_CAN_MCM_D_1E1_DrvKneadingMassglvlSts9, ComIPduSignalRef=Cfg_D_Tx_BODY_LE1_CAN_MCM_D_1E1_DrvKneadingMassgTime9
          ComTxIPdu: ComMinimumDelayTime=0, ComTxIPduClearUpdateBit=Confirmation, ComTxIPduUnusedAreasDefault=0x0
            ComTxModeTrue
              ComTxMode: ComTxModeMode=PERIODIC, ComTxModeNumberOfRepetitions=0, ComTxModeRepetitionPeriod=0, ComTxModeTimeOffset=0, ComTxModeTimePeriod=50
        Cfg_D_Tx_BODY_LE1_CAN_MCM_D_1E8: ComIPduDirection=SEND, ComIPduHandleId=4, PduTimeoutSupport=false, ComPduTimeoutNotificationEnable=false, ComPduIdRef=Cfg_D_Tx_BODY_LE1_CAN_MCM_D_1E8, ComIPduGroupRef=BODY_LE1_CANTx, ComIPduSignalRef=Cfg_D_Tx_BODY_LE1_CAN_MCM_D_1E8_DrvKneadingMassgTime10, ComIPduSignalRef=Cfg_D_Tx_BODY_LE1_CAN_MCM_D_1E8_DrvKneadingMassgSkillsSts10, ComIPduSignalRef=Cfg_D_Tx_BODY_LE1_CAN_MCM_D_1E8_DrvKneadingMassglvlSts10, ComIPduSignalRef=Cfg_D_Tx_BODY_LE1_CAN_MCM_D_1E8_DrvMassageHeatNTC1, ComIPduSignalRef=Cfg_D_Tx_BODY_LE1_CAN_MCM_D_1E8_DrvMassageHeatNTC2, ComIPduSignalRef=Cfg_D_Tx_BODY_LE1_CAN_MCM_D_1E8_DrvMassageHeatNTC3, ComIPduSignalRef=Cfg_D_Tx_BODY_LE1_CAN_MCM_D_1E8_DrvMassageHeatNTC4, ComIPduSignalRef=Cfg_D_Tx_BODY_LE1_CAN_MCM_D_1E8_DrvMassageHeatNTC5, ComIPduSignalRef=Cfg_D_Tx_BODY_LE1_CAN_MCM_D_1E8_DrvMassageHeatNTC6
          ComTxIPdu: ComMinimumDelayTime=0, ComTxIPduClearUpdateBit=Confirmation, ComTxIPduUnusedAreasDefault=0x0
            ComTxModeTrue
              ComTxMode: ComTxModeMode=PERIODIC, ComTxModeNumberOfRepetitions=0, ComTxModeRepetitionPeriod=0, ComTxModeTimeOffset=0, ComTxModeTimePeriod=50
        Cfg_D_Tx_BODY_LE1_CAN_MCM_D_1EC: ComIPduDirection=SEND, ComIPduHandleId=5, PduTimeoutSupport=false, ComPduTimeoutNotificationEnable=false, ComPduIdRef=Cfg_D_Tx_BODY_LE1_CAN_MCM_D_1EC, ComIPduGroupRef=BODY_LE1_CANTx, ComIPduSignalRef=Cfg_D_Tx_BODY_LE1_CAN_MCM_D_1EC_DrvMassageHeatNTC7, ComIPduSignalRef=Cfg_D_Tx_BODY_LE1_CAN_MCM_D_1EC_DrvMassageHeatNTC8, ComIPduSignalRef=Cfg_D_Tx_BODY_LE1_CAN_MCM_D_1EC_DrvMassageHeatNTC9, ComIPduSignalRef=Cfg_D_Tx_BODY_LE1_CAN_MCM_D_1EC_DrvMassageHeatNTC10, ComIPduSignalRef=Cfg_D_Tx_BODY_LE1_CAN_MCM_D_1EC_DrvMassageHeatNTC11, ComIPduSignalRef=Cfg_D_Tx_BODY_LE1_CAN_MCM_D_1EC_DrvMassageHeatNTC12
          ComTxIPdu: ComMinimumDelayTime=0, ComTxIPduClearUpdateBit=Confirmation, ComTxIPduUnusedAreasDefault=0x0
            ComTxModeTrue
              ComTxMode: ComTxModeMode=PERIODIC, ComTxModeNumberOfRepetitions=0, ComTxModeRepetitionPeriod=0, ComTxModeTimeOffset=0, ComTxModeTimePeriod=50
        Cfg_D_Rx_BODY_LE1_CAN_BCU_11E: ComIPduDirection=RECEIVE, ComIPduHandleId=0, PduTimeoutSupport=false, ComPduTimeoutNotificationEnable=false, ComPduIdRef=Cfg_D_Rx_BODY_LE1_CAN_BCU_11E, ComIPduGroupRef=BODY_LE1_CANRx, ComIPduSignalRef=Cfg_D_Rx_BODY_LE1_CAN_BCU_11E_VehSpdSts_Rdnt1, ComIPduSignalRef=Cfg_D_Rx_BODY_LE1_CAN_BCU_11E_VehSpd_Rdnt1
        Cfg_D_Rx_BODY_LE1_CAN_ZONE_13C: ComIPduDirection=RECEIVE, ComIPduHandleId=1, PduTimeoutSupport=true, PduFirstTimeoutValue=500, PduTimeoutValue=500, ComPduTimeoutNotificationEnable=true, ComPduIdRef=Cfg_D_Rx_BODY_LE1_CAN_ZONE_13C, ComIPduGroupRef=BODY_LE1_CANRx, ComIPduSignalRef=Cfg_D_Rx_BODY_LE1_CAN_ZONE_13C_ZONE_13C_CRC, ComIPduSignalRef=Cfg_D_Rx_BODY_LE1_CAN_ZONE_13C_ZONE_13C_MsgCntr, ComIPduSignalRef=Cfg_D_Rx_BODY_LE1_CAN_ZONE_13C_OperatorState_SrvSts, ComIPduSignalRef=Cfg_D_Rx_BODY_LE1_CAN_ZONE_13C_DrvState_SrvSts, ComIPduSignalRef=Cfg_D_Rx_BODY_LE1_CAN_ZONE_13C_VehStateDetailed_SrvSts, ComIPduSignalRef=Cfg_D_Rx_BODY_LE1_CAN_ZONE_13C_DrvState, ComIPduSignalRef=Cfg_D_Rx_BODY_LE1_CAN_ZONE_13C_OperatorState, ComIPduSignalRef=Cfg_D_Rx_BODY_LE1_CAN_ZONE_13C_VehStateDetailed, ComIPduSignalRef=Cfg_D_Rx_BODY_LE1_CAN_ZONE_13C_VehModeDef
        Cfg_D_Rx_BODY_LE1_CAN_ZONE_MCM_05: ComIPduDirection=RECEIVE, ComIPduHandleId=2, PduTimeoutSupport=false, ComPduTimeoutNotificationEnable=false, ComPduIdRef=Cfg_D_Rx_BODY_LE1_CAN_ZONE_MCM_05, ComIPduGroupRef=BODY_LE1_CANRx, ComIPduSignalRef=Cfg_D_Rx_BODY_LE1_CAN_ZONE_MCM_05_DrvKneadingMassgSkillsCmd5, ComIPduSignalRef=Cfg_D_Rx_BODY_LE1_CAN_ZONE_MCM_05_DrvKneadingMassgTimesCmd5, ComIPduSignalRef=Cfg_D_Rx_BODY_LE1_CAN_ZONE_MCM_05_DrvKneadingMassgLvlCmd5, ComIPduSignalRef=Cfg_D_Rx_BODY_LE1_CAN_ZONE_MCM_05_DrvKneadingMassgLvlCmd6, ComIPduSignalRef=Cfg_D_Rx_BODY_LE1_CAN_ZONE_MCM_05_DrvKneadingMassgLvlCmd7, ComIPduSignalRef=Cfg_D_Rx_BODY_LE1_CAN_ZONE_MCM_05_DrvKneadingMassgLvlCmd8, ComIPduSignalRef=Cfg_D_Rx_BODY_LE1_CAN_ZONE_MCM_05_DrvKneadingMassgSkillsCmd6, ComIPduSignalRef=Cfg_D_Rx_BODY_LE1_CAN_ZONE_MCM_05_DrvKneadingMassgTimesCmd6, ComIPduSignalRef=Cfg_D_Rx_BODY_LE1_CAN_ZONE_MCM_05_DrvKneadingMassgSkillsCmd7, ComIPduSignalRef=Cfg_D_Rx_BODY_LE1_CAN_ZONE_MCM_05_DrvKneadingMassgTimesCmd7, ComIPduSignalRef=Cfg_D_Rx_BODY_LE1_CAN_ZONE_MCM_05_DrvKneadingMassgSkillsCmd8, ComIPduSignalRef=Cfg_D_Rx_BODY_LE1_CAN_ZONE_MCM_05_DrvKneadingMassgTimesCmd8, ComIPduSignalRef=Cfg_D_Rx_BODY_LE1_CAN_ZONE_MCM_05_DrvKneadingMassgSkillsCmd9, ComIPduSignalRef=Cfg_D_Rx_BODY_LE1_CAN_ZONE_MCM_05_DrvKneadingMassgTimesCmd9, ComIPduSignalRef=Cfg_D_Rx_BODY_LE1_CAN_ZONE_MCM_05_DrvKneadingMassgLvlCmd9, ComIPduSignalRef=Cfg_D_Rx_BODY_LE1_CAN_ZONE_MCM_05_DrvKneadingMassgLvlCmd10, ComIPduSignalRef=Cfg_D_Rx_BODY_LE1_CAN_ZONE_MCM_05_DrvKneadingMassgTimesCmd10, ComIPduSignalRef=Cfg_D_Rx_BODY_LE1_CAN_ZONE_MCM_05_DrvKneadingMassgSkillsCmd10
        Cfg_D_Rx_BODY_LE1_CAN_ZONE_1C9: ComIPduDirection=RECEIVE, ComIPduHandleId=3, PduTimeoutSupport=false, ComPduTimeoutNotificationEnable=false, ComPduIdRef=Cfg_D_Rx_BODY_LE1_CAN_ZONE_1C9, ComIPduGroupRef=BODY_LE1_CANRx, ComIPduSignalRef=Cfg_D_Rx_BODY_LE1_CAN_ZONE_1C9_DrvHeat1_pct, ComIPduSignalRef=Cfg_D_Rx_BODY_LE1_CAN_ZONE_1C9_DrvHeat2_pct, ComIPduSignalRef=Cfg_D_Rx_BODY_LE1_CAN_ZONE_1C9_DrvHeat3_pct, ComIPduSignalRef=Cfg_D_Rx_BODY_LE1_CAN_ZONE_1C9_DrvHeat4_pct, ComIPduSignalRef=Cfg_D_Rx_BODY_LE1_CAN_ZONE_1C9_DrvHeat5_pct, ComIPduSignalRef=Cfg_D_Rx_BODY_LE1_CAN_ZONE_1C9_DrvHeat6_pct
        Cfg_D_Rx_BODY_LE1_CAN_Zone_FL_MCM_01: ComIPduDirection=RECEIVE, ComIPduHandleId=4, PduTimeoutSupport=true, PduFirstTimeoutValue=500, PduTimeoutValue=500, ComPduTimeoutNotificationEnable=false, ComPduIdRef=Cfg_D_Rx_BODY_LE1_CAN_Zone_FL_MCM_01, ComIPduGroupRef=BODY_LE1_CANRx, ComIPduSignalRef=Cfg_D_Rx_BODY_LE1_CAN_Zone_FL_MCM_01_DrvSeatmassgValve1Cmd, ComIPduSignalRef=Cfg_D_Rx_BODY_LE1_CAN_Zone_FL_MCM_01_DrvSeatmassgValve2Cmd, ComIPduSignalRef=Cfg_D_Rx_BODY_LE1_CAN_Zone_FL_MCM_01_DrvSeatmassgValve3Cmd, ComIPduSignalRef=Cfg_D_Rx_BODY_LE1_CAN_Zone_FL_MCM_01_DrvSeatmassgValve4Cmd, ComIPduSignalRef=Cfg_D_Rx_BODY_LE1_CAN_Zone_FL_MCM_01_DrvSeatmassgValve5Cmd, ComIPduSignalRef=Cfg_D_Rx_BODY_LE1_CAN_Zone_FL_MCM_01_DrvSeatmassgValve6Cmd, ComIPduSignalRef=Cfg_D_Rx_BODY_LE1_CAN_Zone_FL_MCM_01_DrvSeatmassgValve7Cmd, ComIPduSignalRef=Cfg_D_Rx_BODY_LE1_CAN_Zone_FL_MCM_01_DrvSeatmassgValve8Cmd, ComIPduSignalRef=Cfg_D_Rx_BODY_LE1_CAN_Zone_FL_MCM_01_DrvSeatmassgValve9Cmd, ComIPduSignalRef=Cfg_D_Rx_BODY_LE1_CAN_Zone_FL_MCM_01_DrvSeatmassgValve10Cmd, ComIPduSignalRef=Cfg_D_Rx_BODY_LE1_CAN_Zone_FL_MCM_01_DrvSeatmassgValve11Cmd, ComIPduSignalRef=Cfg_D_Rx_BODY_LE1_CAN_Zone_FL_MCM_01_DrvSeatmassgValve12Cmd, ComIPduSignalRef=Cfg_D_Rx_BODY_LE1_CAN_Zone_FL_MCM_01_DrvSeatmassgHeat1Cmd, ComIPduSignalRef=Cfg_D_Rx_BODY_LE1_CAN_Zone_FL_MCM_01_DrvSeatmassgHeat2Cmd, ComIPduSignalRef=Cfg_D_Rx_BODY_LE1_CAN_Zone_FL_MCM_01_DrvSeatmassgHeat3Cmd, ComIPduSignalRef=Cfg_D_Rx_BODY_LE1_CAN_Zone_FL_MCM_01_DrvSeatmassgHeat4Cmd, ComIPduSignalRef=Cfg_D_Rx_BODY_LE1_CAN_Zone_FL_MCM_01_DrvSeatmassgHeat5Cmd, ComIPduSignalRef=Cfg_D_Rx_BODY_LE1_CAN_Zone_FL_MCM_01_DrvSeatmassgHeat6Cmd, ComIPduSignalRef=Cfg_D_Rx_BODY_LE1_CAN_Zone_FL_MCM_01_DrvSeatmassgHeat7Cmd, ComIPduSignalRef=Cfg_D_Rx_BODY_LE1_CAN_Zone_FL_MCM_01_DrvSeatmassgHeat8Cmd, ComIPduSignalRef=Cfg_D_Rx_BODY_LE1_CAN_Zone_FL_MCM_01_DrvSeatmassgHeat9Cmd, ComIPduSignalRef=Cfg_D_Rx_BODY_LE1_CAN_Zone_FL_MCM_01_DrvSeatmassgHeat10Cmd, ComIPduSignalRef=Cfg_D_Rx_BODY_LE1_CAN_Zone_FL_MCM_01_DrvSeatmassgHeat11Cmd, ComIPduSignalRef=Cfg_D_Rx_BODY_LE1_CAN_Zone_FL_MCM_01_DrvSeatmassgHeat12Cmd, ComIPduSignalRef=Cfg_D_Rx_BODY_LE1_CAN_Zone_FL_MCM_01_DrvSeatLumbarTopValue1Cmd, ComIPduSignalRef=Cfg_D_Rx_BODY_LE1_CAN_Zone_FL_MCM_01_DrvSeatLumbarMidValue2Cmd, ComIPduSignalRef=Cfg_D_Rx_BODY_LE1_CAN_Zone_FL_MCM_01_DrvSeatLumbarBottomValue3Cmd, ComIPduSignalRef=Cfg_D_Rx_BODY_LE1_CAN_Zone_FL_MCM_01_DrvSeatBolsterValueBLCmd, ComIPduSignalRef=Cfg_D_Rx_BODY_LE1_CAN_Zone_FL_MCM_01_DrvSeatBolsterValueBRCmd, ComIPduSignalRef=Cfg_D_Rx_BODY_LE1_CAN_Zone_FL_MCM_01_DrvSeatCushionValue6Cmd, ComIPduSignalRef=Cfg_D_Rx_BODY_LE1_CAN_Zone_FL_MCM_01_DrvSeatCushionValue5Cmd, ComIPduSignalRef=Cfg_D_Rx_BODY_LE1_CAN_Zone_FL_MCM_01_DrvSeatCushionValue4Cmd
        Cfg_D_Rx_BODY_LE1_CAN_Zone_FL_MCM_02: ComIPduDirection=RECEIVE, ComIPduHandleId=5, PduTimeoutSupport=true, PduFirstTimeoutValue=500, PduTimeoutValue=500, ComPduTimeoutNotificationEnable=false, ComPduIdRef=Cfg_D_Rx_BODY_LE1_CAN_Zone_FL_MCM_02, ComIPduGroupRef=BODY_LE1_CANRx, ComIPduSignalRef=Cfg_D_Rx_BODY_LE1_CAN_Zone_FL_MCM_02_DrvPumpCmd, ComIPduSignalRef=Cfg_D_Rx_BODY_LE1_CAN_Zone_FL_MCM_02_DrvSeatUpperValueLCmd, ComIPduSignalRef=Cfg_D_Rx_BODY_LE1_CAN_Zone_FL_MCM_02_DrvSeatUpperValueMCmd, ComIPduSignalRef=Cfg_D_Rx_BODY_LE1_CAN_Zone_FL_MCM_02_DrvSeatCushionValue2Cmd, ComIPduSignalRef=Cfg_D_Rx_BODY_LE1_CAN_Zone_FL_MCM_02_DrvSeatUpperValueRCmd, ComIPduSignalRef=Cfg_D_Rx_BODY_LE1_CAN_Zone_FL_MCM_02_DrvSeatCushionValue3Cmd, ComIPduSignalRef=Cfg_D_Rx_BODY_LE1_CAN_Zone_FL_MCM_02_DrvSeatCushionValue1Cmd
        Cfg_D_Rx_BODY_LE1_CAN_ZONE_2EF: ComIPduDirection=RECEIVE, ComIPduHandleId=6, PduTimeoutSupport=false, ComPduTimeoutNotificationEnable=false, ComPduIdRef=Cfg_D_Rx_BODY_LE1_CAN_ZONE_2EF, ComIPduGroupRef=BODY_LE1_CANRx, ComIPduSignalRef=Cfg_D_Rx_BODY_LE1_CAN_ZONE_2EF_BattVolt_LBMR
        Cfg_D_Rx_BODY_LE1_CAN_ZONE_3A9: ComIPduDirection=RECEIVE, ComIPduHandleId=7, PduTimeoutSupport=true, PduFirstTimeoutValue=500, PduTimeoutValue=500, ComPduTimeoutNotificationEnable=false, ComPduIdRef=Cfg_D_Rx_BODY_LE1_CAN_ZONE_3A9, ComIPduGroupRef=BODY_LE1_CANRx, ComIPduSignalRef=Cfg_D_Rx_BODY_LE1_CAN_ZONE_3A9_VehOdometer
        Cfg_D_Rx_BODY_LE1_CAN_ZONE_3B2: ComIPduDirection=RECEIVE, ComIPduHandleId=8, PduTimeoutSupport=true, PduFirstTimeoutValue=500, PduTimeoutValue=6000, ComPduTimeoutNotificationEnable=false, ComPduIdRef=Cfg_D_Rx_BODY_LE1_CAN_ZONE_3B2, ComIPduGroupRef=BODY_LE1_CANRx, ComIPduSignalRef=Cfg_D_Rx_BODY_LE1_CAN_ZONE_3B2_Yr, ComIPduSignalRef=Cfg_D_Rx_BODY_LE1_CAN_ZONE_3B2_Mth, ComIPduSignalRef=Cfg_D_Rx_BODY_LE1_CAN_ZONE_3B2_Day, ComIPduSignalRef=Cfg_D_Rx_BODY_LE1_CAN_ZONE_3B2_Hr, ComIPduSignalRef=Cfg_D_Rx_BODY_LE1_CAN_ZONE_3B2_Min, ComIPduSignalRef=Cfg_D_Rx_BODY_LE1_CAN_ZONE_3B2_Sec, ComIPduSignalRef=Cfg_D_Rx_BODY_LE1_CAN_ZONE_3B2_MSec
        Cfg_D_Rx_BODY_LE1_CAN_ZONE_PNC: ComIPduDirection=RECEIVE, ComIPduHandleId=9, PduTimeoutSupport=false, ComPduTimeoutNotificationEnable=false, ComPduIdRef=Cfg_D_Rx_BODY_LE1_CAN_ZONE_PNC, ComIPduGroupRef=BODY_LE1_CANRx, ComIPduSignalRef=Cfg_D_Rx_BODY_LE1_CAN_ZONE_PNC_PNC_DFT, ComIPduSignalRef=Cfg_D_Rx_BODY_LE1_CAN_ZONE_PNC_PNC1_Sts, ComIPduSignalRef=Cfg_D_Rx_BODY_LE1_CAN_ZONE_PNC_PNC2_Sts, ComIPduSignalRef=Cfg_D_Rx_BODY_LE1_CAN_ZONE_PNC_PNC3_Sts, ComIPduSignalRef=Cfg_D_Rx_BODY_LE1_CAN_ZONE_PNC_PNC4_Sts, ComIPduSignalRef=Cfg_D_Rx_BODY_LE1_CAN_ZONE_PNC_PNC5_Sts, ComIPduSignalRef=Cfg_D_Rx_BODY_LE1_CAN_ZONE_PNC_PNC6_Sts, ComIPduSignalRef=Cfg_D_Rx_BODY_LE1_CAN_ZONE_PNC_PNC7_Sts, ComIPduSignalRef=Cfg_D_Rx_BODY_LE1_CAN_ZONE_PNC_PNC8_Sts, ComIPduSignalRef=Cfg_D_Rx_BODY_LE1_CAN_ZONE_PNC_PNC9_Sts, ComIPduSignalRef=Cfg_D_Rx_BODY_LE1_CAN_ZONE_PNC_PNC10_Sts, ComIPduSignalRef=Cfg_D_Rx_BODY_LE1_CAN_ZONE_PNC_PNC11_Sts, ComIPduSignalRef=Cfg_D_Rx_BODY_LE1_CAN_ZONE_PNC_PNC12_Sts, ComIPduSignalRef=Cfg_D_Rx_BODY_LE1_CAN_ZONE_PNC_PNC13_Sts, ComIPduSignalRef=Cfg_D_Rx_BODY_LE1_CAN_ZONE_PNC_PNC14_Sts, ComIPduSignalRef=Cfg_D_Rx_BODY_LE1_CAN_ZONE_PNC_PNC15_Sts, ComIPduSignalRef=Cfg_D_Rx_BODY_LE1_CAN_ZONE_PNC_PNC16_Sts, ComIPduSignalRef=Cfg_D_Rx_BODY_LE1_CAN_ZONE_PNC_PNC17_Sts, ComIPduSignalRef=Cfg_D_Rx_BODY_LE1_CAN_ZONE_PNC_PNC18_Sts, ComIPduSignalRef=Cfg_D_Rx_BODY_LE1_CAN_ZONE_PNC_PNC19_Sts, ComIPduSignalRef=Cfg_D_Rx_BODY_LE1_CAN_ZONE_PNC_PNC20_Sts, ComIPduSignalRef=Cfg_D_Rx_BODY_LE1_CAN_ZONE_PNC_PNC21_Sts, ComIPduSignalRef=Cfg_D_Rx_BODY_LE1_CAN_ZONE_PNC_PNC22_Sts, ComIPduSignalRef=Cfg_D_Rx_BODY_LE1_CAN_ZONE_PNC_PNC23_Sts, ComIPduSignalRef=Cfg_D_Rx_BODY_LE1_CAN_ZONE_PNC_PNC24_Sts, ComIPduSignalRef=Cfg_D_Rx_BODY_LE1_CAN_ZONE_PNC_PNC25_Sts, ComIPduSignalRef=Cfg_D_Rx_BODY_LE1_CAN_ZONE_PNC_PNC26_Sts, ComIPduSignalRef=Cfg_D_Rx_BODY_LE1_CAN_ZONE_PNC_PNC27_Sts, ComIPduSignalRef=Cfg_D_Rx_BODY_LE1_CAN_ZONE_PNC_PNC28_Sts, ComIPduSignalRef=Cfg_D_Rx_BODY_LE1_CAN_ZONE_PNC_PNC29_Sts, ComIPduSignalRef=Cfg_D_Rx_BODY_LE1_CAN_ZONE_PNC_PNC30_Sts, ComIPduSignalRef=Cfg_D_Rx_BODY_LE1_CAN_ZONE_PNC_PNC31_Sts, ComIPduSignalRef=Cfg_D_Rx_BODY_LE1_CAN_ZONE_PNC_PNC32_Sts, ComIPduSignalRef=Cfg_D_Rx_BODY_LE1_CAN_ZONE_PNC_PNC33_Sts, ComIPduSignalRef=Cfg_D_Rx_BODY_LE1_CAN_ZONE_PNC_PNC34_Sts, ComIPduSignalRef=Cfg_D_Rx_BODY_LE1_CAN_ZONE_PNC_PNC35_Sts, ComIPduSignalRef=Cfg_D_Rx_BODY_LE1_CAN_ZONE_PNC_PNC36_Sts, ComIPduSignalRef=Cfg_D_Rx_BODY_LE1_CAN_ZONE_PNC_PNC37_Sts, ComIPduSignalRef=Cfg_D_Rx_BODY_LE1_CAN_ZONE_PNC_PNC38_Sts, ComIPduSignalRef=Cfg_D_Rx_BODY_LE1_CAN_ZONE_PNC_PNC39_Sts, ComIPduSignalRef=Cfg_D_Rx_BODY_LE1_CAN_ZONE_PNC_PNC40_Sts, ComIPduSignalRef=Cfg_D_Rx_BODY_LE1_CAN_ZONE_PNC_PNC41_Sts, ComIPduSignalRef=Cfg_D_Rx_BODY_LE1_CAN_ZONE_PNC_PNC43_Sts, ComIPduSignalRef=Cfg_D_Rx_BODY_LE1_CAN_ZONE_PNC_PNC42_Sts, ComIPduSignalRef=Cfg_D_Rx_BODY_LE1_CAN_ZONE_PNC_PNC44_Sts, ComIPduSignalRef=Cfg_D_Rx_BODY_LE1_CAN_ZONE_PNC_PNC45_Sts, ComIPduSignalRef=Cfg_D_Rx_BODY_LE1_CAN_ZONE_PNC_PNC46_Sts, ComIPduSignalRef=Cfg_D_Rx_BODY_LE1_CAN_ZONE_PNC_PNC47_Sts, ComIPduSignalRef=Cfg_D_Rx_BODY_LE1_CAN_ZONE_PNC_PNC48_Sts
        Cfg_D_Rx_BODY_LE1_CAN_VC_Data_5E0: ComIPduDirection=RECEIVE, ComIPduHandleId=10, PduTimeoutSupport=false, ComPduTimeoutNotificationEnable=false, ComPduIdRef=Cfg_D_Rx_BODY_LE1_CAN_VC_Data_5E0, ComIPduGroupRef=BODY_LE1_CANRx, ComIPduSignalRef=Cfg_D_Rx_BODY_LE1_CAN_VC_Data_5E0_VC_Data_5E0_CRC, ComIPduSignalRef=Cfg_D_Rx_BODY_LE1_CAN_VC_Data_5E0_VC_Data_5E0_MsgCntr, ComIPduSignalRef=Cfg_D_Rx_BODY_LE1_CAN_VC_Data_5E0_VC_Data_5E0_Payload
      BODY_LE1_CANTx (ComIPduGroup): ComIPduGroupHandleId=0, UserDefine=false, IsRx=false
      BODY_LE1_CANRx (ComIPduGroup): ComIPduGroupHandleId=1, UserDefine=false, IsRx=true
      201 x ComSignal, all with ComErrorNotification=, ComInvalidNotification=, ComDataInvalidAction=NONE, DataInvalidSupport=false, ComRxDataTimeoutAction=NONE, ComSignalDataInvalidValue=, ComNotificationEnable=true, ComSignalEndianness=BIG_ENDIAN, ComSignalInitValue=0, ComTimeoutSubstitutionValue=0, ComSignalLength=0, ComTransferProperty=PENDING, ComUpdateBitPosition=, UserDefine=false, inputFile=, SomeIpSignalMessageType=, isMSignal=false:
        Cfg_D_Tx_BODY_LE1_CAN_MCM_D_1B6_DrvKneadingMassgSkillsSts5: ComNotification=Com_CbkTxAck_Cfg_D_Tx_BODY_LE1_CAN_MCM_D_1B6_DrvKneadingMassgSkillsSts5, ComTimeoutNotification=, ComBitPosition=3, ComBitSize=4, ComFirstTimeout=0, ComHandleId=0, ComSignalInActiveValue=0, DataTimeoutSupport=false, ComTimeout=0, ComSignalType=UINT8, Direction=Tx, InputName=DrvKneadingMassgSkillsSts5, offset=0, factor=1, enumValue=, unitName=, max=15, min=0, compuMethodType=, ComSystemTemplateSystemSignalRef=Cfg_D_Tx_BODY_LE1_CAN_MCM_D_1B6
        Cfg_D_Tx_BODY_LE1_CAN_MCM_D_1B6_DrvKneadingMassgSkillsSts6: ComNotification=Com_CbkTxAck_Cfg_D_Tx_BODY_LE1_CAN_MCM_D_1B6_DrvKneadingMassgSkillsSts6, ComTimeoutNotification=, ComBitPosition=7, ComBitSize=4, ComFirstTimeout=0, ComHandleId=1, ComSignalInActiveValue=0, DataTimeoutSupport=false, ComTimeout=0, ComSignalType=UINT8, Direction=Tx, InputName=DrvKneadingMassgSkillsSts6, offset=0, factor=1, enumValue=, unitName=, max=15, min=0, compuMethodType=, ComSystemTemplateSystemSignalRef=Cfg_D_Tx_BODY_LE1_CAN_MCM_D_1B6
        Cfg_D_Tx_BODY_LE1_CAN_MCM_D_1B6_DrvKneadingMassglvlSts5: ComNotification=Com_CbkTxAck_Cfg_D_Tx_BODY_LE1_CAN_MCM_D_1B6_DrvKneadingMassglvlSts5, ComTimeoutNotification=, ComBitPosition=9, ComBitSize=2, ComFirstTimeout=0, ComHandleId=2, ComSignalInActiveValue=0, DataTimeoutSupport=false, ComTimeout=0, ComSignalType=UINT8, Direction=Tx, InputName=DrvKneadingMassglvlSts5, offset=0, factor=1, enumValue=0%Idle&1%intensity 1&2%intensity 2, unitName=, max=3, min=0, compuMethodType=, ComSystemTemplateSystemSignalRef=Cfg_D_Tx_BODY_LE1_CAN_MCM_D_1B6
        Cfg_D_Tx_BODY_LE1_CAN_MCM_D_1B6_DrvKneadingMassglvlSts6: ComNotification=Com_CbkTxAck_Cfg_D_Tx_BODY_LE1_CAN_MCM_D_1B6_DrvKneadingMassglvlSts6, ComTimeoutNotification=, ComBitPosition=11, ComBitSize=2, ComFirstTimeout=0, ComHandleId=3, ComSignalInActiveValue=0, DataTimeoutSupport=false, ComTimeout=0, ComSignalType=UINT8, Direction=Tx, InputName=DrvKneadingMassglvlSts6, offset=0, factor=1, enumValue=0%Idle&1%intensity 1&2%intensity 2, unitName=, max=3, min=0, compuMethodType=, ComSystemTemplateSystemSignalRef=Cfg_D_Tx_BODY_LE1_CAN_MCM_D_1B6
        Cfg_D_Tx_BODY_LE1_CAN_MCM_D_1B6_DrvKneadingMassglvlSts7: ComNotification=Com_CbkTxAck_Cfg_D_Tx_BODY_LE1_CAN_MCM_D_1B6_DrvKneadingMassglvlSts7, ComTimeoutNotification=, ComBitPosition=13, ComBitSize=2, ComFirstTimeout=0, ComHandleId=4, ComSignalInActiveValue=0, DataTimeoutSupport=false, ComTimeout=0, ComSignalType=UINT8, Direction=Tx, InputName=DrvKneadingMassglvlSts7, offset=0, factor=1, enumValue=0%Idle&1%intensity 1&2%intensity 2, unitName=, max=3, min=0, compuMethodType=, ComSystemTemplateSystemSignalRef=Cfg_D_Tx_BODY_LE1_CAN_MCM_D_1B6
        Cfg_D_Tx_BODY_LE1_CAN_MCM_D_1B6_DrvKneadingMassglvlSts8: ComNotification=Com_CbkTxAck_Cfg_D_Tx_BODY_LE1_CAN_MCM_D_1B6_DrvKneadingMassglvlSts8, ComTimeoutNotification=, ComBitPosition=15, ComBitSize=2, ComFirstTimeout=0, ComHandleId=5, ComSignalInActiveValue=0, DataTimeoutSupport=false, ComTimeout=0, ComSignalType=UINT8, Direction=Tx, InputName=DrvKneadingMassglvlSts8, offset=0, factor=1, enumValue=0%Idle&1%intensity 1&2%intensity 2, unitName=, max=3, min=0, compuMethodType=, ComSystemTemplateSystemSignalRef=Cfg_D_Tx_BODY_LE1_CAN_MCM_D_1B6
        Cfg_D_Tx_BODY_LE1_CAN_MCM_D_1B6_DrvKneadingMassgSkillsSts7: ComNotification=Com_CbkTxAck_Cfg_D_Tx_BODY_LE1_CAN_MCM_D_1B6_DrvKneadingMassgSkillsSts7, ComTimeoutNotification=, ComBitPosition=19, ComBitSize=4, ComFirstTimeout=0, ComHandleId=6, ComSignalInActiveValue=0, DataTimeoutSupport=false, ComTimeout=0, ComSignalType=UINT8, Direction=Tx, InputName=DrvKneadingMassgSkillsSts7, offset=0, factor=1, enumValue=, unitName=, max=15, min=0, compuMethodType=, ComSystemTemplateSystemSignalRef=Cfg_D_Tx_BODY_LE1_CAN_MCM_D_1B6
        Cfg_D_Tx_BODY_LE1_CAN_MCM_D_1B6_DrvKneadingMassgSkillsSts8: ComNotification=Com_CbkTxAck_Cfg_D_Tx_BODY_LE1_CAN_MCM_D_1B6_DrvKneadingMassgSkillsSts8, ComTimeoutNotification=, ComBitPosition=23, ComBitSize=4, ComFirstTimeout=0, ComHandleId=7, ComSignalInActiveValue=0, DataTimeoutSupport=false, ComTimeout=0, ComSignalType=UINT8, Direction=Tx, InputName=DrvKneadingMassgSkillsSts8, offset=0, factor=1, enumValue=, unitName=, max=15, min=0, compuMethodType=, ComSystemTemplateSystemSignalRef=Cfg_D_Tx_BODY_LE1_CAN_MCM_D_1B6
        Cfg_D_Tx_BODY_LE1_CAN_MCM_D_1B6_DrvKneadingMassgTime8: ComNotification=Com_CbkTxAck_Cfg_D_Tx_BODY_LE1_CAN_MCM_D_1B6_DrvKneadingMassgTime8, ComTimeoutNotification=, ComBitPosition=31, ComBitSize=8, ComFirstTimeout=0, ComHandleId=8, ComSignalInActiveValue=0, DataTimeoutSupport=false, ComTimeout=0, ComSignalType=UINT8, Direction=Tx, InputName=DrvKneadingMassgTime8, offset=0, factor=0.1, enumValue=, unitName=, max=25.5, min=0, compuMethodType=INTERNALTOPHYS, ComSystemTemplateSystemSignalRef=Cfg_D_Tx_BODY_LE1_CAN_MCM_D_1B6
        Cfg_D_Tx_BODY_LE1_CAN_MCM_D_1B6_DrvKneadingMassgTime5: ComNotification=Com_CbkTxAck_Cfg_D_Tx_BODY_LE1_CAN_MCM_D_1B6_DrvKneadingMassgTime5, ComTimeoutNotification=, ComBitPosition=47, ComBitSize=8, ComFirstTimeout=0, ComHandleId=9, ComSignalInActiveValue=0, DataTimeoutSupport=false, ComTimeout=0, ComSignalType=UINT8, Direction=Tx, InputName=DrvKneadingMassgTime5, offset=0, factor=0.1, enumValue=, unitName=, max=25.5, min=0, compuMethodType=INTERNALTOPHYS, ComSystemTemplateSystemSignalRef=Cfg_D_Tx_BODY_LE1_CAN_MCM_D_1B6
        Cfg_D_Tx_BODY_LE1_CAN_MCM_D_1B6_DrvKneadingMassgTime6: ComNotification=Com_CbkTxAck_Cfg_D_Tx_BODY_LE1_CAN_MCM_D_1B6_DrvKneadingMassgTime6, ComTimeoutNotification=, ComBitPosition=55, ComBitSize=8, ComFirstTimeout=0, ComHandleId=10, ComSignalInActiveValue=0, DataTimeoutSupport=false, ComTimeout=0, ComSignalType=UINT8, Direction=Tx, InputName=DrvKneadingMassgTime6, offset=0, factor=0.1, enumValue=, unitName=, max=25.5, min=0, compuMethodType=INTERNALTOPHYS, ComSystemTemplateSystemSignalRef=Cfg_D_Tx_BODY_LE1_CAN_MCM_D_1B6
        Cfg_D_Tx_BODY_LE1_CAN_MCM_D_1B6_DrvKneadingMassgTime7: ComNotification=Com_CbkTxAck_Cfg_D_Tx_BODY_LE1_CAN_MCM_D_1B6_DrvKneadingMassgTime7, ComTimeoutNotification=, ComBitPosition=63, ComBitSize=8, ComFirstTimeout=0, ComHandleId=11, ComSignalInActiveValue=0, DataTimeoutSupport=false, ComTimeout=0, ComSignalType=UINT8, Direction=Tx, InputName=DrvKneadingMassgTime7, offset=0, factor=0.1, enumValue=, unitName=, max=25.5, min=0, compuMethodType=INTERNALTOPHYS, ComSystemTemplateSystemSignalRef=Cfg_D_Tx_BODY_LE1_CAN_MCM_D_1B6
        Cfg_D_Tx_BODY_LE1_CAN_MCM_D_1DF_DrvMassSwitchSts: ComNotification=Com_CbkTxAck_Cfg_D_Tx_BODY_LE1_CAN_MCM_D_1DF_DrvMassSwitchSts, ComTimeoutNotification=, ComBitPosition=1, ComBitSize=2, ComFirstTimeout=0, ComHandleId=12, ComSignalInActiveValue=0, DataTimeoutSupport=false, ComTimeout=0, ComSignalType=UINT8, Direction=Tx, InputName=DrvMassSwitchSts, offset=0, factor=1, enumValue=0%No Press&1%Press&2%Err&3%Reserved, unitName=, max=3, min=0, compuMethodType=, ComSystemTemplateSystemSignalRef=Cfg_D_Tx_BODY_LE1_CAN_MCM_D_1DF
        Cfg_D_Tx_BODY_LE1_CAN_MCM_D_1DF_DrvSeatmassgHeatCSts: ComNotification=Com_CbkTxAck_Cfg_D_Tx_BODY_LE1_CAN_MCM_D_1DF_DrvSeatmassgHeatCSts, ComTimeoutNotification=, ComBitPosition=3, ComBitSize=2, ComFirstTimeout=0, ComHandleId=13, ComSignalInActiveValue=0, DataTimeoutSupport=false, ComTimeout=0, ComSignalType=UINT8, Direction=Tx, InputName=DrvSeatmassgHeatCSts, offset=0, factor=1, enumValue=0%Normal&1%Action&2%Err&3%Reserved, unitName=, max=3, min=0, compuMethodType=, ComSystemTemplateSystemSignalRef=Cfg_D_Tx_BODY_LE1_CAN_MCM_D_1DF
        Cfg_D_Tx_BODY_LE1_CAN_MCM_D_1DF_DrvSeatLumbarValueSts: ComNotification=Com_CbkTxAck_Cfg_D_Tx_BODY_LE1_CAN_MCM_D_1DF_DrvSeatLumbarValueSts, ComTimeoutNotification=, ComBitPosition=5, ComBitSize=2, ComFirstTimeout=0, ComHandleId=14, ComSignalInActiveValue=0, DataTimeoutSupport=false, ComTimeout=0, ComSignalType=UINT8, Direction=Tx, InputName=DrvSeatLumbarValueSts, offset=0, factor=1, enumValue=0%Normal&1%Action&2%Err&3%Reserved, unitName=, max=3, min=0, compuMethodType=, ComSystemTemplateSystemSignalRef=Cfg_D_Tx_BODY_LE1_CAN_MCM_D_1DF
        Cfg_D_Tx_BODY_LE1_CAN_MCM_D_1DF_DrvSeatmassgValveSts: ComNotification=Com_CbkTxAck_Cfg_D_Tx_BODY_LE1_CAN_MCM_D_1DF_DrvSeatmassgValveSts, ComTimeoutNotification=, ComBitPosition=7, ComBitSize=2, ComFirstTimeout=0, ComHandleId=15, ComSignalInActiveValue=0, DataTimeoutSupport=false, ComTimeout=0, ComSignalType=UINT8, Direction=Tx, InputName=DrvSeatmassgValveSts, offset=0, factor=1, enumValue=0%Normal&1%Action&2%Err&3%Reserved, unitName=, max=3, min=0, compuMethodType=, ComSystemTemplateSystemSignalRef=Cfg_D_Tx_BODY_LE1_CAN_MCM_D_1DF
        Cfg_D_Tx_BODY_LE1_CAN_MCM_D_1DF_DrvSeatUpperValueSts: ComNotification=Com_CbkTxAck_Cfg_D_Tx_BODY_LE1_CAN_MCM_D_1DF_DrvSeatUpperValueSts, ComTimeoutNotification=, ComBitPosition=9, ComBitSize=2, ComFirstTimeout=0, ComHandleId=16, ComSignalInActiveValue=0, DataTimeoutSupport=false, ComTimeout=0, ComSignalType=UINT8, Direction=Tx, InputName=DrvSeatUpperValueSts, offset=0, factor=1, enumValue=0%Normal&1%Action&2%Err&3%Reserved, unitName=, max=3, min=0, compuMethodType=, ComSystemTemplateSystemSignalRef=Cfg_D_Tx_BODY_LE1_CAN_MCM_D_1DF
        Cfg_D_Tx_BODY_LE1_CAN_MCM_D_1DF_DrvSeatCushionValueSts: ComNotification=Com_CbkTxAck_Cfg_D_Tx_BODY_LE1_CAN_MCM_D_1DF_DrvSeatCushionValueSts, ComTimeoutNotification=, ComBitPosition=11, ComBitSize=2, ComFirstTimeout=0, ComHandleId=17, ComSignalInActiveValue=0, DataTimeoutSupport=false, ComTimeout=0, ComSignalType=UINT8, Direction=Tx, InputName=DrvSeatCushionValueSts, offset=0, factor=1, enumValue=0%Normal&1%Action&2%Err&3%Reserved, unitName=, max=3, min=0, compuMethodType=, ComSystemTemplateSystemSignalRef=Cfg_D_Tx_BODY_LE1_CAN_MCM_D_1DF
        Cfg_D_Tx_BODY_LE1_CAN_MCM_D_1DF_DrvSeatBlosterValueSts: ComNotification=Com_CbkTxAck_Cfg_D_Tx_BODY_LE1_CAN_MCM_D_1DF_DrvSeatBlosterValueSts, ComTimeoutNotification=, ComBitPosition=13, ComBitSize=2, ComFirstTimeout=0, ComHandleId=18, ComSignalInActiveValue=0, DataTimeoutSupport=false, ComTimeout=0, ComSignalType=UINT8, Direction=Tx, InputName=DrvSeatBlosterValueSts, offset=0, factor=1, enumValue=0%Normal&1%Action&2%Err&3%Reserved, unitName=, max=3, min=0, compuMethodType=, ComSystemTemplateSystemSignalRef=Cfg_D_Tx_BODY_LE1_CAN_MCM_D_1DF
        Cfg_D_Tx_BODY_LE1_CAN_MCM_D_1DF_DrvSeatLumbarTopPos: ComNotification=Com_CbkTxAck_Cfg_D_Tx_BODY_LE1_CAN_MCM_D_1DF_DrvSeatLumbarTopPos, ComTimeoutNotification=, ComBitPosition=23, ComBitSize=8, ComFirstTimeout=0, ComHandleId=19, ComSignalInActiveValue=0, DataTimeoutSupport=false, ComTimeout=0, ComSignalType=UINT8, Direction=Tx, InputName=DrvSeatLumbarTopPos, offset=0, factor=1, enumValue=, unitName=, max=255, min=0, compuMethodType=, ComSystemTemplateSystemSignalRef=Cfg_D_Tx_BODY_LE1_CAN_MCM_D_1DF
        Cfg_D_Tx_BODY_LE1_CAN_MCM_D_1DF_DrvSeatLumbarMidPos: ComNotification=Com_CbkTxAck_Cfg_D_Tx_BODY_LE1_CAN_MCM_D_1DF_DrvSeatLumbarMidPos, ComTimeoutNotification=, ComBitPosition=31, ComBitSize=8, ComFirstTimeout=0, ComHandleId=20, ComSignalInActiveValue=0, DataTimeoutSupport=false, ComTimeout=0, ComSignalType=UINT8, Direction=Tx, InputName=DrvSeatLumbarMidPos, offset=0, factor=1, enumValue=, unitName=, max=255, min=0, compuMethodType=, ComSystemTemplateSystemSignalRef=Cfg_D_Tx_BODY_LE1_CAN_MCM_D_1DF
        Cfg_D_Tx_BODY_LE1_CAN_MCM_D_1DF_DrvSeatLumbarBottomPos: ComNotification=Com_CbkTxAck_Cfg_D_Tx_BODY_LE1_CAN_MCM_D_1DF_DrvSeatLumbarBottomPos, ComTimeoutNotification=, ComBitPosition=39, ComBitSize=8, ComFirstTimeout=0, ComHandleId=21, ComSignalInActiveValue=0, DataTimeoutSupport=false, ComTimeout=0, ComSignalType=UINT8, Direction=Tx, InputName=DrvSeatLumbarBottomPos, offset=0, factor=1, enumValue=, unitName=, max=255, min=0, compuMethodType=, ComSystemTemplateSystemSignalRef=Cfg_D_Tx_BODY_LE1_CAN_MCM_D_1DF
        Cfg_D_Tx_BODY_LE1_CAN_MCM_D_1DF_DrvSeatBolsterValueBLPos: ComNotification=Com_CbkTxAck_Cfg_D_Tx_BODY_LE1_CAN_MCM_D_1DF_DrvSeatBolsterValueBLPos, ComTimeoutNotification=, ComBitPosition=47, ComBitSize=8, ComFirstTimeout=0, ComHandleId=22, ComSignalInActiveValue=0, DataTimeoutSupport=false, ComTimeout=0, ComSignalType=UINT8, Direction=Tx, InputName=DrvSeatBolsterValueBLPos, offset=0, factor=1, enumValue=, unitName=, max=255, min=0, compuMethodType=, ComSystemTemplateSystemSignalRef=Cfg_D_Tx_BODY_LE1_CAN_MCM_D_1DF
        Cfg_D_Tx_BODY_LE1_CAN_MCM_D_1DF_DrvSeatBolsterValueBRPos: ComNotification=Com_CbkTxAck_Cfg_D_Tx_BODY_LE1_CAN_MCM_D_1DF_DrvSeatBolsterValueBRPos, ComTimeoutNotification=, ComBitPosition=55, ComBitSize=8, ComFirstTimeout=0, ComHandleId=23, ComSignalInActiveValue=0, DataTimeoutSupport=false, ComTimeout=0, ComSignalType=UINT8, Direction=Tx, InputName=DrvSeatBolsterValueBRPos, offset=0, factor=1, enumValue=, unitName=, max=255, min=0, compuMethodType=, ComSystemTemplateSystemSignalRef=Cfg_D_Tx_BODY_LE1_CAN_MCM_D_1DF
        Cfg_D_Tx_BODY_LE1_CAN_MCM_D_1DF_DrvSeatCushionValue6Pos: ComNotification=Com_CbkTxAck_Cfg_D_Tx_BODY_LE1_CAN_MCM_D_1DF_DrvSeatCushionValue6Pos, ComTimeoutNotification=, ComBitPosition=63, ComBitSize=8, ComFirstTimeout=0, ComHandleId=24, ComSignalInActiveValue=0, DataTimeoutSupport=false, ComTimeout=0, ComSignalType=UINT8, Direction=Tx, InputName=DrvSeatCushionValue6Pos, offset=0, factor=1, enumValue=, unitName=, max=255, min=0, compuMethodType=, ComSystemTemplateSystemSignalRef=Cfg_D_Tx_BODY_LE1_CAN_MCM_D_1DF
        Cfg_D_Tx_BODY_LE1_CAN_MCM_D_1E0_DrvSeatCushionValue5Pos: ComNotification=Com_CbkTxAck_Cfg_D_Tx_BODY_LE1_CAN_MCM_D_1E0_DrvSeatCushionValue5Pos, ComTimeoutNotification=, ComBitPosition=7, ComBitSize=8, ComFirstTimeout=0, ComHandleId=25, ComSignalInActiveValue=0, DataTimeoutSupport=false, ComTimeout=0, ComSignalType=UINT8, Direction=Tx, InputName=DrvSeatCushionValue5Pos, offset=0, factor=1, enumValue=, unitName=, max=255, min=0, compuMethodType=, ComSystemTemplateSystemSignalRef=Cfg_D_Tx_BODY_LE1_CAN_MCM_D_1E0
        Cfg_D_Tx_BODY_LE1_CAN_MCM_D_1E0_DrvSeatCushionValue4Pos: ComNotification=Com_CbkTxAck_Cfg_D_Tx_BODY_LE1_CAN_MCM_D_1E0_DrvSeatCushionValue4Pos, ComTimeoutNotification=, ComBitPosition=15, ComBitSize=8, ComFirstTimeout=0, ComHandleId=26, ComSignalInActiveValue=0, DataTimeoutSupport=false, ComTimeout=0, ComSignalType=UINT8, Direction=Tx, InputName=DrvSeatCushionValue4Pos, offset=0, factor=1, enumValue=, unitName=, max=255, min=0, compuMethodType=, ComSystemTemplateSystemSignalRef=Cfg_D_Tx_BODY_LE1_CAN_MCM_D_1E0
        Cfg_D_Tx_BODY_LE1_CAN_MCM_D_1E0_DrvSeatCushionValue2Pos: ComNotification=Com_CbkTxAck_Cfg_D_Tx_BODY_LE1_CAN_MCM_D_1E0_DrvSeatCushionValue2Pos, ComTimeoutNotification=, ComBitPosition=23, ComBitSize=8, ComFirstTimeout=0, ComHandleId=27, ComSignalInActiveValue=0, DataTimeoutSupport=false, ComTimeout=0, ComSignalType=UINT8, Direction=Tx, InputName=DrvSeatCushionValue2Pos, offset=0, factor=1, enumValue=, unitName=, max=255, min=0, compuMethodType=, ComSystemTemplateSystemSignalRef=Cfg_D_Tx_BODY_LE1_CAN_MCM_D_1E0
        Cfg_D_Tx_BODY_LE1_CAN_MCM_D_1E0_DrvSeatCushionValue1Pos: ComNotification=Com_CbkTxAck_Cfg_D_Tx_BODY_LE1_CAN_MCM_D_1E0_DrvSeatCushionValue1Pos, ComTimeoutNotification=, ComBitPosition=31, ComBitSize=8, ComFirstTimeout=0, ComHandleId=28, ComSignalInActiveValue=0, DataTimeoutSupport=false, ComTimeout=0, ComSignalType=UINT8, Direction=Tx, InputName=DrvSeatCushionValue1Pos, offset=0, factor=1, enumValue=, unitName=, max=255, min=0, compuMethodType=, ComSystemTemplateSystemSignalRef=Cfg_D_Tx_BODY_LE1_CAN_MCM_D_1E0
        Cfg_D_Tx_BODY_LE1_CAN_MCM_D_1E0_DrvSeatUpperValueLPos: ComNotification=Com_CbkTxAck_Cfg_D_Tx_BODY_LE1_CAN_MCM_D_1E0_DrvSeatUpperValueLPos, ComTimeoutNotification=, ComBitPosition=39, ComBitSize=8, ComFirstTimeout=0, ComHandleId=29, ComSignalInActiveValue=0, DataTimeoutSupport=false, ComTimeout=0, ComSignalType=UINT8, Direction=Tx, InputName=DrvSeatUpperValueLPos, offset=0, factor=1, enumValue=, unitName=, max=255, min=0, compuMethodType=, ComSystemTemplateSystemSignalRef=Cfg_D_Tx_BODY_LE1_CAN_MCM_D_1E0
        Cfg_D_Tx_BODY_LE1_CAN_MCM_D_1E0_DrvSeatUpperValueMPos: ComNotification=Com_CbkTxAck_Cfg_D_Tx_BODY_LE1_CAN_MCM_D_1E0_DrvSeatUpperValueMPos, ComTimeoutNotification=, ComBitPosition=47, ComBitSize=8, ComFirstTimeout=0, ComHandleId=30, ComSignalInActiveValue=0, DataTimeoutSupport=false, ComTimeout=0, ComSignalType=UINT8, Direction=Tx, InputName=DrvSeatUpperValueMPos, offset=0, factor=1, enumValue=, unitName=, max=255, min=0, compuMethodType=, ComSystemTemplateSystemSignalRef=Cfg_D_Tx_BODY_LE1_CAN_MCM_D_1E0
        Cfg_D_Tx_BODY_LE1_CAN_MCM_D_1E0_DrvSeatUpperValueRPos: ComNotification=Com_CbkTxAck_Cfg_D_Tx_BODY_LE1_CAN_MCM_D_1E0_DrvSeatUpperValueRPos, ComTimeoutNotification=, ComBitPosition=55, ComBitSize=8, ComFirstTimeout=0, ComHandleId=31, ComSignalInActiveValue=0, DataTimeoutSupport=false, ComTimeout=0, ComSignalType=UINT8, Direction=Tx, InputName=DrvSeatUpperValueRPos, offset=0, factor=1, enumValue=, unitName=, max=255, min=0, compuMethodType=, ComSystemTemplateSystemSignalRef=Cfg_D_Tx_BODY_LE1_CAN_MCM_D_1E0
        Cfg_D_Tx_BODY_LE1_CAN_MCM_D_1E0_DrvPumpSts: ComNotification=Com_CbkTxAck_Cfg_D_Tx_BODY_LE1_CAN_MCM_D_1E0_DrvPumpSts, ComTimeoutNotification=, ComBitPosition=63, ComBitSize=8, ComFirstTimeout=0, ComHandleId=32, ComSignalInActiveValue=0, DataTimeoutSupport=false, ComTimeout=0, ComSignalType=UINT8, Direction=Tx, InputName=DrvPumpSts, offset=0, factor=1, enumValue=, unitName=, max=255, min=0, compuMethodType=, ComSystemTemplateSystemSignalRef=Cfg_D_Tx_BODY_LE1_CAN_MCM_D_1E0
        Cfg_D_Tx_BODY_LE1_CAN_MCM_D_1E1_DrvKneadingMassgSkillsSts9: ComNotification=Com_CbkTxAck_Cfg_D_Tx_BODY_LE1_CAN_MCM_D_1E1_DrvKneadingMassgSkillsSts9, ComTimeoutNotification=, ComBitPosition=11, ComBitSize=4, ComFirstTimeout=0, ComHandleId=33, ComSignalInActiveValue=0, DataTimeoutSupport=false, ComTimeout=0, ComSignalType=UINT8, Direction=Tx, InputName=DrvKneadingMassgSkillsSts9, offset=0, factor=1, enumValue=, unitName=, max=15, min=0, compuMethodType=, ComSystemTemplateSystemSignalRef=Cfg_D_Tx_BODY_LE1_CAN_MCM_D_1E1
        Cfg_D_Tx_BODY_LE1_CAN_MCM_D_1E1_DrvLumControlSts: ComNotification=Com_CbkTxAck_Cfg_D_Tx_BODY_LE1_CAN_MCM_D_1E1_DrvLumControlSts, ComTimeoutNotification=, ComBitPosition=18, ComBitSize=3, ComFirstTimeout=0, ComHandleId=34, ComSignalInActiveValue=0, DataTimeoutSupport=false, ComTimeout=0, ComSignalType=UINT8, Direction=Tx, InputName=DrvLumControlSts, offset=0, factor=1, enumValue=0%No action&1%Manual control&2%Recall&3%System failure&4%Reserved&5%Reserved&6%Reserved&7%Reserved, unitName=, max=7, min=0, compuMethodType=, ComSystemTemplateSystemSignalRef=Cfg_D_Tx_BODY_LE1_CAN_MCM_D_1E1
        Cfg_D_Tx_BODY_LE1_CAN_MCM_D_1E1_DrvLumSwitchSts: ComNotification=Com_CbkTxAck_Cfg_D_Tx_BODY_LE1_CAN_MCM_D_1E1_DrvLumSwitchSts, ComTimeoutNotification=, ComBitPosition=21, ComBitSize=3, ComFirstTimeout=0, ComHandleId=35, ComSignalInActiveValue=0, DataTimeoutSupport=false, ComTimeout=0, ComSignalType=UINT8, Direction=Tx, InputName=DrvLumSwitchSts, offset=0, factor=1, enumValue=0%No Press&1%Forward&2%Reward&3%Up&4%Down&5%Erro, unitName=, max=7, min=0, compuMethodType=, ComSystemTemplateSystemSignalRef=Cfg_D_Tx_BODY_LE1_CAN_MCM_D_1E1
        Cfg_D_Tx_BODY_LE1_CAN_MCM_D_1E1_DrvSystemFailr: ComNotification=Com_CbkTxAck_Cfg_D_Tx_BODY_LE1_CAN_MCM_D_1E1_DrvSystemFailr, ComTimeoutNotification=, ComBitPosition=22, ComBitSize=1, ComFirstTimeout=0, ComHandleId=36, ComSignalInActiveValue=0, DataTimeoutSupport=false, ComTimeout=0, ComSignalType=UINT8, Direction=Tx, InputName=DrvSystemFailr, offset=0, factor=1, enumValue=0%no Failure&1%Failure, unitName=, max=1, min=0, compuMethodType=, ComSystemTemplateSystemSignalRef=Cfg_D_Tx_BODY_LE1_CAN_MCM_D_1E1
        Cfg_D_Tx_BODY_LE1_CAN_MCM_D_1E1_DrvSeatMassFailr: ComNotification=Com_CbkTxAck_Cfg_D_Tx_BODY_LE1_CAN_MCM_D_1E1_DrvSeatMassFailr, ComTimeoutNotification=, ComBitPosition=23, ComBitSize=1, ComFirstTimeout=0, ComHandleId=37, ComSignalInActiveValue=0, DataTimeoutSupport=false, ComTimeout=0, ComSignalType=UINT8, Direction=Tx, InputName=DrvSeatMassFailr, offset=0, factor=1, enumValue=0%no Failure&1%Failure, unitName=, max=1, min=0, compuMethodType=, ComSystemTemplateSystemSignalRef=Cfg_D_Tx_BODY_LE1_CAN_MCM_D_1E1
        Cfg_D_Tx_BODY_LE1_CAN_MCM_D_1E1_DrvSeatCushionValue3Pos: ComNotification=Com_CbkTxAck_Cfg_D_Tx_BODY_LE1_CAN_MCM_D_1E1_DrvSeatCushionValue3Pos, ComTimeoutNotification=, ComBitPosition=31, ComBitSize=8, ComFirstTimeout=0, ComHandleId=38, ComSignalInActiveValue=0, DataTimeoutSupport=false, ComTimeout=0, ComSignalType=UINT8, Direction=Tx, InputName=DrvSeatCushionValue3Pos, offset=0, factor=1, enumValue=, unitName=, max=100, min=0, compuMethodType=, ComSystemTemplateSystemSignalRef=Cfg_D_Tx_BODY_LE1_CAN_MCM_D_1E1
        Cfg_D_Tx_BODY_LE1_CAN_MCM_D_1E1_DrvLumbarTopWorkSts: ComNotification=Com_CbkTxAck_Cfg_D_Tx_BODY_LE1_CAN_MCM_D_1E1_DrvLumbarTopWorkSts, ComTimeoutNotification=, ComBitPosition=33, ComBitSize=2, ComFirstTimeout=0, ComHandleId=39, ComSignalInActiveValue=0, DataTimeoutSupport=false, ComTimeout=0, ComSignalType=UINT8, Direction=Tx, InputName=DrvLumbarTopWorkSts, offset=0, factor=1, enumValue=0%No action&1%Inflation&2%Deflation&3%Idle, unitName=, max=3, min=0, compuMethodType=, ComSystemTemplateSystemSignalRef=Cfg_D_Tx_BODY_LE1_CAN_MCM_D_1E1
        Cfg_D_Tx_BODY_LE1_CAN_MCM_D_1E1_DrvLumbarMidWorkSts: ComNotification=Com_CbkTxAck_Cfg_D_Tx_BODY_LE1_CAN_MCM_D_1E1_DrvLumbarMidWorkSts, ComTimeoutNotification=, ComBitPosition=35, ComBitSize=2, ComFirstTimeout=0, ComHandleId=40, ComSignalInActiveValue=0, DataTimeoutSupport=false, ComTimeout=0, ComSignalType=UINT8, Direction=Tx, InputName=DrvLumbarMidWorkSts, offset=0, factor=1, enumValue=0%No action&1%Inflation&2%Deflation&3%Idle, unitName=, max=3, min=0, compuMethodType=, ComSystemTemplateSystemSignalRef=Cfg_D_Tx_BODY_LE1_CAN_MCM_D_1E1
        Cfg_D_Tx_BODY_LE1_CAN_MCM_D_1E1_DrvLumbarBottomWorkSts: ComNotification=Com_CbkTxAck_Cfg_D_Tx_BODY_LE1_CAN_MCM_D_1E1_DrvLumbarBottomWorkSts, ComTimeoutNotification=, ComBitPosition=37, ComBitSize=2, ComFirstTimeout=0, ComHandleId=41, ComSignalInActiveValue=0, DataTimeoutSupport=false, ComTimeout=0, ComSignalType=UINT8, Direction=Tx, InputName=DrvLumbarBottomWorkSts, offset=0, factor=1, enumValue=0%No action&1%Inflation&2%Deflation&3%Idle, unitName=, max=3, min=0, compuMethodType=, ComSystemTemplateSystemSignalRef=Cfg_D_Tx_BODY_LE1_CAN_MCM_D_1E1
        Cfg_D_Tx_BODY_LE1_CAN_MCM_D_1E1_DrvHeat1Sts: ComNotification=Com_CbkTxAck_Cfg_D_Tx_BODY_LE1_CAN_MCM_D_1E1_DrvHeat1Sts, ComTimeoutNotification=, ComBitPosition=39, ComBitSize=2, ComFirstTimeout=0, ComHandleId=42, ComSignalInActiveValue=0, DataTimeoutSupport=false, ComTimeout=0, ComSignalType=UINT8, Direction=Tx, InputName=DrvHeat1Sts, offset=0, factor=1, enumValue=0%no action&1%action&2%err&3%reserved, unitName=, max=3, min=0, compuMethodType=, ComSystemTemplateSystemSignalRef=Cfg_D_Tx_BODY_LE1_CAN_MCM_D_1E1
        Cfg_D_Tx_BODY_LE1_CAN_MCM_D_1E1_DrvHeat2Sts: ComNotification=Com_CbkTxAck_Cfg_D_Tx_BODY_LE1_CAN_MCM_D_1E1_DrvHeat2Sts, ComTimeoutNotification=, ComBitPosition=41, ComBitSize=2, ComFirstTimeout=0, ComHandleId=43, ComSignalInActiveValue=0, DataTimeoutSupport=false, ComTimeout=0, ComSignalType=UINT8, Direction=Tx, InputName=DrvHeat2Sts, offset=0, factor=1, enumValue=0%no action&1%action&2%err&3%reserved, unitName=, max=3, min=0, compuMethodType=, ComSystemTemplateSystemSignalRef=Cfg_D_Tx_BODY_LE1_CAN_MCM_D_1E1
        Cfg_D_Tx_BODY_LE1_CAN_MCM_D_1E1_DrvHeat3Sts: ComNotification=Com_CbkTxAck_Cfg_D_Tx_BODY_LE1_CAN_MCM_D_1E1_DrvHeat3Sts, ComTimeoutNotification=, ComBitPosition=43, ComBitSize=2, ComFirstTimeout=0, ComHandleId=44, ComSignalInActiveValue=0, DataTimeoutSupport=false, ComTimeout=0, ComSignalType=UINT8, Direction=Tx, InputName=DrvHeat3Sts, offset=0, factor=1, enumValue=0%no action&1%action&2%err&3%reserved, unitName=, max=3, min=0, compuMethodType=, ComSystemTemplateSystemSignalRef=Cfg_D_Tx_BODY_LE1_CAN_MCM_D_1E1
        Cfg_D_Tx_BODY_LE1_CAN_MCM_D_1E1_DrvHeat4Sts: ComNotification=Com_CbkTxAck_Cfg_D_Tx_BODY_LE1_CAN_MCM_D_1E1_DrvHeat4Sts, ComTimeoutNotification=, ComBitPosition=45, ComBitSize=2, ComFirstTimeout=0, ComHandleId=45, ComSignalInActiveValue=0, DataTimeoutSupport=false, ComTimeout=0, ComSignalType=UINT8, Direction=Tx, InputName=DrvHeat4Sts, offset=0, factor=1, enumValue=0%no action&1%action&2%err&3%reserved, unitName=, max=3, min=0, compuMethodType=, ComSystemTemplateSystemSignalRef=Cfg_D_Tx_BODY_LE1_CAN_MCM_D_1E1
        Cfg_D_Tx_BODY_LE1_CAN_MCM_D_1E1_DrvHeat5Sts: ComNotification=Com_CbkTxAck_Cfg_D_Tx_BODY_LE1_CAN_MCM_D_1E1_DrvHeat5Sts, ComTimeoutNotification=, ComBitPosition=47, ComBitSize=2, ComFirstTimeout=0, ComHandleId=46, ComSignalInActiveValue=0, DataTimeoutSupport=false, ComTimeout=0, ComSignalType=UINT8, Direction=Tx, InputName=DrvHeat5Sts, offset=0, factor=1, enumValue=0%no action&1%action&2%err&3%reserved, unitName=, max=3, min=0, compuMethodType=, ComSystemTemplateSystemSignalRef=Cfg_D_Tx_BODY_LE1_CAN_MCM_D_1E1
        Cfg_D_Tx_BODY_LE1_CAN_MCM_D_1E1_DrvHeat6Sts: ComNotification=Com_CbkTxAck_Cfg_D_Tx_BODY_LE1_CAN_MCM_D_1E1_DrvHeat6Sts, ComTimeoutNotification=, ComBitPosition=49, ComBitSize=2, ComFirstTimeout=0, ComHandleId=47, ComSignalInActiveValue=0, DataTimeoutSupport=false, ComTimeout=0, ComSignalType=UINT8, Direction=Tx, InputName=DrvHeat6Sts, offset=0, factor=1, enumValue=0%no action&1%action&2%err&3%reserved, unitName=, max=3, min=0, compuMethodType=, ComSystemTemplateSystemSignalRef=Cfg_D_Tx_BODY_LE1_CAN_MCM_D_1E1
        Cfg_D_Tx_BODY_LE1_CAN_MCM_D_1E1_DrvHeat5ErrSts: ComNotification=Com_CbkTxAck_Cfg_D_Tx_BODY_LE1_CAN_MCM_D_1E1_DrvHeat5ErrSts, ComTimeoutNotification=, ComBitPosition=53, ComBitSize=4, ComFirstTimeout=0, ComHandleId=48, ComSignalInActiveValue=0, DataTimeoutSupport=false, ComTimeout=0, ComSignalType=UINT8, Direction=Tx, InputName=DrvHeat5ErrSts, offset=0, factor=1, enumValue=0%No Error&1%Heater Short to GND&2%Heater short to PWR or Heater Open&3%Sensor short to GND&15%Invalid&4%Sensor short to PWR or Sensor Open&5%Over Current, unitName=, max=15, min=0, compuMethodType=, ComSystemTemplateSystemSignalRef=Cfg_D_Tx_BODY_LE1_CAN_MCM_D_1E1
        Cfg_D_Tx_BODY_LE1_CAN_MCM_D_1E1_DrvKneadingMassglvlSts9: ComNotification=Com_CbkTxAck_Cfg_D_Tx_BODY_LE1_CAN_MCM_D_1E1_DrvKneadingMassglvlSts9, ComTimeoutNotification=, ComBitPosition=55, ComBitSize=2, ComFirstTimeout=0, ComHandleId=49, ComSignalInActiveValue=0, DataTimeoutSupport=false, ComTimeout=0, ComSignalType=UINT8, Direction=Tx, InputName=DrvKneadingMassglvlSts9, offset=0, factor=1, enumValue=0%Idle&1%intensity 1&2%intensity 2, unitName=, max=3, min=0, compuMethodType=, ComSystemTemplateSystemSignalRef=Cfg_D_Tx_BODY_LE1_CAN_MCM_D_1E1
        Cfg_D_Tx_BODY_LE1_CAN_MCM_D_1E1_DrvKneadingMassgTime9: ComNotification=Com_CbkTxAck_Cfg_D_Tx_BODY_LE1_CAN_MCM_D_1E1_DrvKneadingMassgTime9, ComTimeoutNotification=, ComBitPosition=63, ComBitSize=8, ComFirstTimeout=0, ComHandleId=50, ComSignalInActiveValue=0, DataTimeoutSupport=false, ComTimeout=0, ComSignalType=UINT8, Direction=Tx, InputName=DrvKneadingMassgTime9, offset=0, factor=0.1, enumValue=, unitName=, max=25.5, min=0, compuMethodType=INTERNALTOPHYS, ComSystemTemplateSystemSignalRef=Cfg_D_Tx_BODY_LE1_CAN_MCM_D_1E1
        Cfg_D_Tx_BODY_LE1_CAN_MCM_D_1E8_DrvKneadingMassgTime10: ComNotification=Com_CbkTxAck_Cfg_D_Tx_BODY_LE1_CAN_MCM_D_1E8_DrvKneadingMassgTime10, ComTimeoutNotification=, ComBitPosition=7, ComBitSize=8, ComFirstTimeout=0, ComHandleId=51, ComSignalInActiveValue=0, DataTimeoutSupport=false, ComTimeout=0, ComSignalType=UINT8, Direction=Tx, InputName=DrvKneadingMassgTime10, offset=0, factor=0.1, enumValue=, unitName=, max=25.5, min=0, compuMethodType=INTERNALTOPHYS, ComSystemTemplateSystemSignalRef=Cfg_D_Tx_BODY_LE1_CAN_MCM_D_1E8
        Cfg_D_Tx_BODY_LE1_CAN_MCM_D_1E8_DrvKneadingMassgSkillsSts10: ComNotification=Com_CbkTxAck_Cfg_D_Tx_BODY_LE1_CAN_MCM_D_1E8_DrvKneadingMassgSkillsSts10, ComTimeoutNotification=, ComBitPosition=11, ComBitSize=4, ComFirstTimeout=0, ComHandleId=52, ComSignalInActiveValue=0, DataTimeoutSupport=false, ComTimeout=0, ComSignalType=UINT8, Direction=Tx, InputName=DrvKneadingMassgSkillsSts10, offset=0, factor=1, enumValue=, unitName=, max=15, min=0, compuMethodType=, ComSystemTemplateSystemSignalRef=Cfg_D_Tx_BODY_LE1_CAN_MCM_D_1E8
        Cfg_D_Tx_BODY_LE1_CAN_MCM_D_1E8_DrvKneadingMassglvlSts10: ComNotification=Com_CbkTxAck_Cfg_D_Tx_BODY_LE1_CAN_MCM_D_1E8_DrvKneadingMassglvlSts10, ComTimeoutNotification=, ComBitPosition=13, ComBitSize=2, ComFirstTimeout=0, ComHandleId=53, ComSignalInActiveValue=0, DataTimeoutSupport=false, ComTimeout=0, ComSignalType=UINT8, Direction=Tx, InputName=DrvKneadingMassglvlSts10, offset=0, factor=1, enumValue=0%Idle&1%intensity 1&2%intensity 2, unitName=, max=3, min=0, compuMethodType=, ComSystemTemplateSystemSignalRef=Cfg_D_Tx_BODY_LE1_CAN_MCM_D_1E8
        Cfg_D_Tx_BODY_LE1_CAN_MCM_D_1E8_DrvMassageHeatNTC1: ComNotification=Com_CbkTxAck_Cfg_D_Tx_BODY_LE1_CAN_MCM_D_1E8_DrvMassageHeatNTC1, ComTimeoutNotification=, ComBitPosition=23, ComBitSize=8, ComFirstTimeout=0, ComHandleId=54, ComSignalInActiveValue=0, DataTimeoutSupport=false, ComTimeout=0, ComSignalType=UINT8, Direction=Tx, InputName=DrvMassageHeatNTC1, offset=-40, factor=0.5, enumValue=, unitName=degC, max=87.5, min=-40, compuMethodType=INTERNALTOPHYS, ComSystemTemplateSystemSignalRef=Cfg_D_Tx_BODY_LE1_CAN_MCM_D_1E8
        Cfg_D_Tx_BODY_LE1_CAN_MCM_D_1E8_DrvMassageHeatNTC2: ComNotification=Com_CbkTxAck_Cfg_D_Tx_BODY_LE1_CAN_MCM_D_1E8_DrvMassageHeatNTC2, ComTimeoutNotification=, ComBitPosition=31, ComBitSize=8, ComFirstTimeout=0, ComHandleId=55, ComSignalInActiveValue=0, DataTimeoutSupport=false, ComTimeout=0, ComSignalType=UINT8, Direction=Tx, InputName=DrvMassageHeatNTC2, offset=-40, factor=0.5, enumValue=, unitName=degC, max=87.5, min=-40, compuMethodType=INTERNALTOPHYS, ComSystemTemplateSystemSignalRef=Cfg_D_Tx_BODY_LE1_CAN_MCM_D_1E8
        Cfg_D_Tx_BODY_LE1_CAN_MCM_D_1E8_DrvMassageHeatNTC3: ComNotification=Com_CbkTxAck_Cfg_D_Tx_BODY_LE1_CAN_MCM_D_1E8_DrvMassageHeatNTC3, ComTimeoutNotification=, ComBitPosition=39, ComBitSize=8, ComFirstTimeout=0, ComHandleId=56, ComSignalInActiveValue=0, DataTimeoutSupport=false, ComTimeout=0, ComSignalType=UINT8, Direction=Tx, InputName=DrvMassageHeatNTC3, offset=-40, factor=0.5, enumValue=, unitName=degC, max=87.5, min=-40, compuMethodType=INTERNALTOPHYS, ComSystemTemplateSystemSignalRef=Cfg_D_Tx_BODY_LE1_CAN_MCM_D_1E8
        Cfg_D_Tx_BODY_LE1_CAN_MCM_D_1E8_DrvMassageHeatNTC4: ComNotification=Com_CbkTxAck_Cfg_D_Tx_BODY_LE1_CAN_MCM_D_1E8_DrvMassageHeatNTC4, ComTimeoutNotification=, ComBitPosition=47, ComBitSize=8, ComFirstTimeout=0, ComHandleId=57, ComSignalInActiveValue=0, DataTimeoutSupport=false, ComTimeout=0, ComSignalType=UINT8, Direction=Tx, InputName=DrvMassageHeatNTC4, offset=-40, factor=0.5, enumValue=, unitName=degC, max=87.5, min=-40, compuMethodType=INTERNALTOPHYS, ComSystemTemplateSystemSignalRef=Cfg_D_Tx_BODY_LE1_CAN_MCM_D_1E8
        Cfg_D_Tx_BODY_LE1_CAN_MCM_D_1E8_DrvMassageHeatNTC5: ComNotification=Com_CbkTxAck_Cfg_D_Tx_BODY_LE1_CAN_MCM_D_1E8_DrvMassageHeatNTC5, ComTimeoutNotification=, ComBitPosition=55, ComBitSize=8, ComFirstTimeout=0, ComHandleId=58, ComSignalInActiveValue=0, DataTimeoutSupport=false, ComTimeout=0, ComSignalType=UINT8, Direction=Tx, InputName=DrvMassageHeatNTC5, offset=-40, factor=0.5, enumValue=, unitName=degC, max=87.5, min=-40, compuMethodType=INTERNALTOPHYS, ComSystemTemplateSystemSignalRef=Cfg_D_Tx_BODY_LE1_CAN_MCM_D_1E8
        Cfg_D_Tx_BODY_LE1_CAN_MCM_D_1E8_DrvMassageHeatNTC6: ComNotification=Com_CbkTxAck_Cfg_D_Tx_BODY_LE1_CAN_MCM_D_1E8_DrvMassageHeatNTC6, ComTimeoutNotification=, ComBitPosition=63, ComBitSize=8, ComFirstTimeout=0, ComHandleId=59, ComSignalInActiveValue=0, DataTimeoutSupport=false, ComTimeout=0, ComSignalType=UINT8, Direction=Tx, InputName=DrvMassageHeatNTC6, offset=-40, factor=0.5, enumValue=, unitName=degC, max=87.5, min=-40, compuMethodType=INTERNALTOPHYS, ComSystemTemplateSystemSignalRef=Cfg_D_Tx_BODY_LE1_CAN_MCM_D_1E8
        Cfg_D_Tx_BODY_LE1_CAN_MCM_D_1EC_DrvMassageHeatNTC7: ComNotification=Com_CbkTxAck_Cfg_D_Tx_BODY_LE1_CAN_MCM_D_1EC_DrvMassageHeatNTC7, ComTimeoutNotification=, ComBitPosition=23, ComBitSize=8, ComFirstTimeout=0, ComHandleId=60, ComSignalInActiveValue=0, DataTimeoutSupport=false, ComTimeout=0, ComSignalType=UINT8, Direction=Tx, InputName=DrvMassageHeatNTC7, offset=-40, factor=0.5, enumValue=, unitName=degC, max=87.5, min=-40, compuMethodType=INTERNALTOPHYS, ComSystemTemplateSystemSignalRef=Cfg_D_Tx_BODY_LE1_CAN_MCM_D_1EC
        Cfg_D_Tx_BODY_LE1_CAN_MCM_D_1EC_DrvMassageHeatNTC8: ComNotification=Com_CbkTxAck_Cfg_D_Tx_BODY_LE1_CAN_MCM_D_1EC_DrvMassageHeatNTC8, ComTimeoutNotification=, ComBitPosition=31, ComBitSize=8, ComFirstTimeout=0, ComHandleId=61, ComSignalInActiveValue=0, DataTimeoutSupport=false, ComTimeout=0, ComSignalType=UINT8, Direction=Tx, InputName=DrvMassageHeatNTC8, offset=-40, factor=0.5, enumValue=, unitName=degC, max=87.5, min=-40, compuMethodType=INTERNALTOPHYS, ComSystemTemplateSystemSignalRef=Cfg_D_Tx_BODY_LE1_CAN_MCM_D_1EC
        Cfg_D_Tx_BODY_LE1_CAN_MCM_D_1EC_DrvMassageHeatNTC9: ComNotification=Com_CbkTxAck_Cfg_D_Tx_BODY_LE1_CAN_MCM_D_1EC_DrvMassageHeatNTC9, ComTimeoutNotification=, ComBitPosition=39, ComBitSize=8, ComFirstTimeout=0, ComHandleId=62, ComSignalInActiveValue=0, DataTimeoutSupport=false, ComTimeout=0, ComSignalType=UINT8, Direction=Tx, InputName=DrvMassageHeatNTC9, offset=-40, factor=0.5, enumValue=, unitName=degC, max=87.5, min=-40, compuMethodType=INTERNALTOPHYS, ComSystemTemplateSystemSignalRef=Cfg_D_Tx_BODY_LE1_CAN_MCM_D_1EC
        Cfg_D_Tx_BODY_LE1_CAN_MCM_D_1EC_DrvMassageHeatNTC10: ComNotification=Com_CbkTxAck_Cfg_D_Tx_BODY_LE1_CAN_MCM_D_1EC_DrvMassageHeatNTC10, ComTimeoutNotification=, ComBitPosition=47, ComBitSize=8, ComFirstTimeout=0, ComHandleId=63, ComSignalInActiveValue=0, DataTimeoutSupport=false, ComTimeout=0, ComSignalType=UINT8, Direction=Tx, InputName=DrvMassageHeatNTC10, offset=-40, factor=0.5, enumValue=, unitName=degC, max=87.5, min=-40, compuMethodType=INTERNALTOPHYS, ComSystemTemplateSystemSignalRef=Cfg_D_Tx_BODY_LE1_CAN_MCM_D_1EC
        Cfg_D_Tx_BODY_LE1_CAN_MCM_D_1EC_DrvMassageHeatNTC11: ComNotification=Com_CbkTxAck_Cfg_D_Tx_BODY_LE1_CAN_MCM_D_1EC_DrvMassageHeatNTC11, ComTimeoutNotification=, ComBitPosition=55, ComBitSize=8, ComFirstTimeout=0, ComHandleId=64, ComSignalInActiveValue=0, DataTimeoutSupport=false, ComTimeout=0, ComSignalType=UINT8, Direction=Tx, InputName=DrvMassageHeatNTC11, offset=-40, factor=0.5, enumValue=, unitName=degC, max=87.5, min=-40, compuMethodType=INTERNALTOPHYS, ComSystemTemplateSystemSignalRef=Cfg_D_Tx_BODY_LE1_CAN_MCM_D_1EC
        Cfg_D_Tx_BODY_LE1_CAN_MCM_D_1EC_DrvMassageHeatNTC12: ComNotification=Com_CbkTxAck_Cfg_D_Tx_BODY_LE1_CAN_MCM_D_1EC_DrvMassageHeatNTC12, ComTimeoutNotification=, ComBitPosition=63, ComBitSize=8, ComFirstTimeout=0, ComHandleId=65, ComSignalInActiveValue=0, DataTimeoutSupport=false, ComTimeout=0, ComSignalType=UINT8, Direction=Tx, InputName=DrvMassageHeatNTC12, offset=-40, factor=0.5, enumValue=, unitName=degC, max=87.5, min=-40, compuMethodType=INTERNALTOPHYS, ComSystemTemplateSystemSignalRef=Cfg_D_Tx_BODY_LE1_CAN_MCM_D_1EC
        Cfg_D_Rx_BODY_LE1_CAN_BCU_11E_VehSpdSts_Rdnt1: ComNotification=Com_CbkRxAck_Cfg_D_Rx_BODY_LE1_CAN_BCU_11E_VehSpdSts_Rdnt1, ComTimeoutNotification=, ComBitPosition=29, ComBitSize=1, ComFirstTimeout=0, ComHandleId=0, DataTimeoutSupport=false, ComTimeout=0, ComSignalType=UINT8, Direction=Rx, InputName=VehSpdSts_Rdnt1, offset=0, factor=1, enumValue=0%Inalid&1%Valid, unitName=, max=1, min=0, compuMethodType=, ComSystemTemplateSystemSignalRef=Cfg_D_Rx_BODY_LE1_CAN_BCU_11E
        Cfg_D_Rx_BODY_LE1_CAN_BCU_11E_VehSpd_Rdnt1: ComNotification=Com_CbkRxAck_Cfg_D_Rx_BODY_LE1_CAN_BCU_11E_VehSpd_Rdnt1, ComTimeoutNotification=, ComBitPosition=28, ComBitSize=13, ComFirstTimeout=0, ComHandleId=1, DataTimeoutSupport=false, ComTimeout=0, ComSignalType=UINT16, Direction=Rx, InputName=VehSpd_Rdnt1, offset=0, factor=0.05625, enumValue=, unitName=km/h, max=360, min=0, compuMethodType=INTERNALTOPHYS, ComSystemTemplateSystemSignalRef=Cfg_D_Rx_BODY_LE1_CAN_BCU_11E
        Cfg_D_Rx_BODY_LE1_CAN_ZONE_13C_ZONE_13C_CRC: ComNotification=Com_CbkRxAck_Cfg_D_Rx_BODY_LE1_CAN_ZONE_13C_ZONE_13C_CRC, ComTimeoutNotification=Com_CbkRxTOut_Cfg_D_Rx_BODY_LE1_CAN_ZONE_13C_ZONE_13C_CRC, ComBitPosition=7, ComBitSize=8, ComFirstTimeout=500, ComHandleId=2, DataTimeoutSupport=true, ComTimeout=500, ComSignalType=UINT8, Direction=Rx, InputName=ZONE_13C_CRC, offset=0, factor=1, enumValue=, unitName=, max=255, min=0, compuMethodType=, ComSystemTemplateSystemSignalRef=Cfg_D_Rx_BODY_LE1_CAN_ZONE_13C
        Cfg_D_Rx_BODY_LE1_CAN_ZONE_13C_ZONE_13C_MsgCntr: ComNotification=Com_CbkRxAck_Cfg_D_Rx_BODY_LE1_CAN_ZONE_13C_ZONE_13C_MsgCntr, ComTimeoutNotification=Com_CbkRxTOut_Cfg_D_Rx_BODY_LE1_CAN_ZONE_13C_ZONE_13C_MsgCntr, ComBitPosition=11, ComBitSize=4, ComFirstTimeout=500, ComHandleId=3, DataTimeoutSupport=true, ComTimeout=500, ComSignalType=UINT8, Direction=Rx, InputName=ZONE_13C_MsgCntr, offset=0, factor=1, enumValue=, unitName=, max=14, min=0, compuMethodType=, ComSystemTemplateSystemSignalRef=Cfg_D_Rx_BODY_LE1_CAN_ZONE_13C
        Cfg_D_Rx_BODY_LE1_CAN_ZONE_13C_OperatorState_SrvSts: ComNotification=Com_CbkRxAck_Cfg_D_Rx_BODY_LE1_CAN_ZONE_13C_OperatorState_SrvSts, ComTimeoutNotification=Com_CbkRxTOut_Cfg_D_Rx_BODY_LE1_CAN_ZONE_13C_OperatorState_SrvSts, ComBitPosition=12, ComBitSize=1, ComFirstTimeout=500, ComHandleId=4, DataTimeoutSupport=true, ComTimeout=500, ComSignalType=UINT8, Direction=Rx, InputName=OperatorState_SrvSts, offset=0, factor=1, enumValue=0%invalid&1%valid, unitName=, max=1, min=0, compuMethodType=, ComSystemTemplateSystemSignalRef=Cfg_D_Rx_BODY_LE1_CAN_ZONE_13C
        Cfg_D_Rx_BODY_LE1_CAN_ZONE_13C_DrvState_SrvSts: ComNotification=Com_CbkRxAck_Cfg_D_Rx_BODY_LE1_CAN_ZONE_13C_DrvState_SrvSts, ComTimeoutNotification=Com_CbkRxTOut_Cfg_D_Rx_BODY_LE1_CAN_ZONE_13C_DrvState_SrvSts, ComBitPosition=13, ComBitSize=1, ComFirstTimeout=500, ComHandleId=5, DataTimeoutSupport=true, ComTimeout=500, ComSignalType=UINT8, Direction=Rx, InputName=DrvState_SrvSts, offset=0, factor=1, enumValue=0%invalid&1%valid, unitName=, max=1, min=0, compuMethodType=, ComSystemTemplateSystemSignalRef=Cfg_D_Rx_BODY_LE1_CAN_ZONE_13C
        Cfg_D_Rx_BODY_LE1_CAN_ZONE_13C_VehStateDetailed_SrvSts: ComNotification=Com_CbkRxAck_Cfg_D_Rx_BODY_LE1_CAN_ZONE_13C_VehStateDetailed_SrvSts, ComTimeoutNotification=Com_CbkRxTOut_Cfg_D_Rx_BODY_LE1_CAN_ZONE_13C_VehStateDetailed_SrvSts, ComBitPosition=14, ComBitSize=1, ComFirstTimeout=500, ComHandleId=6, DataTimeoutSupport=true, ComTimeout=500, ComSignalType=UINT8, Direction=Rx, InputName=VehStateDetailed_SrvSts, offset=0, factor=1, enumValue=0%invalid&1%valid, unitName=, max=1, min=0, compuMethodType=, ComSystemTemplateSystemSignalRef=Cfg_D_Rx_BODY_LE1_CAN_ZONE_13C
        Cfg_D_Rx_BODY_LE1_CAN_ZONE_13C_DrvState: ComNotification=Com_CbkRxAck_Cfg_D_Rx_BODY_LE1_CAN_ZONE_13C_DrvState, ComTimeoutNotification=Com_CbkRxTOut_Cfg_D_Rx_BODY_LE1_CAN_ZONE_13C_DrvState, ComBitPosition=18, ComBitSize=3, ComFirstTimeout=500, ComHandleId=7, DataTimeoutSupport=true, ComTimeout=500, ComSignalType=UINT8, Direction=Rx, InputName=DrvState, offset=0, factor=1, enumValue=0%DRV_ST_NONE&1%DRV_ST_MD&2%DRV_ST_AD&7%DRV_ST_INVALID, unitName=, max=7, min=0, compuMethodType=, ComSystemTemplateSystemSignalRef=Cfg_D_Rx_BODY_LE1_CAN_ZONE_13C
        Cfg_D_Rx_BODY_LE1_CAN_ZONE_13C_OperatorState: ComNotification=Com_CbkRxAck_Cfg_D_Rx_BODY_LE1_CAN_ZONE_13C_OperatorState, ComTimeoutNotification=Com_CbkRxTOut_Cfg_D_Rx_BODY_LE1_CAN_ZONE_13C_OperatorState, ComBitPosition=21, ComBitSize=3, ComFirstTimeout=500, ComHandleId=8, DataTimeoutSupport=true, ComTimeout=500, ComSignalType=UINT8, Direction=Rx, InputName=OperatorState, offset=0, factor=1, enumValue=0%OPERATOR_ST_NONE&1%OPERATOR_ST_OUTSIDE&2%OPERATOR_ST_AVAILABLE&3%OPERATOR_ST_INSIDE&7%OPERATOR_ST_INVALID, unitName=, max=7, min=0, compuMethodType=, ComSystemTemplateSystemSignalRef=Cfg_D_Rx_BODY_LE1_CAN_ZONE_13C
        Cfg_D_Rx_BODY_LE1_CAN_ZONE_13C_VehStateDetailed: ComNotification=Com_CbkRxAck_Cfg_D_Rx_BODY_LE1_CAN_ZONE_13C_VehStateDetailed, ComTimeoutNotification=Com_CbkRxTOut_Cfg_D_Rx_BODY_LE1_CAN_ZONE_13C_VehStateDetailed, ComBitPosition=27, ComBitSize=4, ComFirstTimeout=500, ComHandleId=9, DataTimeoutSupport=true, ComTimeout=500, ComSignalType=UINT8, Direction=Rx, InputName=VehStateDetailed, offset=0, factor=1, enumValue=0%VEH_ST_PARKED&1%VEH_ST_DRVRDY&2%VEH_ST_DRIVING&3%VEH_ST_SWUPDATE&15%VEH_ST_INVALID&4%VEH_ST_CHARGING&5%VEH_ST_PWRSWAP, unitName=, max=15, min=0, compuMethodType=, ComSystemTemplateSystemSignalRef=Cfg_D_Rx_BODY_LE1_CAN_ZONE_13C
        Cfg_D_Rx_BODY_LE1_CAN_ZONE_13C_VehModeDef: ComNotification=Com_CbkRxAck_Cfg_D_Rx_BODY_LE1_CAN_ZONE_13C_VehModeDef, ComTimeoutNotification=Com_CbkRxTOut_Cfg_D_Rx_BODY_LE1_CAN_ZONE_13C_VehModeDef, ComBitPosition=31, ComBitSize=4, ComFirstTimeout=500, ComHandleId=10, DataTimeoutSupport=true, ComTimeout=500, ComSignalType=UINT8, Direction=Rx, InputName=VehModeDef, offset=0, factor=1, enumValue=0%VEHMODE_RESERVED&1%VEHMODE_PRODUCTION&2%VEHMODE_TRANSPORT&3%VEHMODE_SHOWROOM&15%VEHMODE_INVALID&4%VEHMODE_REGULAR&5%VEHMODE_DUT&6%VEHMODE_TESTDRIVE&7%VEHMODE_MAINTENANCE&8%VEHMODE_SVT&9%VEHMODE_ENDOFLIFE, unitName=, max=15, min=0, compuMethodType=, ComSystemTemplateSystemSignalRef=Cfg_D_Rx_BODY_LE1_CAN_ZONE_13C
        Cfg_D_Rx_BODY_LE1_CAN_ZONE_MCM_05_DrvKneadingMassgSkillsCmd5: ComNotification=Com_CbkRxAck_Cfg_D_Rx_BODY_LE1_CAN_ZONE_MCM_05_DrvKneadingMassgSkillsCmd5, ComTimeoutNotification=, ComBitPosition=3, ComBitSize=4, ComFirstTimeout=0, ComHandleId=11, DataTimeoutSupport=false, ComTimeout=0, ComSignalType=UINT8, Direction=Rx, InputName=DrvKneadingMassgSkillsCmd5, offset=0, factor=1, enumValue=, unitName=, max=15, min=0, compuMethodType=, ComSystemTemplateSystemSignalRef=Cfg_D_Rx_BODY_LE1_CAN_ZONE_MCM_05
        Cfg_D_Rx_BODY_LE1_CAN_ZONE_MCM_05_DrvKneadingMassgTimesCmd5: ComNotification=Com_CbkRxAck_Cfg_D_Rx_BODY_LE1_CAN_ZONE_MCM_05_DrvKneadingMassgTimesCmd5, ComTimeoutNotification=, ComBitPosition=7, ComBitSize=4, ComFirstTimeout=0, ComHandleId=12, DataTimeoutSupport=false, ComTimeout=0, ComSignalType=UINT8, Direction=Rx, InputName=DrvKneadingMassgTimesCmd5, offset=0, factor=1, enumValue=, unitName=, max=15, min=0, compuMethodType=, ComSystemTemplateSystemSignalRef=Cfg_D_Rx_BODY_LE1_CAN_ZONE_MCM_05
        Cfg_D_Rx_BODY_LE1_CAN_ZONE_MCM_05_DrvKneadingMassgLvlCmd5: ComNotification=Com_CbkRxAck_Cfg_D_Rx_BODY_LE1_CAN_ZONE_MCM_05_DrvKneadingMassgLvlCmd5, ComTimeoutNotification=, ComBitPosition=9, ComBitSize=2, ComFirstTimeout=0, ComHandleId=13, DataTimeoutSupport=false, ComTimeout=0, ComSignalType=UINT8, Direction=Rx, InputName=DrvKneadingMassgLvlCmd5, offset=0, factor=1, enumValue=0%Idle&1%intensity 1&2%intensity 2, unitName=, max=3, min=0, compuMethodType=, ComSystemTemplateSystemSignalRef=Cfg_D_Rx_BODY_LE1_CAN_ZONE_MCM_05
        Cfg_D_Rx_BODY_LE1_CAN_ZONE_MCM_05_DrvKneadingMassgLvlCmd6: ComNotification=Com_CbkRxAck_Cfg_D_Rx_BODY_LE1_CAN_ZONE_MCM_05_DrvKneadingMassgLvlCmd6, ComTimeoutNotification=, ComBitPosition=11, ComBitSize=2, ComFirstTimeout=0, ComHandleId=14, DataTimeoutSupport=false, ComTimeout=0, ComSignalType=UINT8, Direction=Rx, InputName=DrvKneadingMassgLvlCmd6, offset=0, factor=1, enumValue=0%Idle&1%intensity 1&2%intensity 2, unitName=, max=3, min=0, compuMethodType=, ComSystemTemplateSystemSignalRef=Cfg_D_Rx_BODY_LE1_CAN_ZONE_MCM_05
        Cfg_D_Rx_BODY_LE1_CAN_ZONE_MCM_05_DrvKneadingMassgLvlCmd7: ComNotification=Com_CbkRxAck_Cfg_D_Rx_BODY_LE1_CAN_ZONE_MCM_05_DrvKneadingMassgLvlCmd7, ComTimeoutNotification=, ComBitPosition=13, ComBitSize=2, ComFirstTimeout=0, ComHandleId=15, DataTimeoutSupport=false, ComTimeout=0, ComSignalType=UINT8, Direction=Rx, InputName=DrvKneadingMassgLvlCmd7, offset=0, factor=1, enumValue=0%Idle&1%intensity 1&2%intensity 2, unitName=, max=3, min=0, compuMethodType=, ComSystemTemplateSystemSignalRef=Cfg_D_Rx_BODY_LE1_CAN_ZONE_MCM_05
        Cfg_D_Rx_BODY_LE1_CAN_ZONE_MCM_05_DrvKneadingMassgLvlCmd8: ComNotification=Com_CbkRxAck_Cfg_D_Rx_BODY_LE1_CAN_ZONE_MCM_05_DrvKneadingMassgLvlCmd8, ComTimeoutNotification=, ComBitPosition=15, ComBitSize=2, ComFirstTimeout=0, ComHandleId=16, DataTimeoutSupport=false, ComTimeout=0, ComSignalType=UINT8, Direction=Rx, InputName=DrvKneadingMassgLvlCmd8, offset=0, factor=1, enumValue=0%Idle&1%intensity 1&2%intensity 2, unitName=, max=3, min=0, compuMethodType=, ComSystemTemplateSystemSignalRef=Cfg_D_Rx_BODY_LE1_CAN_ZONE_MCM_05
        Cfg_D_Rx_BODY_LE1_CAN_ZONE_MCM_05_DrvKneadingMassgSkillsCmd6: ComNotification=Com_CbkRxAck_Cfg_D_Rx_BODY_LE1_CAN_ZONE_MCM_05_DrvKneadingMassgSkillsCmd6, ComTimeoutNotification=, ComBitPosition=19, ComBitSize=4, ComFirstTimeout=0, ComHandleId=17, DataTimeoutSupport=false, ComTimeout=0, ComSignalType=UINT8, Direction=Rx, InputName=DrvKneadingMassgSkillsCmd6, offset=0, factor=1, enumValue=, unitName=, max=15, min=0, compuMethodType=, ComSystemTemplateSystemSignalRef=Cfg_D_Rx_BODY_LE1_CAN_ZONE_MCM_05
        Cfg_D_Rx_BODY_LE1_CAN_ZONE_MCM_05_DrvKneadingMassgTimesCmd6: ComNotification=Com_CbkRxAck_Cfg_D_Rx_BODY_LE1_CAN_ZONE_MCM_05_DrvKneadingMassgTimesCmd6, ComTimeoutNotification=, ComBitPosition=23, ComBitSize=4, ComFirstTimeout=0, ComHandleId=18, DataTimeoutSupport=false, ComTimeout=0, ComSignalType=UINT8, Direction=Rx, InputName=DrvKneadingMassgTimesCmd6, offset=0, factor=1, enumValue=, unitName=, max=15, min=0, compuMethodType=, ComSystemTemplateSystemSignalRef=Cfg_D_Rx_BODY_LE1_CAN_ZONE_MCM_05
        Cfg_D_Rx_BODY_LE1_CAN_ZONE_MCM_05_DrvKneadingMassgSkillsCmd7: ComNotification=Com_CbkRxAck_Cfg_D_Rx_BODY_LE1_CAN_ZONE_MCM_05_DrvKneadingMassgSkillsCmd7, ComTimeoutNotification=, ComBitPosition=27, ComBitSize=4, ComFirstTimeout=0, ComHandleId=19, DataTimeoutSupport=false, ComTimeout=0, ComSignalType=UINT8, Direction=Rx, InputName=DrvKneadingMassgSkillsCmd7, offset=0, factor=1, enumValue=, unitName=, max=15, min=0, compuMethodType=, ComSystemTemplateSystemSignalRef=Cfg_D_Rx_BODY_LE1_CAN_ZONE_MCM_05
        Cfg_D_Rx_BODY_LE1_CAN_ZONE_MCM_05_DrvKneadingMassgTimesCmd7: ComNotification=Com_CbkRxAck_Cfg_D_Rx_BODY_LE1_CAN_ZONE_MCM_05_DrvKneadingMassgTimesCmd7, ComTimeoutNotification=, ComBitPosition=31, ComBitSize=4, ComFirstTimeout=0, ComHandleId=20, DataTimeoutSupport=false, ComTimeout=0, ComSignalType=UINT8, Direction=Rx, InputName=DrvKneadingMassgTimesCmd7, offset=0, factor=1, enumValue=, unitName=, max=15, min=0, compuMethodType=, ComSystemTemplateSystemSignalRef=Cfg_D_Rx_BODY_LE1_CAN_ZONE_MCM_05
        Cfg_D_Rx_BODY_LE1_CAN_ZONE_MCM_05_DrvKneadingMassgSkillsCmd8: ComNotification=Com_CbkRxAck_Cfg_D_Rx_BODY_LE1_CAN_ZONE_MCM_05_DrvKneadingMassgSkillsCmd8, ComTimeoutNotification=, ComBitPosition=35, ComBitSize=4, ComFirstTimeout=0, ComHandleId=21, DataTimeoutSupport=false, ComTimeout=0, ComSignalType=UINT8, Direction=Rx, InputName=DrvKneadingMassgSkillsCmd8, offset=0, factor=1, enumValue=, unitName=, max=15, min=0, compuMethodType=, ComSystemTemplateSystemSignalRef=Cfg_D_Rx_BODY_LE1_CAN_ZONE_MCM_05
        Cfg_D_Rx_BODY_LE1_CAN_ZONE_MCM_05_DrvKneadingMassgTimesCmd8: ComNotification=Com_CbkRxAck_Cfg_D_Rx_BODY_LE1_CAN_ZONE_MCM_05_DrvKneadingMassgTimesCmd8, ComTimeoutNotification=, ComBitPosition=39, ComBitSize=4, ComFirstTimeout=0, ComHandleId=22, DataTimeoutSupport=false, ComTimeout=0, ComSignalType=UINT8, Direction=Rx, InputName=DrvKneadingMassgTimesCmd8, offset=0, factor=1, enumValue=, unitName=, max=15, min=0, compuMethodType=, ComSystemTemplateSystemSignalRef=Cfg_D_Rx_BODY_LE1_CAN_ZONE_MCM_05
        Cfg_D_Rx_BODY_LE1_CAN_ZONE_MCM_05_DrvKneadingMassgSkillsCmd9: ComNotification=Com_CbkRxAck_Cfg_D_Rx_BODY_LE1_CAN_ZONE_MCM_05_DrvKneadingMassgSkillsCmd9, ComTimeoutNotification=, ComBitPosition=43, ComBitSize=4, ComFirstTimeout=0, ComHandleId=23, DataTimeoutSupport=false, ComTimeout=0, ComSignalType=UINT8, Direction=Rx, InputName=DrvKneadingMassgSkillsCmd9, offset=0, factor=1, enumValue=, unitName=, max=15, min=0, compuMethodType=, ComSystemTemplateSystemSignalRef=Cfg_D_Rx_BODY_LE1_CAN_ZONE_MCM_05
        Cfg_D_Rx_BODY_LE1_CAN_ZONE_MCM_05_DrvKneadingMassgTimesCmd9: ComNotification=Com_CbkRxAck_Cfg_D_Rx_BODY_LE1_CAN_ZONE_MCM_05_DrvKneadingMassgTimesCmd9, ComTimeoutNotification=, ComBitPosition=47, ComBitSize=4, ComFirstTimeout=0, ComHandleId=24, DataTimeoutSupport=false, ComTimeout=0, ComSignalType=UINT8, Direction=Rx, InputName=DrvKneadingMassgTimesCmd9, offset=0, factor=1, enumValue=, unitName=, max=15, min=0, compuMethodType=, ComSystemTemplateSystemSignalRef=Cfg_D_Rx_BODY_LE1_CAN_ZONE_MCM_05
        Cfg_D_Rx_BODY_LE1_CAN_ZONE_MCM_05_DrvKneadingMassgLvlCmd9: ComNotification=Com_CbkRxAck_Cfg_D_Rx_BODY_LE1_CAN_ZONE_MCM_05_DrvKneadingMassgLvlCmd9, ComTimeoutNotification=, ComBitPosition=49, ComBitSize=2, ComFirstTimeout=0, ComHandleId=25, DataTimeoutSupport=false, ComTimeout=0, ComSignalType=UINT8, Direction=Rx, InputName=DrvKneadingMassgLvlCmd9, offset=0, factor=1, enumValue=0%Idle&1%intensity 1&2%intensity 2, unitName=, max=3, min=0, compuMethodType=, ComSystemTemplateSystemSignalRef=Cfg_D_Rx_BODY_LE1_CAN_ZONE_MCM_05
        Cfg_D_Rx_BODY_LE1_CAN_ZONE_MCM_05_DrvKneadingMassgLvlCmd10: ComNotification=Com_CbkRxAck_Cfg_D_Rx_BODY_LE1_CAN_ZONE_MCM_05_DrvKneadingMassgLvlCmd10, ComTimeoutNotification=, ComBitPosition=51, ComBitSize=2, ComFirstTimeout=0, ComHandleId=26, DataTimeoutSupport=false, ComTimeout=0, ComSignalType=UINT8, Direction=Rx, InputName=DrvKneadingMassgLvlCmd10, offset=0, factor=1, enumValue=0%Idle&1%intensity 1&2%intensity 2, unitName=, max=3, min=0, compuMethodType=, ComSystemTemplateSystemSignalRef=Cfg_D_Rx_BODY_LE1_CAN_ZONE_MCM_05
        Cfg_D_Rx_BODY_LE1_CAN_ZONE_MCM_05_DrvKneadingMassgTimesCmd10: ComNotification=Com_CbkRxAck_Cfg_D_Rx_BODY_LE1_CAN_ZONE_MCM_05_DrvKneadingMassgTimesCmd10, ComTimeoutNotification=, ComBitPosition=55, ComBitSize=4, ComFirstTimeout=0, ComHandleId=27, DataTimeoutSupport=false, ComTimeout=0, ComSignalType=UINT8, Direction=Rx, InputName=DrvKneadingMassgTimesCmd10, offset=0, factor=1, enumValue=, unitName=, max=15, min=0, compuMethodType=, ComSystemTemplateSystemSignalRef=Cfg_D_Rx_BODY_LE1_CAN_ZONE_MCM_05
        Cfg_D_Rx_BODY_LE1_CAN_ZONE_MCM_05_DrvKneadingMassgSkillsCmd10: ComNotification=Com_CbkRxAck_Cfg_D_Rx_BODY_LE1_CAN_ZONE_MCM_05_DrvKneadingMassgSkillsCmd10, ComTimeoutNotification=, ComBitPosition=59, ComBitSize=4, ComFirstTimeout=0, ComHandleId=28, DataTimeoutSupport=false, ComTimeout=0, ComSignalType=UINT8, Direction=Rx, InputName=DrvKneadingMassgSkillsCmd10, offset=0, factor=1, enumValue=, unitName=, max=15, min=0, compuMethodType=, ComSystemTemplateSystemSignalRef=Cfg_D_Rx_BODY_LE1_CAN_ZONE_MCM_05
        Cfg_D_Rx_BODY_LE1_CAN_ZONE_1C9_DrvHeat1_pct: ComNotification=Com_CbkRxAck_Cfg_D_Rx_BODY_LE1_CAN_ZONE_1C9_DrvHeat1_pct, ComTimeoutNotification=, ComBitPosition=22, ComBitSize=7, ComFirstTimeout=0, ComHandleId=29, DataTimeoutSupport=false, ComTimeout=0, ComSignalType=UINT8, Direction=Rx, InputName=DrvHeat1_pct, offset=0, factor=1, enumValue=, unitName=, max=127, min=0, compuMethodType=, ComSystemTemplateSystemSignalRef=Cfg_D_Rx_BODY_LE1_CAN_ZONE_1C9
        Cfg_D_Rx_BODY_LE1_CAN_ZONE_1C9_DrvHeat2_pct: ComNotification=Com_CbkRxAck_Cfg_D_Rx_BODY_LE1_CAN_ZONE_1C9_DrvHeat2_pct, ComTimeoutNotification=, ComBitPosition=30, ComBitSize=7, ComFirstTimeout=0, ComHandleId=30, DataTimeoutSupport=false, ComTimeout=0, ComSignalType=UINT8, Direction=Rx, InputName=DrvHeat2_pct, offset=0, factor=1, enumValue=, unitName=, max=127, min=0, compuMethodType=, ComSystemTemplateSystemSignalRef=Cfg_D_Rx_BODY_LE1_CAN_ZONE_1C9
        Cfg_D_Rx_BODY_LE1_CAN_ZONE_1C9_DrvHeat3_pct: ComNotification=Com_CbkRxAck_Cfg_D_Rx_BODY_LE1_CAN_ZONE_1C9_DrvHeat3_pct, ComTimeoutNotification=, ComBitPosition=38, ComBitSize=7, ComFirstTimeout=0, ComHandleId=31, DataTimeoutSupport=false, ComTimeout=0, ComSignalType=UINT8, Direction=Rx, InputName=DrvHeat3_pct, offset=0, factor=1, enumValue=, unitName=, max=127, min=0, compuMethodType=, ComSystemTemplateSystemSignalRef=Cfg_D_Rx_BODY_LE1_CAN_ZONE_1C9
        Cfg_D_Rx_BODY_LE1_CAN_ZONE_1C9_DrvHeat4_pct: ComNotification=Com_CbkRxAck_Cfg_D_Rx_BODY_LE1_CAN_ZONE_1C9_DrvHeat4_pct, ComTimeoutNotification=, ComBitPosition=46, ComBitSize=7, ComFirstTimeout=0, ComHandleId=32, DataTimeoutSupport=false, ComTimeout=0, ComSignalType=UINT8, Direction=Rx, InputName=DrvHeat4_pct, offset=0, factor=1, enumValue=, unitName=, max=127, min=0, compuMethodType=, ComSystemTemplateSystemSignalRef=Cfg_D_Rx_BODY_LE1_CAN_ZONE_1C9
        Cfg_D_Rx_BODY_LE1_CAN_ZONE_1C9_DrvHeat5_pct: ComNotification=Com_CbkRxAck_Cfg_D_Rx_BODY_LE1_CAN_ZONE_1C9_DrvHeat5_pct, ComTimeoutNotification=, ComBitPosition=54, ComBitSize=7, ComFirstTimeout=0, ComHandleId=33, DataTimeoutSupport=false, ComTimeout=0, ComSignalType=UINT8, Direction=Rx, InputName=DrvHeat5_pct, offset=0, factor=1, enumValue=, unitName=, max=127, min=0, compuMethodType=, ComSystemTemplateSystemSignalRef=Cfg_D_Rx_BODY_LE1_CAN_ZONE_1C9
        Cfg_D_Rx_BODY_LE1_CAN_ZONE_1C9_DrvHeat6_pct: ComNotification=Com_CbkRxAck_Cfg_D_Rx_BODY_LE1_CAN_ZONE_1C9_DrvHeat6_pct, ComTimeoutNotification=, ComBitPosition=62, ComBitSize=7, ComFirstTimeout=0, ComHandleId=34, DataTimeoutSupport=false, ComTimeout=0, ComSignalType=UINT8, Direction=Rx, InputName=DrvHeat6_pct, offset=0, factor=1, enumValue=, unitName=, max=127, min=0, compuMethodType=, ComSystemTemplateSystemSignalRef=Cfg_D_Rx_BODY_LE1_CAN_ZONE_1C9
        Cfg_D_Rx_BODY_LE1_CAN_Zone_FL_MCM_01_DrvSeatmassgValve1Cmd: ComNotification=Com_CbkRxAck_Cfg_D_Rx_BODY_LE1_CAN_Zone_FL_MCM_01_DrvSeatmassgValve1Cmd, ComTimeoutNotification=Com_CbkRxTOut_Cfg_D_Rx_BODY_LE1_CAN_Zone_FL_MCM_01_DrvSeatmassgValve1Cmd, ComBitPosition=1, ComBitSize=2, ComFirstTimeout=500, ComHandleId=35, DataTimeoutSupport=true, ComTimeout=500, ComSignalType=UINT8, Direction=Rx, InputName=DrvSeatmassgValve1Cmd, offset=0, factor=1, enumValue=0%No action&1%Inflation&2%Deflation&3%Reserved, unitName=, max=3, min=0, compuMethodType=, ComSystemTemplateSystemSignalRef=Cfg_D_Rx_BODY_LE1_CAN_Zone_FL_MCM_01
        Cfg_D_Rx_BODY_LE1_CAN_Zone_FL_MCM_01_DrvSeatmassgValve2Cmd: ComNotification=Com_CbkRxAck_Cfg_D_Rx_BODY_LE1_CAN_Zone_FL_MCM_01_DrvSeatmassgValve2Cmd, ComTimeoutNotification=Com_CbkRxTOut_Cfg_D_Rx_BODY_LE1_CAN_Zone_FL_MCM_01_DrvSeatmassgValve2Cmd, ComBitPosition=3, ComBitSize=2, ComFirstTimeout=500, ComHandleId=36, DataTimeoutSupport=true, ComTimeout=500, ComSignalType=UINT8, Direction=Rx, InputName=DrvSeatmassgValve2Cmd, offset=0, factor=1, enumValue=0%No action&1%Inflation&2%Deflation&3%Reserved, unitName=, max=3, min=0, compuMethodType=, ComSystemTemplateSystemSignalRef=Cfg_D_Rx_BODY_LE1_CAN_Zone_FL_MCM_01
        Cfg_D_Rx_BODY_LE1_CAN_Zone_FL_MCM_01_DrvSeatmassgValve3Cmd: ComNotification=Com_CbkRxAck_Cfg_D_Rx_BODY_LE1_CAN_Zone_FL_MCM_01_DrvSeatmassgValve3Cmd, ComTimeoutNotification=Com_CbkRxTOut_Cfg_D_Rx_BODY_LE1_CAN_Zone_FL_MCM_01_DrvSeatmassgValve3Cmd, ComBitPosition=5, ComBitSize=2, ComFirstTimeout=500, ComHandleId=37, DataTimeoutSupport=true, ComTimeout=500, ComSignalType=UINT8, Direction=Rx, InputName=DrvSeatmassgValve3Cmd, offset=0, factor=1, enumValue=0%No action&1%Inflation&2%Deflation&3%Reserved, unitName=, max=3, min=0, compuMethodType=, ComSystemTemplateSystemSignalRef=Cfg_D_Rx_BODY_LE1_CAN_Zone_FL_MCM_01
        Cfg_D_Rx_BODY_LE1_CAN_Zone_FL_MCM_01_DrvSeatmassgValve4Cmd: ComNotification=Com_CbkRxAck_Cfg_D_Rx_BODY_LE1_CAN_Zone_FL_MCM_01_DrvSeatmassgValve4Cmd, ComTimeoutNotification=Com_CbkRxTOut_Cfg_D_Rx_BODY_LE1_CAN_Zone_FL_MCM_01_DrvSeatmassgValve4Cmd, ComBitPosition=7, ComBitSize=2, ComFirstTimeout=500, ComHandleId=38, DataTimeoutSupport=true, ComTimeout=500, ComSignalType=UINT8, Direction=Rx, InputName=DrvSeatmassgValve4Cmd, offset=0, factor=1, enumValue=0%No action&1%Inflation&2%Deflation&3%Reserved, unitName=, max=3, min=0, compuMethodType=, ComSystemTemplateSystemSignalRef=Cfg_D_Rx_BODY_LE1_CAN_Zone_FL_MCM_01
        Cfg_D_Rx_BODY_LE1_CAN_Zone_FL_MCM_01_DrvSeatmassgValve5Cmd: ComNotification=Com_CbkRxAck_Cfg_D_Rx_BODY_LE1_CAN_Zone_FL_MCM_01_DrvSeatmassgValve5Cmd, ComTimeoutNotification=Com_CbkRxTOut_Cfg_D_Rx_BODY_LE1_CAN_Zone_FL_MCM_01_DrvSeatmassgValve5Cmd, ComBitPosition=9, ComBitSize=2, ComFirstTimeout=500, ComHandleId=39, DataTimeoutSupport=true, ComTimeout=500, ComSignalType=UINT8, Direction=Rx, InputName=DrvSeatmassgValve5Cmd, offset=0, factor=1, enumValue=0%No action&1%Inflation&2%Deflation&3%Reserved, unitName=, max=3, min=0, compuMethodType=, ComSystemTemplateSystemSignalRef=Cfg_D_Rx_BODY_LE1_CAN_Zone_FL_MCM_01
        Cfg_D_Rx_BODY_LE1_CAN_Zone_FL_MCM_01_DrvSeatmassgValve6Cmd: ComNotification=Com_CbkRxAck_Cfg_D_Rx_BODY_LE1_CAN_Zone_FL_MCM_01_DrvSeatmassgValve6Cmd, ComTimeoutNotification=Com_CbkRxTOut_Cfg_D_Rx_BODY_LE1_CAN_Zone_FL_MCM_01_DrvSeatmassgValve6Cmd, ComBitPosition=11, ComBitSize=2, ComFirstTimeout=500, ComHandleId=40, DataTimeoutSupport=true, ComTimeout=500, ComSignalType=UINT8, Direction=Rx, InputName=DrvSeatmassgValve6Cmd, offset=0, factor=1, enumValue=0%No action&1%Inflation&2%Deflation&3%Reserved, unitName=, max=3, min=0, compuMethodType=, ComSystemTemplateSystemSignalRef=Cfg_D_Rx_BODY_LE1_CAN_Zone_FL_MCM_01
        Cfg_D_Rx_BODY_LE1_CAN_Zone_FL_MCM_01_DrvSeatmassgValve7Cmd: ComNotification=Com_CbkRxAck_Cfg_D_Rx_BODY_LE1_CAN_Zone_FL_MCM_01_DrvSeatmassgValve7Cmd, ComTimeoutNotification=Com_CbkRxTOut_Cfg_D_Rx_BODY_LE1_CAN_Zone_FL_MCM_01_DrvSeatmassgValve7Cmd, ComBitPosition=13, ComBitSize=2, ComFirstTimeout=500, ComHandleId=41, DataTimeoutSupport=true, ComTimeout=500, ComSignalType=UINT8, Direction=Rx, InputName=DrvSeatmassgValve7Cmd, offset=0, factor=1, enumValue=0%No action&1%Inflation&2%Deflation&3%Reserved, unitName=, max=3, min=0, compuMethodType=, ComSystemTemplateSystemSignalRef=Cfg_D_Rx_BODY_LE1_CAN_Zone_FL_MCM_01
        Cfg_D_Rx_BODY_LE1_CAN_Zone_FL_MCM_01_DrvSeatmassgValve8Cmd: ComNotification=Com_CbkRxAck_Cfg_D_Rx_BODY_LE1_CAN_Zone_FL_MCM_01_DrvSeatmassgValve8Cmd, ComTimeoutNotification=Com_CbkRxTOut_Cfg_D_Rx_BODY_LE1_CAN_Zone_FL_MCM_01_DrvSeatmassgValve8Cmd, ComBitPosition=15, ComBitSize=2, ComFirstTimeout=500, ComHandleId=42, DataTimeoutSupport=true, ComTimeout=500, ComSignalType=UINT8, Direction=Rx, InputName=DrvSeatmassgValve8Cmd, offset=0, factor=1, enumValue=0%No action&1%Inflation&2%Deflation&3%Reserved, unitName=, max=3, min=0, compuMethodType=, ComSystemTemplateSystemSignalRef=Cfg_D_Rx_BODY_LE1_CAN_Zone_FL_MCM_01
        Cfg_D_Rx_BODY_LE1_CAN_Zone_FL_MCM_01_DrvSeatmassgValve9Cmd: ComNotification=Com_CbkRxAck_Cfg_D_Rx_BODY_LE1_CAN_Zone_FL_MCM_01_DrvSeatmassgValve9Cmd, ComTimeoutNotification=Com_CbkRxTOut_Cfg_D_Rx_BODY_LE1_CAN_Zone_FL_MCM_01_DrvSeatmassgValve9Cmd, ComBitPosition=17, ComBitSize=2, ComFirstTimeout=500, ComHandleId=43, DataTimeoutSupport=true, ComTimeout=500, ComSignalType=UINT8, Direction=Rx, InputName=DrvSeatmassgValve9Cmd, offset=0, factor=1, enumValue=0%No action&1%Inflation&2%Deflation&3%Reserved, unitName=, max=3, min=0, compuMethodType=, ComSystemTemplateSystemSignalRef=Cfg_D_Rx_BODY_LE1_CAN_Zone_FL_MCM_01
        Cfg_D_Rx_BODY_LE1_CAN_Zone_FL_MCM_01_DrvSeatmassgValve10Cmd: ComNotification=Com_CbkRxAck_Cfg_D_Rx_BODY_LE1_CAN_Zone_FL_MCM_01_DrvSeatmassgValve10Cmd, ComTimeoutNotification=Com_CbkRxTOut_Cfg_D_Rx_BODY_LE1_CAN_Zone_FL_MCM_01_DrvSeatmassgValve10Cmd, ComBitPosition=19, ComBitSize=2, ComFirstTimeout=500, ComHandleId=44, DataTimeoutSupport=true, ComTimeout=500, ComSignalType=UINT8, Direction=Rx, InputName=DrvSeatmassgValve10Cmd, offset=0, factor=1, enumValue=0%No action&1%Inflation&2%Deflation&3%Reserved, unitName=, max=3, min=0, compuMethodType=, ComSystemTemplateSystemSignalRef=Cfg_D_Rx_BODY_LE1_CAN_Zone_FL_MCM_01
        Cfg_D_Rx_BODY_LE1_CAN_Zone_FL_MCM_01_DrvSeatmassgValve11Cmd: ComNotification=Com_CbkRxAck_Cfg_D_Rx_BODY_LE1_CAN_Zone_FL_MCM_01_DrvSeatmassgValve11Cmd, ComTimeoutNotification=Com_CbkRxTOut_Cfg_D_Rx_BODY_LE1_CAN_Zone_FL_MCM_01_DrvSeatmassgValve11Cmd, ComBitPosition=21, ComBitSize=2, ComFirstTimeout=500, ComHandleId=45, DataTimeoutSupport=true, ComTimeout=500, ComSignalType=UINT8, Direction=Rx, InputName=DrvSeatmassgValve11Cmd, offset=0, factor=1, enumValue=0%No action&1%Inflation&2%Deflation&3%Reserved, unitName=, max=3, min=0, compuMethodType=, ComSystemTemplateSystemSignalRef=Cfg_D_Rx_BODY_LE1_CAN_Zone_FL_MCM_01
        Cfg_D_Rx_BODY_LE1_CAN_Zone_FL_MCM_01_DrvSeatmassgValve12Cmd: ComNotification=Com_CbkRxAck_Cfg_D_Rx_BODY_LE1_CAN_Zone_FL_MCM_01_DrvSeatmassgValve12Cmd, ComTimeoutNotification=Com_CbkRxTOut_Cfg_D_Rx_BODY_LE1_CAN_Zone_FL_MCM_01_DrvSeatmassgValve12Cmd, ComBitPosition=23, ComBitSize=2, ComFirstTimeout=500, ComHandleId=46, DataTimeoutSupport=true, ComTimeout=500, ComSignalType=UINT8, Direction=Rx, InputName=DrvSeatmassgValve12Cmd, offset=0, factor=1, enumValue=0%No action&1%Inflation&2%Deflation&3%Reserved, unitName=, max=3, min=0, compuMethodType=, ComSystemTemplateSystemSignalRef=Cfg_D_Rx_BODY_LE1_CAN_Zone_FL_MCM_01
        Cfg_D_Rx_BODY_LE1_CAN_Zone_FL_MCM_01_DrvSeatmassgHeat1Cmd: ComNotification=Com_CbkRxAck_Cfg_D_Rx_BODY_LE1_CAN_Zone_FL_MCM_01_DrvSeatmassgHeat1Cmd, ComTimeoutNotification=Com_CbkRxTOut_Cfg_D_Rx_BODY_LE1_CAN_Zone_FL_MCM_01_DrvSeatmassgHeat1Cmd, ComBitPosition=25, ComBitSize=2, ComFirstTimeout=500, ComHandleId=47, DataTimeoutSupport=true, ComTimeout=500, ComSignalType=UINT8, Direction=Rx, InputName=DrvSeatmassgHeat1Cmd, offset=0, factor=1, enumValue=0%No action&1%Heat open&2%Heat Close&3%Reserved, unitName=, max=3, min=0, compuMethodType=, ComSystemTemplateSystemSignalRef=Cfg_D_Rx_BODY_LE1_CAN_Zone_FL_MCM_01
        Cfg_D_Rx_BODY_LE1_CAN_Zone_FL_MCM_01_DrvSeatmassgHeat2Cmd: ComNotification=Com_CbkRxAck_Cfg_D_Rx_BODY_LE1_CAN_Zone_FL_MCM_01_DrvSeatmassgHeat2Cmd, ComTimeoutNotification=Com_CbkRxTOut_Cfg_D_Rx_BODY_LE1_CAN_Zone_FL_MCM_01_DrvSeatmassgHeat2Cmd, ComBitPosition=27, ComBitSize=2, ComFirstTimeout=500, ComHandleId=48, DataTimeoutSupport=true, ComTimeout=500, ComSignalType=UINT8, Direction=Rx, InputName=DrvSeatmassgHeat2Cmd, offset=0, factor=1, enumValue=0%No action&1%Heat open&2%Heat Close&3%Reserved, unitName=, max=3, min=0, compuMethodType=, ComSystemTemplateSystemSignalRef=Cfg_D_Rx_BODY_LE1_CAN_Zone_FL_MCM_01
        Cfg_D_Rx_BODY_LE1_CAN_Zone_FL_MCM_01_DrvSeatmassgHeat3Cmd: ComNotification=Com_CbkRxAck_Cfg_D_Rx_BODY_LE1_CAN_Zone_FL_MCM_01_DrvSeatmassgHeat3Cmd, ComTimeoutNotification=Com_CbkRxTOut_Cfg_D_Rx_BODY_LE1_CAN_Zone_FL_MCM_01_DrvSeatmassgHeat3Cmd, ComBitPosition=29, ComBitSize=2, ComFirstTimeout=500, ComHandleId=49, DataTimeoutSupport=true, ComTimeout=500, ComSignalType=UINT8, Direction=Rx, InputName=DrvSeatmassgHeat3Cmd, offset=0, factor=1, enumValue=0%No action&1%Heat open&2%Heat Close&3%Reserved, unitName=, max=3, min=0, compuMethodType=, ComSystemTemplateSystemSignalRef=Cfg_D_Rx_BODY_LE1_CAN_Zone_FL_MCM_01
        Cfg_D_Rx_BODY_LE1_CAN_Zone_FL_MCM_01_DrvSeatmassgHeat4Cmd: ComNotification=Com_CbkRxAck_Cfg_D_Rx_BODY_LE1_CAN_Zone_FL_MCM_01_DrvSeatmassgHeat4Cmd, ComTimeoutNotification=Com_CbkRxTOut_Cfg_D_Rx_BODY_LE1_CAN_Zone_FL_MCM_01_DrvSeatmassgHeat4Cmd, ComBitPosition=31, ComBitSize=2, ComFirstTimeout=500, ComHandleId=50, DataTimeoutSupport=true, ComTimeout=500, ComSignalType=UINT8, Direction=Rx, InputName=DrvSeatmassgHeat4Cmd, offset=0, factor=1, enumValue=0%No action&1%Heat open&2%Heat Close&3%Reserved, unitName=, max=3, min=0, compuMethodType=, ComSystemTemplateSystemSignalRef=Cfg_D_Rx_BODY_LE1_CAN_Zone_FL_MCM_01
        Cfg_D_Rx_BODY_LE1_CAN_Zone_FL_MCM_01_DrvSeatmassgHeat5Cmd: ComNotification=Com_CbkRxAck_Cfg_D_Rx_BODY_LE1_CAN_Zone_FL_MCM_01_DrvSeatmassgHeat5Cmd, ComTimeoutNotification=Com_CbkRxTOut_Cfg_D_Rx_BODY_LE1_CAN_Zone_FL_MCM_01_DrvSeatmassgHeat5Cmd, ComBitPosition=33, ComBitSize=2, ComFirstTimeout=500, ComHandleId=51, DataTimeoutSupport=true, ComTimeout=500, ComSignalType=UINT8, Direction=Rx, InputName=DrvSeatmassgHeat5Cmd, offset=0, factor=1, enumValue=0%No action&1%Heat open&2%Heat Close&3%Reserved, unitName=, max=3, min=0, compuMethodType=, ComSystemTemplateSystemSignalRef=Cfg_D_Rx_BODY_LE1_CAN_Zone_FL_MCM_01
        Cfg_D_Rx_BODY_LE1_CAN_Zone_FL_MCM_01_DrvSeatmassgHeat6Cmd: ComNotification=Com_CbkRxAck_Cfg_D_Rx_BODY_LE1_CAN_Zone_FL_MCM_01_DrvSeatmassgHeat6Cmd, ComTimeoutNotification=Com_CbkRxTOut_Cfg_D_Rx_BODY_LE1_CAN_Zone_FL_MCM_01_DrvSeatmassgHeat6Cmd, ComBitPosition=35, ComBitSize=2, ComFirstTimeout=500, ComHandleId=52, DataTimeoutSupport=true, ComTimeout=500, ComSignalType=UINT8, Direction=Rx, InputName=DrvSeatmassgHeat6Cmd, offset=0, factor=1, enumValue=0%No action&1%Heat open&2%Heat Close&3%Reserved, unitName=, max=3, min=0, compuMethodType=, ComSystemTemplateSystemSignalRef=Cfg_D_Rx_BODY_LE1_CAN_Zone_FL_MCM_01
        Cfg_D_Rx_BODY_LE1_CAN_Zone_FL_MCM_01_DrvSeatmassgHeat7Cmd: ComNotification=Com_CbkRxAck_Cfg_D_Rx_BODY_LE1_CAN_Zone_FL_MCM_01_DrvSeatmassgHeat7Cmd, ComTimeoutNotification=Com_CbkRxTOut_Cfg_D_Rx_BODY_LE1_CAN_Zone_FL_MCM_01_DrvSeatmassgHeat7Cmd, ComBitPosition=37, ComBitSize=2, ComFirstTimeout=500, ComHandleId=53, DataTimeoutSupport=true, ComTimeout=500, ComSignalType=UINT8, Direction=Rx, InputName=DrvSeatmassgHeat7Cmd, offset=0, factor=1, enumValue=0%No action&1%Heat open&2%Heat Close&3%Reserved, unitName=, max=3, min=0, compuMethodType=, ComSystemTemplateSystemSignalRef=Cfg_D_Rx_BODY_LE1_CAN_Zone_FL_MCM_01
        Cfg_D_Rx_BODY_LE1_CAN_Zone_FL_MCM_01_DrvSeatmassgHeat8Cmd: ComNotification=Com_CbkRxAck_Cfg_D_Rx_BODY_LE1_CAN_Zone_FL_MCM_01_DrvSeatmassgHeat8Cmd, ComTimeoutNotification=Com_CbkRxTOut_Cfg_D_Rx_BODY_LE1_CAN_Zone_FL_MCM_01_DrvSeatmassgHeat8Cmd, ComBitPosition=39, ComBitSize=2, ComFirstTimeout=500, ComHandleId=54, DataTimeoutSupport=true, ComTimeout=500, ComSignalType=UINT8, Direction=Rx, InputName=DrvSeatmassgHeat8Cmd, offset=0, factor=1, enumValue=0%No action&1%Heat open&2%Heat Close&3%Reserved, unitName=, max=3, min=0, compuMethodType=, ComSystemTemplateSystemSignalRef=Cfg_D_Rx_BODY_LE1_CAN_Zone_FL_MCM_01
        Cfg_D_Rx_BODY_LE1_CAN_Zone_FL_MCM_01_DrvSeatmassgHeat9Cmd: ComNotification=Com_CbkRxAck_Cfg_D_Rx_BODY_LE1_CAN_Zone_FL_MCM_01_DrvSeatmassgHeat9Cmd, ComTimeoutNotification=Com_CbkRxTOut_Cfg_D_Rx_BODY_LE1_CAN_Zone_FL_MCM_01_DrvSeatmassgHeat9Cmd, ComBitPosition=41, ComBitSize=2, ComFirstTimeout=500, ComHandleId=55, DataTimeoutSupport=true, ComTimeout=500, ComSignalType=UINT8, Direction=Rx, InputName=DrvSeatmassgHeat9Cmd, offset=0, factor=1, enumValue=0%No action&1%Heat open&2%Heat Close&3%Reserved, unitName=, max=3, min=0, compuMethodType=, ComSystemTemplateSystemSignalRef=Cfg_D_Rx_BODY_LE1_CAN_Zone_FL_MCM_01
        Cfg_D_Rx_BODY_LE1_CAN_Zone_FL_MCM_01_DrvSeatmassgHeat10Cmd: ComNotification=Com_CbkRxAck_Cfg_D_Rx_BODY_LE1_CAN_Zone_FL_MCM_01_DrvSeatmassgHeat10Cmd, ComTimeoutNotification=Com_CbkRxTOut_Cfg_D_Rx_BODY_LE1_CAN_Zone_FL_MCM_01_DrvSeatmassgHeat10Cmd, ComBitPosition=43, ComBitSize=2, ComFirstTimeout=500, ComHandleId=56, DataTimeoutSupport=true, ComTimeout=500, ComSignalType=UINT8, Direction=Rx, InputName=DrvSeatmassgHeat10Cmd, offset=0, factor=1, enumValue=0%No action&1%Heat open&2%Heat Close&3%Reserved, unitName=, max=3, min=0, compuMethodType=, ComSystemTemplateSystemSignalRef=Cfg_D_Rx_BODY_LE1_CAN_Zone_FL_MCM_01
        Cfg_D_Rx_BODY_LE1_CAN_Zone_FL_MCM_01_DrvSeatmassgHeat11Cmd: ComNotification=Com_CbkRxAck_Cfg_D_Rx_BODY_LE1_CAN_Zone_FL_MCM_01_DrvSeatmassgHeat11Cmd, ComTimeoutNotification=Com_CbkRxTOut_Cfg_D_Rx_BODY_LE1_CAN_Zone_FL_MCM_01_DrvSeatmassgHeat11Cmd, ComBitPosition=45, ComBitSize=2, ComFirstTimeout=500, ComHandleId=57, DataTimeoutSupport=true, ComTimeout=500, ComSignalType=UINT8, Direction=Rx, InputName=DrvSeatmassgHeat11Cmd, offset=0, factor=1, enumValue=0%No action&1%Heat open&2%Heat Close&3%Reserved, unitName=, max=3, min=0, compuMethodType=, ComSystemTemplateSystemSignalRef=Cfg_D_Rx_BODY_LE1_CAN_Zone_FL_MCM_01
        Cfg_D_Rx_BODY_LE1_CAN_Zone_FL_MCM_01_DrvSeatmassgHeat12Cmd: ComNotification=Com_CbkRxAck_Cfg_D_Rx_BODY_LE1_CAN_Zone_FL_MCM_01_DrvSeatmassgHeat12Cmd, ComTimeoutNotification=Com_CbkRxTOut_Cfg_D_Rx_BODY_LE1_CAN_Zone_FL_MCM_01_DrvSeatmassgHeat12Cmd, ComBitPosition=47, ComBitSize=2, ComFirstTimeout=500, ComHandleId=58, DataTimeoutSupport=true, ComTimeout=500, ComSignalType=UINT8, Direction=Rx, InputName=DrvSeatmassgHeat12Cmd, offset=0, factor=1, enumValue=0%No action&1%Heat open&2%Heat Close&3%Reserved, unitName=, max=3, min=0, compuMethodType=, ComSystemTemplateSystemSignalRef=Cfg_D_Rx_BODY_LE1_CAN_Zone_FL_MCM_01
        Cfg_D_Rx_BODY_LE1_CAN_Zone_FL_MCM_01_DrvSeatLumbarTopValue1Cmd: ComNotification=Com_CbkRxAck_Cfg_D_Rx_BODY_LE1_CAN_Zone_FL_MCM_01_DrvSeatLumbarTopValue1Cmd, ComTimeoutNotification=Com_CbkRxTOut_Cfg_D_Rx_BODY_LE1_CAN_Zone_FL_MCM_01_DrvSeatLumbarTopValue1Cmd, ComBitPosition=49, ComBitSize=2, ComFirstTimeout=500, ComHandleId=59, DataTimeoutSupport=true, ComTimeout=500, ComSignalType=UINT8, Direction=Rx, InputName=DrvSeatLumbarTopValue1Cmd, offset=0, factor=1, enumValue=0%No action&1%Inflation&2%Deflation&3%Reserved, unitName=, max=3, min=0, compuMethodType=, ComSystemTemplateSystemSignalRef=Cfg_D_Rx_BODY_LE1_CAN_Zone_FL_MCM_01
        Cfg_D_Rx_BODY_LE1_CAN_Zone_FL_MCM_01_DrvSeatLumbarMidValue2Cmd: ComNotification=Com_CbkRxAck_Cfg_D_Rx_BODY_LE1_CAN_Zone_FL_MCM_01_DrvSeatLumbarMidValue2Cmd, ComTimeoutNotification=Com_CbkRxTOut_Cfg_D_Rx_BODY_LE1_CAN_Zone_FL_MCM_01_DrvSeatLumbarMidValue2Cmd, ComBitPosition=51, ComBitSize=2, ComFirstTimeout=500, ComHandleId=60, DataTimeoutSupport=true, ComTimeout=500, ComSignalType=UINT8, Direction=Rx, InputName=DrvSeatLumbarMidValue2Cmd, offset=0, factor=1, enumValue=0%No action&1%Inflation&2%Deflation&3%Reserved, unitName=, max=3, min=0, compuMethodType=, ComSystemTemplateSystemSignalRef=Cfg_D_Rx_BODY_LE1_CAN_Zone_FL_MCM_01
        Cfg_D_Rx_BODY_LE1_CAN_Zone_FL_MCM_01_DrvSeatLumbarBottomValue3Cmd: ComNotification=Com_CbkRxAck_Cfg_D_Rx_BODY_LE1_CAN_Zone_FL_MCM_01_DrvSeatLumbarBottomValue3Cmd, ComTimeoutNotification=Com_CbkRxTOut_Cfg_D_Rx_BODY_LE1_CAN_Zone_FL_MCM_01_DrvSeatLumbarBottomValue3Cmd, ComBitPosition=53, ComBitSize=2, ComFirstTimeout=500, ComHandleId=61, DataTimeoutSupport=true, ComTimeout=500, ComSignalType=UINT8, Direction=Rx, InputName=DrvSeatLumbarBottomValue3Cmd, offset=0, factor=1, enumValue=0%No action&1%Inflation&2%Deflation&3%Reserved, unitName=, max=3, min=0, compuMethodType=, ComSystemTemplateSystemSignalRef=Cfg_D_Rx_BODY_LE1_CAN_Zone_FL_MCM_01
        Cfg_D_Rx_BODY_LE1_CAN_Zone_FL_MCM_01_DrvSeatBolsterValueBLCmd: ComNotification=Com_CbkRxAck_Cfg_D_Rx_BODY_LE1_CAN_Zone_FL_MCM_01_DrvSeatBolsterValueBLCmd, ComTimeoutNotification=Com_CbkRxTOut_Cfg_D_Rx_BODY_LE1_CAN_Zone_FL_MCM_01_DrvSeatBolsterValueBLCmd, ComBitPosition=55, ComBitSize=2, ComFirstTimeout=500, ComHandleId=62, DataTimeoutSupport=true, ComTimeout=500, ComSignalType=UINT8, Direction=Rx, InputName=DrvSeatBolsterValueBLCmd, offset=0, factor=1, enumValue=0%No action&1%Inflation&2%Deflation&3%Reserved, unitName=, max=3, min=0, compuMethodType=, ComSystemTemplateSystemSignalRef=Cfg_D_Rx_BODY_LE1_CAN_Zone_FL_MCM_01
        Cfg_D_Rx_BODY_LE1_CAN_Zone_FL_MCM_01_DrvSeatBolsterValueBRCmd: ComNotification=Com_CbkRxAck_Cfg_D_Rx_BODY_LE1_CAN_Zone_FL_MCM_01_DrvSeatBolsterValueBRCmd, ComTimeoutNotification=Com_CbkRxTOut_Cfg_D_Rx_BODY_LE1_CAN_Zone_FL_MCM_01_DrvSeatBolsterValueBRCmd, ComBitPosition=57, ComBitSize=2, ComFirstTimeout=500, ComHandleId=63, DataTimeoutSupport=true, ComTimeout=500, ComSignalType=UINT8, Direction=Rx, InputName=DrvSeatBolsterValueBRCmd, offset=0, factor=1, enumValue=0%No action&1%Inflation&2%Deflation&3%Reserved, unitName=, max=3, min=0, compuMethodType=, ComSystemTemplateSystemSignalRef=Cfg_D_Rx_BODY_LE1_CAN_Zone_FL_MCM_01
        Cfg_D_Rx_BODY_LE1_CAN_Zone_FL_MCM_01_DrvSeatCushionValue6Cmd: ComNotification=Com_CbkRxAck_Cfg_D_Rx_BODY_LE1_CAN_Zone_FL_MCM_01_DrvSeatCushionValue6Cmd, ComTimeoutNotification=Com_CbkRxTOut_Cfg_D_Rx_BODY_LE1_CAN_Zone_FL_MCM_01_DrvSeatCushionValue6Cmd, ComBitPosition=59, ComBitSize=2, ComFirstTimeout=500, ComHandleId=64, DataTimeoutSupport=true, ComTimeout=500, ComSignalType=UINT8, Direction=Rx, InputName=DrvSeatCushionValue6Cmd, offset=0, factor=1, enumValue=0%No action&1%Inflation&2%Deflation&3%Reserved, unitName=, max=3, min=0, compuMethodType=, ComSystemTemplateSystemSignalRef=Cfg_D_Rx_BODY_LE1_CAN_Zone_FL_MCM_01
        Cfg_D_Rx_BODY_LE1_CAN_Zone_FL_MCM_01_DrvSeatCushionValue5Cmd: ComNotification=Com_CbkRxAck_Cfg_D_Rx_BODY_LE1_CAN_Zone_FL_MCM_01_DrvSeatCushionValue5Cmd, ComTimeoutNotification=Com_CbkRxTOut_Cfg_D_Rx_BODY_LE1_CAN_Zone_FL_MCM_01_DrvSeatCushionValue5Cmd, ComBitPosition=61, ComBitSize=2, ComFirstTimeout=500, ComHandleId=65, DataTimeoutSupport=true, ComTimeout=500, ComSignalType=UINT8, Direction=Rx, InputName=DrvSeatCushionValue5Cmd, offset=0, factor=1, enumValue=0%No action&1%Inflation&2%Deflation&3%Reserved, unitName=, max=3, min=0, compuMethodType=, ComSystemTemplateSystemSignalRef=Cfg_D_Rx_BODY_LE1_CAN_Zone_FL_MCM_01
        Cfg_D_Rx_BODY_LE1_CAN_Zone_FL_MCM_01_DrvSeatCushionValue4Cmd: ComNotification=Com_CbkRxAck_Cfg_D_Rx_BODY_LE1_CAN_Zone_FL_MCM_01_DrvSeatCushionValue4Cmd, ComTimeoutNotification=Com_CbkRxTOut_Cfg_D_Rx_BODY_LE1_CAN_Zone_FL_MCM_01_DrvSeatCushionValue4Cmd, ComBitPosition=63, ComBitSize=2, ComFirstTimeout=500, ComHandleId=66, DataTimeoutSupport=true, ComTimeout=500, ComSignalType=UINT8, Direction=Rx, InputName=DrvSeatCushionValue4Cmd, offset=0, factor=1, enumValue=0%No action&1%Inflation&2%Deflation&3%Reserved, unitName=, max=3, min=0, compuMethodType=, ComSystemTemplateSystemSignalRef=Cfg_D_Rx_BODY_LE1_CAN_Zone_FL_MCM_01
        Cfg_D_Rx_BODY_LE1_CAN_Zone_FL_MCM_02_DrvPumpCmd: ComNotification=Com_CbkRxAck_Cfg_D_Rx_BODY_LE1_CAN_Zone_FL_MCM_02_DrvPumpCmd, ComTimeoutNotification=Com_CbkRxTOut_Cfg_D_Rx_BODY_LE1_CAN_Zone_FL_MCM_02_DrvPumpCmd, ComBitPosition=23, ComBitSize=7, ComFirstTimeout=500, ComHandleId=67, DataTimeoutSupport=true, ComTimeout=500, ComSignalType=UINT8, Direction=Rx, InputName=DrvPumpCmd, offset=0, factor=1, enumValue=, unitName=, max=127, min=0, compuMethodType=, ComSystemTemplateSystemSignalRef=Cfg_D_Rx_BODY_LE1_CAN_Zone_FL_MCM_02
        Cfg_D_Rx_BODY_LE1_CAN_Zone_FL_MCM_02_DrvSeatUpperValueLCmd: ComNotification=Com_CbkRxAck_Cfg_D_Rx_BODY_LE1_CAN_Zone_FL_MCM_02_DrvSeatUpperValueLCmd, ComTimeoutNotification=Com_CbkRxTOut_Cfg_D_Rx_BODY_LE1_CAN_Zone_FL_MCM_02_DrvSeatUpperValueLCmd, ComBitPosition=25, ComBitSize=2, ComFirstTimeout=500, ComHandleId=68, DataTimeoutSupport=true, ComTimeout=500, ComSignalType=UINT8, Direction=Rx, InputName=DrvSeatUpperValueLCmd, offset=0, factor=1, enumValue=0%No action&1%Inflation&2%Deflation&3%Reserved, unitName=, max=3, min=0, compuMethodType=, ComSystemTemplateSystemSignalRef=Cfg_D_Rx_BODY_LE1_CAN_Zone_FL_MCM_02
        Cfg_D_Rx_BODY_LE1_CAN_Zone_FL_MCM_02_DrvSeatUpperValueMCmd: ComNotification=Com_CbkRxAck_Cfg_D_Rx_BODY_LE1_CAN_Zone_FL_MCM_02_DrvSeatUpperValueMCmd, ComTimeoutNotification=Com_CbkRxTOut_Cfg_D_Rx_BODY_LE1_CAN_Zone_FL_MCM_02_DrvSeatUpperValueMCmd, ComBitPosition=27, ComBitSize=2, ComFirstTimeout=500, ComHandleId=69, DataTimeoutSupport=true, ComTimeout=500, ComSignalType=UINT8, Direction=Rx, InputName=DrvSeatUpperValueMCmd, offset=0, factor=1, enumValue=0%No action&1%Inflation&2%Deflation&3%Reserved, unitName=, max=3, min=0, compuMethodType=, ComSystemTemplateSystemSignalRef=Cfg_D_Rx_BODY_LE1_CAN_Zone_FL_MCM_02
        Cfg_D_Rx_BODY_LE1_CAN_Zone_FL_MCM_02_DrvSeatCushionValue2Cmd: ComNotification=Com_CbkRxAck_Cfg_D_Rx_BODY_LE1_CAN_Zone_FL_MCM_02_DrvSeatCushionValue2Cmd, ComTimeoutNotification=Com_CbkRxTOut_Cfg_D_Rx_BODY_LE1_CAN_Zone_FL_MCM_02_DrvSeatCushionValue2Cmd, ComBitPosition=29, ComBitSize=2, ComFirstTimeout=500, ComHandleId=70, DataTimeoutSupport=true, ComTimeout=500, ComSignalType=UINT8, Direction=Rx, InputName=DrvSeatCushionValue2Cmd, offset=0, factor=1, enumValue=0%No action&1%Inflation&2%Deflation&3%Reserved, unitName=, max=3, min=0, compuMethodType=, ComSystemTemplateSystemSignalRef=Cfg_D_Rx_BODY_LE1_CAN_Zone_FL_MCM_02
        Cfg_D_Rx_BODY_LE1_CAN_Zone_FL_MCM_02_DrvSeatUpperValueRCmd: ComNotification=Com_CbkRxAck_Cfg_D_Rx_BODY_LE1_CAN_Zone_FL_MCM_02_DrvSeatUpperValueRCmd, ComTimeoutNotification=Com_CbkRxTOut_Cfg_D_Rx_BODY_LE1_CAN_Zone_FL_MCM_02_DrvSeatUpperValueRCmd, ComBitPosition=31, ComBitSize=2, ComFirstTimeout=500, ComHandleId=71, DataTimeoutSupport=true, ComTimeout=500, ComSignalType=UINT8, Direction=Rx, InputName=DrvSeatUpperValueRCmd, offset=0, factor=1, enumValue=0%No action&1%Inflation&2%Deflation&3%Reserved, unitName=, max=3, min=0, compuMethodType=, ComSystemTemplateSystemSignalRef=Cfg_D_Rx_BODY_LE1_CAN_Zone_FL_MCM_02
        Cfg_D_Rx_BODY_LE1_CAN_Zone_FL_MCM_02_DrvSeatCushionValue3Cmd: ComNotification=Com_CbkRxAck_Cfg_D_Rx_BODY_LE1_CAN_Zone_FL_MCM_02_DrvSeatCushionValue3Cmd, ComTimeoutNotification=Com_CbkRxTOut_Cfg_D_Rx_BODY_LE1_CAN_Zone_FL_MCM_02_DrvSeatCushionValue3Cmd, ComBitPosition=37, ComBitSize=2, ComFirstTimeout=500, ComHandleId=72, DataTimeoutSupport=true, ComTimeout=500, ComSignalType=UINT8, Direction=Rx, InputName=DrvSeatCushionValue3Cmd, offset=0, factor=1, enumValue=0%No action&1%Inflation&2%Deflation&3%Reserved, unitName=, max=3, min=0, compuMethodType=, ComSystemTemplateSystemSignalRef=Cfg_D_Rx_BODY_LE1_CAN_Zone_FL_MCM_02
        Cfg_D_Rx_BODY_LE1_CAN_Zone_FL_MCM_02_DrvSeatCushionValue1Cmd: ComNotification=Com_CbkRxAck_Cfg_D_Rx_BODY_LE1_CAN_Zone_FL_MCM_02_DrvSeatCushionValue1Cmd, ComTimeoutNotification=Com_CbkRxTOut_Cfg_D_Rx_BODY_LE1_CAN_Zone_FL_MCM_02_DrvSeatCushionValue1Cmd, ComBitPosition=39, ComBitSize=2, ComFirstTimeout=500, ComHandleId=73, DataTimeoutSupport=true, ComTimeout=500, ComSignalType=UINT8, Direction=Rx, InputName=DrvSeatCushionValue1Cmd, offset=0, factor=1, enumValue=0%No action&1%Inflation&2%Deflation&3%Reserved, unitName=, max=3, min=0, compuMethodType=, ComSystemTemplateSystemSignalRef=Cfg_D_Rx_BODY_LE1_CAN_Zone_FL_MCM_02
        Cfg_D_Rx_BODY_LE1_CAN_ZONE_2EF_BattVolt_LBMR: ComNotification=Com_CbkRxAck_Cfg_D_Rx_BODY_LE1_CAN_ZONE_2EF_BattVolt_LBMR, ComTimeoutNotification=, ComBitPosition=23, ComBitSize=16, ComFirstTimeout=0, ComHandleId=74, DataTimeoutSupport=false, ComTimeout=0, ComSignalType=UINT16, Direction=Rx, InputName=BattVolt_LBMR, offset=0, factor=0.001, enumValue=, unitName=V, max=65.535, min=0, compuMethodType=INTERNALTOPHYS, ComSystemTemplateSystemSignalRef=Cfg_D_Rx_BODY_LE1_CAN_ZONE_2EF
        Cfg_D_Rx_BODY_LE1_CAN_ZONE_3A9_VehOdometer: ComNotification=Com_CbkRxAck_Cfg_D_Rx_BODY_LE1_CAN_ZONE_3A9_VehOdometer, ComTimeoutNotification=Com_CbkRxTOut_Cfg_D_Rx_BODY_LE1_CAN_ZONE_3A9_VehOdometer, ComBitPosition=7, ComBitSize=24, ComFirstTimeout=500, ComHandleId=75, DataTimeoutSupport=true, ComTimeout=500, ComSignalType=UINT32, Direction=Rx, InputName=VehOdometer, offset=0, factor=1, enumValue=, unitName=km, max=16777215, min=0, compuMethodType=, ComSystemTemplateSystemSignalRef=Cfg_D_Rx_BODY_LE1_CAN_ZONE_3A9
        Cfg_D_Rx_BODY_LE1_CAN_ZONE_3B2_Yr: ComNotification=Com_CbkRxAck_Cfg_D_Rx_BODY_LE1_CAN_ZONE_3B2_Yr, ComTimeoutNotification=Com_CbkRxTOut_Cfg_D_Rx_BODY_LE1_CAN_ZONE_3B2_Yr, ComBitPosition=7, ComBitSize=8, ComFirstTimeout=500, ComHandleId=76, DataTimeoutSupport=true, ComTimeout=6000, ComSignalType=UINT8, Direction=Rx, InputName=Yr, offset=2000, factor=1, enumValue=, unitName=Year, max=2254, min=2000, compuMethodType=INTERNALTOPHYS, ComSystemTemplateSystemSignalRef=Cfg_D_Rx_BODY_LE1_CAN_ZONE_3B2
        Cfg_D_Rx_BODY_LE1_CAN_ZONE_3B2_Mth: ComNotification=Com_CbkRxAck_Cfg_D_Rx_BODY_LE1_CAN_ZONE_3B2_Mth, ComTimeoutNotification=Com_CbkRxTOut_Cfg_D_Rx_BODY_LE1_CAN_ZONE_3B2_Mth, ComBitPosition=11, ComBitSize=4, ComFirstTimeout=500, ComHandleId=77, DataTimeoutSupport=true, ComTimeout=6000, ComSignalType=UINT8, Direction=Rx, InputName=Mth, offset=0, factor=1, enumValue=11%November&12%December&13%Reserved&14%Reserved&15%Invalid&0%Unknown&1%January&2%February&3%March&4%April&5%May&6%June&7%July&8%August&9%September&10%October, unitName=, max=15, min=0, compuMethodType=, ComSystemTemplateSystemSignalRef=Cfg_D_Rx_BODY_LE1_CAN_ZONE_3B2
        Cfg_D_Rx_BODY_LE1_CAN_ZONE_3B2_Day: ComNotification=Com_CbkRxAck_Cfg_D_Rx_BODY_LE1_CAN_ZONE_3B2_Day, ComTimeoutNotification=Com_CbkRxTOut_Cfg_D_Rx_BODY_LE1_CAN_ZONE_3B2_Day, ComBitPosition=20, ComBitSize=5, ComFirstTimeout=500, ComHandleId=78, DataTimeoutSupport=true, ComTimeout=6000, ComSignalType=UINT8, Direction=Rx, InputName=Day, offset=0, factor=1, enumValue=, unitName=Day, max=31, min=0, compuMethodType=, ComSystemTemplateSystemSignalRef=Cfg_D_Rx_BODY_LE1_CAN_ZONE_3B2
        Cfg_D_Rx_BODY_LE1_CAN_ZONE_3B2_Hr: ComNotification=Com_CbkRxAck_Cfg_D_Rx_BODY_LE1_CAN_ZONE_3B2_Hr, ComTimeoutNotification=Com_CbkRxTOut_Cfg_D_Rx_BODY_LE1_CAN_ZONE_3B2_Hr, ComBitPosition=28, ComBitSize=5, ComFirstTimeout=500, ComHandleId=79, DataTimeoutSupport=true, ComTimeout=6000, ComSignalType=UINT8, Direction=Rx, InputName=Hr, offset=0, factor=1, enumValue=, unitName=Hour, max=23, min=0, compuMethodType=, ComSystemTemplateSystemSignalRef=Cfg_D_Rx_BODY_LE1_CAN_ZONE_3B2
        Cfg_D_Rx_BODY_LE1_CAN_ZONE_3B2_Min: ComNotification=Com_CbkRxAck_Cfg_D_Rx_BODY_LE1_CAN_ZONE_3B2_Min, ComTimeoutNotification=Com_CbkRxTOut_Cfg_D_Rx_BODY_LE1_CAN_ZONE_3B2_Min, ComBitPosition=37, ComBitSize=6, ComFirstTimeout=500, ComHandleId=80, DataTimeoutSupport=true, ComTimeout=6000, ComSignalType=UINT8, Direction=Rx, InputName=Min, offset=0, factor=1, enumValue=, unitName=min, max=59, min=0, compuMethodType=, ComSystemTemplateSystemSignalRef=Cfg_D_Rx_BODY_LE1_CAN_ZONE_3B2
        Cfg_D_Rx_BODY_LE1_CAN_ZONE_3B2_Sec: ComNotification=Com_CbkRxAck_Cfg_D_Rx_BODY_LE1_CAN_ZONE_3B2_Sec, ComTimeoutNotification=Com_CbkRxTOut_Cfg_D_Rx_BODY_LE1_CAN_ZONE_3B2_Sec, ComBitPosition=45, ComBitSize=6, ComFirstTimeout=500, ComHandleId=81, DataTimeoutSupport=true, ComTimeout=6000, ComSignalType=UINT8, Direction=Rx, InputName=Sec, offset=0, factor=1, enumValue=, unitName=Sec, max=59, min=0, compuMethodType=, ComSystemTemplateSystemSignalRef=Cfg_D_Rx_BODY_LE1_CAN_ZONE_3B2
        Cfg_D_Rx_BODY_LE1_CAN_ZONE_3B2_MSec: ComNotification=Com_CbkRxAck_Cfg_D_Rx_BODY_LE1_CAN_ZONE_3B2_MSec, ComTimeoutNotification=Com_CbkRxTOut_Cfg_D_Rx_BODY_LE1_CAN_ZONE_3B2_MSec, ComBitPosition=49, ComBitSize=10, ComFirstTimeout=500, ComHandleId=82, DataTimeoutSupport=true, ComTimeout=6000, ComSignalType=UINT16, Direction=Rx, InputName=MSec, offset=0, factor=1, enumValue=, unitName=, max=1023, min=0, compuMethodType=, ComSystemTemplateSystemSignalRef=Cfg_D_Rx_BODY_LE1_CAN_ZONE_3B2
        Cfg_D_Rx_BODY_LE1_CAN_ZONE_PNC_PNC_DFT: ComNotification=Com_CbkRxAck_Cfg_D_Rx_BODY_LE1_CAN_ZONE_PNC_PNC_DFT, ComTimeoutNotification=, ComBitPosition=15, ComBitSize=1, ComFirstTimeout=0, ComHandleId=83, DataTimeoutSupport=false, ComTimeout=0, ComSignalType=UINT8, Direction=Rx, InputName=PNC_DFT, offset=0, factor=1, enumValue=0%Inactive&1%Active, unitName=, max=1, min=0, compuMethodType=, ComSystemTemplateSystemSignalRef=Cfg_D_Rx_BODY_LE1_CAN_ZONE_PNC
        Cfg_D_Rx_BODY_LE1_CAN_ZONE_PNC_PNC1_Sts: ComNotification=Com_CbkRxAck_Cfg_D_Rx_BODY_LE1_CAN_ZONE_PNC_PNC1_Sts, ComTimeoutNotification=, ComBitPosition=16, ComBitSize=1, ComFirstTimeout=0, ComHandleId=84, DataTimeoutSupport=false, ComTimeout=0, ComSignalType=UINT8, Direction=Rx, InputName=PNC1_Sts, offset=0, factor=1, enumValue=0%Inactive&1%Active, unitName=, max=1, min=0, compuMethodType=, ComSystemTemplateSystemSignalRef=Cfg_D_Rx_BODY_LE1_CAN_ZONE_PNC
        Cfg_D_Rx_BODY_LE1_CAN_ZONE_PNC_PNC2_Sts: ComNotification=Com_CbkRxAck_Cfg_D_Rx_BODY_LE1_CAN_ZONE_PNC_PNC2_Sts, ComTimeoutNotification=, ComBitPosition=17, ComBitSize=1, ComFirstTimeout=0, ComHandleId=85, DataTimeoutSupport=false, ComTimeout=0, ComSignalType=UINT8, Direction=Rx, InputName=PNC2_Sts, offset=0, factor=1, enumValue=0%Inactive&1%Active, unitName=, max=1, min=0, compuMethodType=, ComSystemTemplateSystemSignalRef=Cfg_D_Rx_BODY_LE1_CAN_ZONE_PNC
        Cfg_D_Rx_BODY_LE1_CAN_ZONE_PNC_PNC3_Sts: ComNotification=Com_CbkRxAck_Cfg_D_Rx_BODY_LE1_CAN_ZONE_PNC_PNC3_Sts, ComTimeoutNotification=, ComBitPosition=18, ComBitSize=1, ComFirstTimeout=0, ComHandleId=86, DataTimeoutSupport=false, ComTimeout=0, ComSignalType=UINT8, Direction=Rx, InputName=PNC3_Sts, offset=0, factor=1, enumValue=0%Inactive&1%Active, unitName=, max=1, min=0, compuMethodType=, ComSystemTemplateSystemSignalRef=Cfg_D_Rx_BODY_LE1_CAN_ZONE_PNC
        Cfg_D_Rx_BODY_LE1_CAN_ZONE_PNC_PNC4_Sts: ComNotification=Com_CbkRxAck_Cfg_D_Rx_BODY_LE1_CAN_ZONE_PNC_PNC4_Sts, ComTimeoutNotification=, ComBitPosition=19, ComBitSize=1, ComFirstTimeout=0, ComHandleId=87, DataTimeoutSupport=false, ComTimeout=0, ComSignalType=UINT8, Direction=Rx, InputName=PNC4_Sts, offset=0, factor=1, enumValue=0%Inactive&1%Active, unitName=, max=1, min=0, compuMethodType=, ComSystemTemplateSystemSignalRef=Cfg_D_Rx_BODY_LE1_CAN_ZONE_PNC
        Cfg_D_Rx_BODY_LE1_CAN_ZONE_PNC_PNC5_Sts: ComNotification=Com_CbkRxAck_Cfg_D_Rx_BODY_LE1_CAN_ZONE_PNC_PNC5_Sts, ComTimeoutNotification=, ComBitPosition=20, ComBitSize=1, ComFirstTimeout=0, ComHandleId=88, DataTimeoutSupport=false, ComTimeout=0, ComSignalType=UINT8, Direction=Rx, InputName=PNC5_Sts, offset=0, factor=1, enumValue=0%Inactive&1%Active, unitName=, max=1, min=0, compuMethodType=, ComSystemTemplateSystemSignalRef=Cfg_D_Rx_BODY_LE1_CAN_ZONE_PNC
        Cfg_D_Rx_BODY_LE1_CAN_ZONE_PNC_PNC6_Sts: ComNotification=Com_CbkRxAck_Cfg_D_Rx_BODY_LE1_CAN_ZONE_PNC_PNC6_Sts, ComTimeoutNotification=, ComBitPosition=21, ComBitSize=1, ComFirstTimeout=0, ComHandleId=89, DataTimeoutSupport=false, ComTimeout=0, ComSignalType=UINT8, Direction=Rx, InputName=PNC6_Sts, offset=0, factor=1, enumValue=0%Inactive&1%Active, unitName=, max=1, min=0, compuMethodType=, ComSystemTemplateSystemSignalRef=Cfg_D_Rx_BODY_LE1_CAN_ZONE_PNC
        Cfg_D_Rx_BODY_LE1_CAN_ZONE_PNC_PNC7_Sts: ComNotification=Com_CbkRxAck_Cfg_D_Rx_BODY_LE1_CAN_ZONE_PNC_PNC7_Sts, ComTimeoutNotification=, ComBitPosition=22, ComBitSize=1, ComFirstTimeout=0, ComHandleId=90, DataTimeoutSupport=false, ComTimeout=0, ComSignalType=UINT8, Direction=Rx, InputName=PNC7_Sts, offset=0, factor=1, enumValue=0%Inactive&1%Active, unitName=, max=1, min=0, compuMethodType=, ComSystemTemplateSystemSignalRef=Cfg_D_Rx_BODY_LE1_CAN_ZONE_PNC
        Cfg_D_Rx_BODY_LE1_CAN_ZONE_PNC_PNC8_Sts: ComNotification=Com_CbkRxAck_Cfg_D_Rx_BODY_LE1_CAN_ZONE_PNC_PNC8_Sts, ComTimeoutNotification=, ComBitPosition=23, ComBitSize=1, ComFirstTimeout=0, ComHandleId=91, DataTimeoutSupport=false, ComTimeout=0, ComSignalType=UINT8, Direction=Rx, InputName=PNC8_Sts, offset=0, factor=1, enumValue=0%Inactive&1%Active, unitName=, max=1, min=0, compuMethodType=, ComSystemTemplateSystemSignalRef=Cfg_D_Rx_BODY_LE1_CAN_ZONE_PNC
        Cfg_D_Rx_BODY_LE1_CAN_ZONE_PNC_PNC9_Sts: ComNotification=Com_CbkRxAck_Cfg_D_Rx_BODY_LE1_CAN_ZONE_PNC_PNC9_Sts, ComTimeoutNotification=, ComBitPosition=24, ComBitSize=1, ComFirstTimeout=0, ComHandleId=92, DataTimeoutSupport=false, ComTimeout=0, ComSignalType=UINT8, Direction=Rx, InputName=PNC9_Sts, offset=0, factor=1, enumValue=0%Inactive&1%Active, unitName=, max=1, min=0, compuMethodType=, ComSystemTemplateSystemSignalRef=Cfg_D_Rx_BODY_LE1_CAN_ZONE_PNC
        Cfg_D_Rx_BODY_LE1_CAN_ZONE_PNC_PNC10_Sts: ComNotification=Com_CbkRxAck_Cfg_D_Rx_BODY_LE1_CAN_ZONE_PNC_PNC10_Sts, ComTimeoutNotification=, ComBitPosition=25, ComBitSize=1, ComFirstTimeout=0, ComHandleId=93, DataTimeoutSupport=false, ComTimeout=0, ComSignalType=UINT8, Direction=Rx, InputName=PNC10_Sts, offset=0, factor=1, enumValue=0%Inactive&1%Active, unitName=, max=1, min=0, compuMethodType=, ComSystemTemplateSystemSignalRef=Cfg_D_Rx_BODY_LE1_CAN_ZONE_PNC
        Cfg_D_Rx_BODY_LE1_CAN_ZONE_PNC_PNC11_Sts: ComNotification=Com_CbkRxAck_Cfg_D_Rx_BODY_LE1_CAN_ZONE_PNC_PNC11_Sts, ComTimeoutNotification=, ComBitPosition=26, ComBitSize=1, ComFirstTimeout=0, ComHandleId=94, DataTimeoutSupport=false, ComTimeout=0, ComSignalType=UINT8, Direction=Rx, InputName=PNC11_Sts, offset=0, factor=1, enumValue=0%Inactive&1%Active, unitName=, max=1, min=0, compuMethodType=, ComSystemTemplateSystemSignalRef=Cfg_D_Rx_BODY_LE1_CAN_ZONE_PNC
        Cfg_D_Rx_BODY_LE1_CAN_ZONE_PNC_PNC12_Sts: ComNotification=Com_CbkRxAck_Cfg_D_Rx_BODY_LE1_CAN_ZONE_PNC_PNC12_Sts, ComTimeoutNotification=, ComBitPosition=27, ComBitSize=1, ComFirstTimeout=0, ComHandleId=95, DataTimeoutSupport=false, ComTimeout=0, ComSignalType=UINT8, Direction=Rx, InputName=PNC12_Sts, offset=0, factor=1, enumValue=0%Inactive&1%Active, unitName=, max=1, min=0, compuMethodType=, ComSystemTemplateSystemSignalRef=Cfg_D_Rx_BODY_LE1_CAN_ZONE_PNC
        Cfg_D_Rx_BODY_LE1_CAN_ZONE_PNC_PNC13_Sts: ComNotification=Com_CbkRxAck_Cfg_D_Rx_BODY_LE1_CAN_ZONE_PNC_PNC13_Sts, ComTimeoutNotification=, ComBitPosition=28, ComBitSize=1, ComFirstTimeout=0, ComHandleId=96, DataTimeoutSupport=false, ComTimeout=0, ComSignalType=UINT8, Direction=Rx, InputName=PNC13_Sts, offset=0, factor=1, enumValue=0%Inactive&1%Active, unitName=, max=1, min=0, compuMethodType=, ComSystemTemplateSystemSignalRef=Cfg_D_Rx_BODY_LE1_CAN_ZONE_PNC
        Cfg_D_Rx_BODY_LE1_CAN_ZONE_PNC_PNC14_Sts: ComNotification=Com_CbkRxAck_Cfg_D_Rx_BODY_LE1_CAN_ZONE_PNC_PNC14_Sts, ComTimeoutNotification=, ComBitPosition=29, ComBitSize=1, ComFirstTimeout=0, ComHandleId=97, DataTimeoutSupport=false, ComTimeout=0, ComSignalType=UINT8, Direction=Rx, InputName=PNC14_Sts, offset=0, factor=1, enumValue=0%Inactive&1%Active, unitName=, max=1, min=0, compuMethodType=, ComSystemTemplateSystemSignalRef=Cfg_D_Rx_BODY_LE1_CAN_ZONE_PNC
        Cfg_D_Rx_BODY_LE1_CAN_ZONE_PNC_PNC15_Sts: ComNotification=Com_CbkRxAck_Cfg_D_Rx_BODY_LE1_CAN_ZONE_PNC_PNC15_Sts, ComTimeoutNotification=, ComBitPosition=30, ComBitSize=1, ComFirstTimeout=0, ComHandleId=98, DataTimeoutSupport=false, ComTimeout=0, ComSignalType=UINT8, Direction=Rx, InputName=PNC15_Sts, offset=0, factor=1, enumValue=0%Inactive&1%Active, unitName=, max=1, min=0, compuMethodType=, ComSystemTemplateSystemSignalRef=Cfg_D_Rx_BODY_LE1_CAN_ZONE_PNC
        Cfg_D_Rx_BODY_LE1_CAN_ZONE_PNC_PNC16_Sts: ComNotification=Com_CbkRxAck_Cfg_D_Rx_BODY_LE1_CAN_ZONE_PNC_PNC16_Sts, ComTimeoutNotification=, ComBitPosition=31, ComBitSize=1, ComFirstTimeout=0, ComHandleId=99, DataTimeoutSupport=false, ComTimeout=0, ComSignalType=UINT8, Direction=Rx, InputName=PNC16_Sts, offset=0, factor=1, enumValue=0%Inactive&1%Active, unitName=, max=1, min=0, compuMethodType=, ComSystemTemplateSystemSignalRef=Cfg_D_Rx_BODY_LE1_CAN_ZONE_PNC
        Cfg_D_Rx_BODY_LE1_CAN_ZONE_PNC_PNC17_Sts: ComNotification=Com_CbkRxAck_Cfg_D_Rx_BODY_LE1_CAN_ZONE_PNC_PNC17_Sts, ComTimeoutNotification=, ComBitPosition=32, ComBitSize=1, ComFirstTimeout=0, ComHandleId=100, DataTimeoutSupport=false, ComTimeout=0, ComSignalType=UINT8, Direction=Rx, InputName=PNC17_Sts, offset=0, factor=1, enumValue=0%Inactive&1%Active, unitName=, max=1, min=0, compuMethodType=, ComSystemTemplateSystemSignalRef=Cfg_D_Rx_BODY_LE1_CAN_ZONE_PNC
        Cfg_D_Rx_BODY_LE1_CAN_ZONE_PNC_PNC18_Sts: ComNotification=Com_CbkRxAck_Cfg_D_Rx_BODY_LE1_CAN_ZONE_PNC_PNC18_Sts, ComTimeoutNotification=, ComBitPosition=33, ComBitSize=1, ComFirstTimeout=0, ComHandleId=101, DataTimeoutSupport=false, ComTimeout=0, ComSignalType=UINT8, Direction=Rx, InputName=PNC18_Sts, offset=0, factor=1, enumValue=0%Inactive&1%Active, unitName=, max=1, min=0, compuMethodType=, ComSystemTemplateSystemSignalRef=Cfg_D_Rx_BODY_LE1_CAN_ZONE_PNC
        Cfg_D_Rx_BODY_LE1_CAN_ZONE_PNC_PNC19_Sts: ComNotification=Com_CbkRxAck_Cfg_D_Rx_BODY_LE1_CAN_ZONE_PNC_PNC19_Sts, ComTimeoutNotification=, ComBitPosition=34, ComBitSize=1, ComFirstTimeout=0, ComHandleId=102, DataTimeoutSupport=false, ComTimeout=0, ComSignalType=UINT8, Direction=Rx, InputName=PNC19_Sts, offset=0, factor=1, enumValue=0%Inactive&1%Active, unitName=, max=1, min=0, compuMethodType=, ComSystemTemplateSystemSignalRef=Cfg_D_Rx_BODY_LE1_CAN_ZONE_PNC
        Cfg_D_Rx_BODY_LE1_CAN_ZONE_PNC_PNC20_Sts: ComNotification=Com_CbkRxAck_Cfg_D_Rx_BODY_LE1_CAN_ZONE_PNC_PNC20_Sts, ComTimeoutNotification=, ComBitPosition=35, ComBitSize=1, ComFirstTimeout=0, ComHandleId=103, DataTimeoutSupport=false, ComTimeout=0, ComSignalType=UINT8, Direction=Rx, InputName=PNC20_Sts, offset=0, factor=1, enumValue=0%Inactive&1%Active, unitName=, max=1, min=0, compuMethodType=, ComSystemTemplateSystemSignalRef=Cfg_D_Rx_BODY_LE1_CAN_ZONE_PNC
        Cfg_D_Rx_BODY_LE1_CAN_ZONE_PNC_PNC21_Sts: ComNotification=Com_CbkRxAck_Cfg_D_Rx_BODY_LE1_CAN_ZONE_PNC_PNC21_Sts, ComTimeoutNotification=, ComBitPosition=36, ComBitSize=1, ComFirstTimeout=0, ComHandleId=104, DataTimeoutSupport=false, ComTimeout=0, ComSignalType=UINT8, Direction=Rx, InputName=PNC21_Sts, offset=0, factor=1, enumValue=0%Inactive&1%Active, unitName=, max=1, min=0, compuMethodType=, ComSystemTemplateSystemSignalRef=Cfg_D_Rx_BODY_LE1_CAN_ZONE_PNC
        Cfg_D_Rx_BODY_LE1_CAN_ZONE_PNC_PNC22_Sts: ComNotification=Com_CbkRxAck_Cfg_D_Rx_BODY_LE1_CAN_ZONE_PNC_PNC22_Sts, ComTimeoutNotification=, ComBitPosition=37, ComBitSize=1, ComFirstTimeout=0, ComHandleId=105, DataTimeoutSupport=false, ComTimeout=0, ComSignalType=UINT8, Direction=Rx, InputName=PNC22_Sts, offset=0, factor=1, enumValue=0%Inactive&1%Active, unitName=, max=1, min=0, compuMethodType=, ComSystemTemplateSystemSignalRef=Cfg_D_Rx_BODY_LE1_CAN_ZONE_PNC
        Cfg_D_Rx_BODY_LE1_CAN_ZONE_PNC_PNC23_Sts: ComNotification=Com_CbkRxAck_Cfg_D_Rx_BODY_LE1_CAN_ZONE_PNC_PNC23_Sts, ComTimeoutNotification=, ComBitPosition=38, ComBitSize=1, ComFirstTimeout=0, ComHandleId=106, DataTimeoutSupport=false, ComTimeout=0, ComSignalType=UINT8, Direction=Rx, InputName=PNC23_Sts, offset=0, factor=1, enumValue=0%Inactive&1%Active, unitName=, max=1, min=0, compuMethodType=, ComSystemTemplateSystemSignalRef=Cfg_D_Rx_BODY_LE1_CAN_ZONE_PNC
        Cfg_D_Rx_BODY_LE1_CAN_ZONE_PNC_PNC24_Sts: ComNotification=Com_CbkRxAck_Cfg_D_Rx_BODY_LE1_CAN_ZONE_PNC_PNC24_Sts, ComTimeoutNotification=, ComBitPosition=39, ComBitSize=1, ComFirstTimeout=0, ComHandleId=107, DataTimeoutSupport=false, ComTimeout=0, ComSignalType=UINT8, Direction=Rx, InputName=PNC24_Sts, offset=0, factor=1, enumValue=0%Inactive&1%Active, unitName=, max=1, min=0, compuMethodType=, ComSystemTemplateSystemSignalRef=Cfg_D_Rx_BODY_LE1_CAN_ZONE_PNC
        Cfg_D_Rx_BODY_LE1_CAN_ZONE_PNC_PNC25_Sts: ComNotification=Com_CbkRxAck_Cfg_D_Rx_BODY_LE1_CAN_ZONE_PNC_PNC25_Sts, ComTimeoutNotification=, ComBitPosition=40, ComBitSize=1, ComFirstTimeout=0, ComHandleId=108, DataTimeoutSupport=false, ComTimeout=0, ComSignalType=UINT8, Direction=Rx, InputName=PNC25_Sts, offset=0, factor=1, enumValue=0%Inactive&1%Active, unitName=, max=1, min=0, compuMethodType=, ComSystemTemplateSystemSignalRef=Cfg_D_Rx_BODY_LE1_CAN_ZONE_PNC
        Cfg_D_Rx_BODY_LE1_CAN_ZONE_PNC_PNC26_Sts: ComNotification=Com_CbkRxAck_Cfg_D_Rx_BODY_LE1_CAN_ZONE_PNC_PNC26_Sts, ComTimeoutNotification=, ComBitPosition=41, ComBitSize=1, ComFirstTimeout=0, ComHandleId=109, DataTimeoutSupport=false, ComTimeout=0, ComSignalType=UINT8, Direction=Rx, InputName=PNC26_Sts, offset=0, factor=1, enumValue=0%Inactive&1%Active, unitName=, max=1, min=0, compuMethodType=, ComSystemTemplateSystemSignalRef=Cfg_D_Rx_BODY_LE1_CAN_ZONE_PNC
        Cfg_D_Rx_BODY_LE1_CAN_ZONE_PNC_PNC27_Sts: ComNotification=Com_CbkRxAck_Cfg_D_Rx_BODY_LE1_CAN_ZONE_PNC_PNC27_Sts, ComTimeoutNotification=, ComBitPosition=42, ComBitSize=1, ComFirstTimeout=0, ComHandleId=110, DataTimeoutSupport=false, ComTimeout=0, ComSignalType=UINT8, Direction=Rx, InputName=PNC27_Sts, offset=0, factor=1, enumValue=0%Inactive&1%Active, unitName=, max=1, min=0, compuMethodType=, ComSystemTemplateSystemSignalRef=Cfg_D_Rx_BODY_LE1_CAN_ZONE_PNC
        Cfg_D_Rx_BODY_LE1_CAN_ZONE_PNC_PNC28_Sts: ComNotification=Com_CbkRxAck_Cfg_D_Rx_BODY_LE1_CAN_ZONE_PNC_PNC28_Sts, ComTimeoutNotification=, ComBitPosition=43, ComBitSize=1, ComFirstTimeout=0, ComHandleId=111, DataTimeoutSupport=false, ComTimeout=0, ComSignalType=UINT8, Direction=Rx, InputName=PNC28_Sts, offset=0, factor=1, enumValue=0%Inactive&1%Active, unitName=, max=1, min=0, compuMethodType=, ComSystemTemplateSystemSignalRef=Cfg_D_Rx_BODY_LE1_CAN_ZONE_PNC
        Cfg_D_Rx_BODY_LE1_CAN_ZONE_PNC_PNC29_Sts: ComNotification=Com_CbkRxAck_Cfg_D_Rx_BODY_LE1_CAN_ZONE_PNC_PNC29_Sts, ComTimeoutNotification=, ComBitPosition=44, ComBitSize=1, ComFirstTimeout=0, ComHandleId=112, DataTimeoutSupport=false, ComTimeout=0, ComSignalType=UINT8, Direction=Rx, InputName=PNC29_Sts, offset=0, factor=1, enumValue=0%Inactive&1%Active, unitName=, max=1, min=0, compuMethodType=, ComSystemTemplateSystemSignalRef=Cfg_D_Rx_BODY_LE1_CAN_ZONE_PNC
        Cfg_D_Rx_BODY_LE1_CAN_ZONE_PNC_PNC30_Sts: ComNotification=Com_CbkRxAck_Cfg_D_Rx_BODY_LE1_CAN_ZONE_PNC_PNC30_Sts, ComTimeoutNotification=, ComBitPosition=45, ComBitSize=1, ComFirstTimeout=0, ComHandleId=113, DataTimeoutSupport=false, ComTimeout=0, ComSignalType=UINT8, Direction=Rx, InputName=PNC30_Sts, offset=0, factor=1, enumValue=0%Inactive&1%Active, unitName=, max=1, min=0, compuMethodType=, ComSystemTemplateSystemSignalRef=Cfg_D_Rx_BODY_LE1_CAN_ZONE_PNC
        Cfg_D_Rx_BODY_LE1_CAN_ZONE_PNC_PNC31_Sts: ComNotification=Com_CbkRxAck_Cfg_D_Rx_BODY_LE1_CAN_ZONE_PNC_PNC31_Sts, ComTimeoutNotification=, ComBitPosition=46, ComBitSize=1, ComFirstTimeout=0, ComHandleId=114, DataTimeoutSupport=false, ComTimeout=0, ComSignalType=UINT8, Direction=Rx, InputName=PNC31_Sts, offset=0, factor=1, enumValue=0%Inactive&1%Active, unitName=, max=1, min=0, compuMethodType=, ComSystemTemplateSystemSignalRef=Cfg_D_Rx_BODY_LE1_CAN_ZONE_PNC
        Cfg_D_Rx_BODY_LE1_CAN_ZONE_PNC_PNC32_Sts: ComNotification=Com_CbkRxAck_Cfg_D_Rx_BODY_LE1_CAN_ZONE_PNC_PNC32_Sts, ComTimeoutNotification=, ComBitPosition=47, ComBitSize=1, ComFirstTimeout=0, ComHandleId=115, DataTimeoutSupport=false, ComTimeout=0, ComSignalType=UINT8, Direction=Rx, InputName=PNC32_Sts, offset=0, factor=1, enumValue=0%Inactive&1%Active, unitName=, max=1, min=0, compuMethodType=, ComSystemTemplateSystemSignalRef=Cfg_D_Rx_BODY_LE1_CAN_ZONE_PNC
        Cfg_D_Rx_BODY_LE1_CAN_ZONE_PNC_PNC33_Sts: ComNotification=Com_CbkRxAck_Cfg_D_Rx_BODY_LE1_CAN_ZONE_PNC_PNC33_Sts, ComTimeoutNotification=, ComBitPosition=48, ComBitSize=1, ComFirstTimeout=0, ComHandleId=116, DataTimeoutSupport=false, ComTimeout=0, ComSignalType=UINT8, Direction=Rx, InputName=PNC33_Sts, offset=0, factor=1, enumValue=0%Inactive&1%Active, unitName=, max=1, min=0, compuMethodType=, ComSystemTemplateSystemSignalRef=Cfg_D_Rx_BODY_LE1_CAN_ZONE_PNC
        Cfg_D_Rx_BODY_LE1_CAN_ZONE_PNC_PNC34_Sts: ComNotification=Com_CbkRxAck_Cfg_D_Rx_BODY_LE1_CAN_ZONE_PNC_PNC34_Sts, ComTimeoutNotification=, ComBitPosition=49, ComBitSize=1, ComFirstTimeout=0, ComHandleId=117, DataTimeoutSupport=false, ComTimeout=0, ComSignalType=UINT8, Direction=Rx, InputName=PNC34_Sts, offset=0, factor=1, enumValue=0%Inactive&1%Active, unitName=, max=1, min=0, compuMethodType=, ComSystemTemplateSystemSignalRef=Cfg_D_Rx_BODY_LE1_CAN_ZONE_PNC
        Cfg_D_Rx_BODY_LE1_CAN_ZONE_PNC_PNC35_Sts: ComNotification=Com_CbkRxAck_Cfg_D_Rx_BODY_LE1_CAN_ZONE_PNC_PNC35_Sts, ComTimeoutNotification=, ComBitPosition=50, ComBitSize=1, ComFirstTimeout=0, ComHandleId=118, DataTimeoutSupport=false, ComTimeout=0, ComSignalType=UINT8, Direction=Rx, InputName=PNC35_Sts, offset=0, factor=1, enumValue=0%Inactive&1%Active, unitName=, max=1, min=0, compuMethodType=, ComSystemTemplateSystemSignalRef=Cfg_D_Rx_BODY_LE1_CAN_ZONE_PNC
        Cfg_D_Rx_BODY_LE1_CAN_ZONE_PNC_PNC36_Sts: ComNotification=Com_CbkRxAck_Cfg_D_Rx_BODY_LE1_CAN_ZONE_PNC_PNC36_Sts, ComTimeoutNotification=, ComBitPosition=51, ComBitSize=1, ComFirstTimeout=0, ComHandleId=119, DataTimeoutSupport=false, ComTimeout=0, ComSignalType=UINT8, Direction=Rx, InputName=PNC36_Sts, offset=0, factor=1, enumValue=0%Inactive&1%Active, unitName=, max=1, min=0, compuMethodType=, ComSystemTemplateSystemSignalRef=Cfg_D_Rx_BODY_LE1_CAN_ZONE_PNC
        Cfg_D_Rx_BODY_LE1_CAN_ZONE_PNC_PNC37_Sts: ComNotification=Com_CbkRxAck_Cfg_D_Rx_BODY_LE1_CAN_ZONE_PNC_PNC37_Sts, ComTimeoutNotification=, ComBitPosition=52, ComBitSize=1, ComFirstTimeout=0, ComHandleId=120, DataTimeoutSupport=false, ComTimeout=0, ComSignalType=UINT8, Direction=Rx, InputName=PNC37_Sts, offset=0, factor=1, enumValue=0%Inactive&1%Active, unitName=, max=1, min=0, compuMethodType=, ComSystemTemplateSystemSignalRef=Cfg_D_Rx_BODY_LE1_CAN_ZONE_PNC
        Cfg_D_Rx_BODY_LE1_CAN_ZONE_PNC_PNC38_Sts: ComNotification=Com_CbkRxAck_Cfg_D_Rx_BODY_LE1_CAN_ZONE_PNC_PNC38_Sts, ComTimeoutNotification=, ComBitPosition=53, ComBitSize=1, ComFirstTimeout=0, ComHandleId=121, DataTimeoutSupport=false, ComTimeout=0, ComSignalType=UINT8, Direction=Rx, InputName=PNC38_Sts, offset=0, factor=1, enumValue=0%Inactive&1%Active, unitName=, max=1, min=0, compuMethodType=, ComSystemTemplateSystemSignalRef=Cfg_D_Rx_BODY_LE1_CAN_ZONE_PNC
        Cfg_D_Rx_BODY_LE1_CAN_ZONE_PNC_PNC39_Sts: ComNotification=Com_CbkRxAck_Cfg_D_Rx_BODY_LE1_CAN_ZONE_PNC_PNC39_Sts, ComTimeoutNotification=, ComBitPosition=54, ComBitSize=1, ComFirstTimeout=0, ComHandleId=122, DataTimeoutSupport=false, ComTimeout=0, ComSignalType=UINT8, Direction=Rx, InputName=PNC39_Sts, offset=0, factor=1, enumValue=0%Inactive&1%Active, unitName=, max=1, min=0, compuMethodType=, ComSystemTemplateSystemSignalRef=Cfg_D_Rx_BODY_LE1_CAN_ZONE_PNC
        Cfg_D_Rx_BODY_LE1_CAN_ZONE_PNC_PNC40_Sts: ComNotification=Com_CbkRxAck_Cfg_D_Rx_BODY_LE1_CAN_ZONE_PNC_PNC40_Sts, ComTimeoutNotification=, ComBitPosition=55, ComBitSize=1, ComFirstTimeout=0, ComHandleId=123, DataTimeoutSupport=false, ComTimeout=0, ComSignalType=UINT8, Direction=Rx, InputName=PNC40_Sts, offset=0, factor=1, enumValue=0%Inactive&1%Active, unitName=, max=1, min=0, compuMethodType=, ComSystemTemplateSystemSignalRef=Cfg_D_Rx_BODY_LE1_CAN_ZONE_PNC
        Cfg_D_Rx_BODY_LE1_CAN_ZONE_PNC_PNC41_Sts: ComNotification=Com_CbkRxAck_Cfg_D_Rx_BODY_LE1_CAN_ZONE_PNC_PNC41_Sts, ComTimeoutNotification=, ComBitPosition=56, ComBitSize=1, ComFirstTimeout=0, ComHandleId=124, DataTimeoutSupport=false, ComTimeout=0, ComSignalType=UINT8, Direction=Rx, InputName=PNC41_Sts, offset=0, factor=1, enumValue=0%Inactive&1%Active, unitName=, max=1, min=0, compuMethodType=, ComSystemTemplateSystemSignalRef=Cfg_D_Rx_BODY_LE1_CAN_ZONE_PNC
        Cfg_D_Rx_BODY_LE1_CAN_ZONE_PNC_PNC43_Sts: ComNotification=Com_CbkRxAck_Cfg_D_Rx_BODY_LE1_CAN_ZONE_PNC_PNC43_Sts, ComTimeoutNotification=, ComBitPosition=57, ComBitSize=1, ComFirstTimeout=0, ComHandleId=125, DataTimeoutSupport=false, ComTimeout=0, ComSignalType=UINT8, Direction=Rx, InputName=PNC43_Sts, offset=0, factor=1, enumValue=0%Inactive&1%Active, unitName=, max=1, min=0, compuMethodType=, ComSystemTemplateSystemSignalRef=Cfg_D_Rx_BODY_LE1_CAN_ZONE_PNC
        Cfg_D_Rx_BODY_LE1_CAN_ZONE_PNC_PNC42_Sts: ComNotification=Com_CbkRxAck_Cfg_D_Rx_BODY_LE1_CAN_ZONE_PNC_PNC42_Sts, ComTimeoutNotification=, ComBitPosition=58, ComBitSize=1, ComFirstTimeout=0, ComHandleId=126, DataTimeoutSupport=false, ComTimeout=0, ComSignalType=UINT8, Direction=Rx, InputName=PNC42_Sts, offset=0, factor=1, enumValue=0%Inactive&1%Active, unitName=, max=1, min=0, compuMethodType=, ComSystemTemplateSystemSignalRef=Cfg_D_Rx_BODY_LE1_CAN_ZONE_PNC
        Cfg_D_Rx_BODY_LE1_CAN_ZONE_PNC_PNC44_Sts: ComNotification=Com_CbkRxAck_Cfg_D_Rx_BODY_LE1_CAN_ZONE_PNC_PNC44_Sts, ComTimeoutNotification=, ComBitPosition=59, ComBitSize=1, ComFirstTimeout=0, ComHandleId=127, DataTimeoutSupport=false, ComTimeout=0, ComSignalType=UINT8, Direction=Rx, InputName=PNC44_Sts, offset=0, factor=1, enumValue=0%Inactive&1%Active, unitName=, max=1, min=0, compuMethodType=, ComSystemTemplateSystemSignalRef=Cfg_D_Rx_BODY_LE1_CAN_ZONE_PNC
        Cfg_D_Rx_BODY_LE1_CAN_ZONE_PNC_PNC45_Sts: ComNotification=Com_CbkRxAck_Cfg_D_Rx_BODY_LE1_CAN_ZONE_PNC_PNC45_Sts, ComTimeoutNotification=, ComBitPosition=60, ComBitSize=1, ComFirstTimeout=0, ComHandleId=128, DataTimeoutSupport=false, ComTimeout=0, ComSignalType=UINT8, Direction=Rx, InputName=PNC45_Sts, offset=0, factor=1, enumValue=0%Inactive&1%Active, unitName=, max=1, min=0, compuMethodType=, ComSystemTemplateSystemSignalRef=Cfg_D_Rx_BODY_LE1_CAN_ZONE_PNC
        Cfg_D_Rx_BODY_LE1_CAN_ZONE_PNC_PNC46_Sts: ComNotification=Com_CbkRxAck_Cfg_D_Rx_BODY_LE1_CAN_ZONE_PNC_PNC46_Sts, ComTimeoutNotification=, ComBitPosition=61, ComBitSize=1, ComFirstTimeout=0, ComHandleId=129, DataTimeoutSupport=false, ComTimeout=0, ComSignalType=UINT8, Direction=Rx, InputName=PNC46_Sts, offset=0, factor=1, enumValue=0%Inactive&1%Active, unitName=, max=1, min=0, compuMethodType=, ComSystemTemplateSystemSignalRef=Cfg_D_Rx_BODY_LE1_CAN_ZONE_PNC
        Cfg_D_Rx_BODY_LE1_CAN_ZONE_PNC_PNC47_Sts: ComNotification=Com_CbkRxAck_Cfg_D_Rx_BODY_LE1_CAN_ZONE_PNC_PNC47_Sts, ComTimeoutNotification=, ComBitPosition=62, ComBitSize=1, ComFirstTimeout=0, ComHandleId=130, DataTimeoutSupport=false, ComTimeout=0, ComSignalType=UINT8, Direction=Rx, InputName=PNC47_Sts, offset=0, factor=1, enumValue=0%Inactive&1%Active, unitName=, max=1, min=0, compuMethodType=, ComSystemTemplateSystemSignalRef=Cfg_D_Rx_BODY_LE1_CAN_ZONE_PNC
        Cfg_D_Rx_BODY_LE1_CAN_ZONE_PNC_PNC48_Sts: ComNotification=Com_CbkRxAck_Cfg_D_Rx_BODY_LE1_CAN_ZONE_PNC_PNC48_Sts, ComTimeoutNotification=, ComBitPosition=63, ComBitSize=1, ComFirstTimeout=0, ComHandleId=131, DataTimeoutSupport=false, ComTimeout=0, ComSignalType=UINT8, Direction=Rx, InputName=PNC48_Sts, offset=0, factor=1, enumValue=0%Inactive&1%Active, unitName=, max=1, min=0, compuMethodType=, ComSystemTemplateSystemSignalRef=Cfg_D_Rx_BODY_LE1_CAN_ZONE_PNC
        Cfg_D_Rx_BODY_LE1_CAN_VC_Data_5E0_VC_Data_5E0_CRC: ComNotification=Com_CbkRxAck_Cfg_D_Rx_BODY_LE1_CAN_VC_Data_5E0_VC_Data_5E0_CRC, ComTimeoutNotification=, ComBitPosition=7, ComBitSize=8, ComFirstTimeout=0, ComHandleId=132, DataTimeoutSupport=false, ComTimeout=0, ComSignalType=UINT8, Direction=Rx, InputName=VC_Data_5E0_CRC, offset=0, factor=1, enumValue=, unitName=, max=255, min=0, compuMethodType=, ComSystemTemplateSystemSignalRef=Cfg_D_Rx_BODY_LE1_CAN_VC_Data_5E0
        Cfg_D_Rx_BODY_LE1_CAN_VC_Data_5E0_VC_Data_5E0_MsgCntr: ComNotification=Com_CbkRxAck_Cfg_D_Rx_BODY_LE1_CAN_VC_Data_5E0_VC_Data_5E0_MsgCntr, ComTimeoutNotification=, ComBitPosition=11, ComBitSize=4, ComFirstTimeout=0, ComHandleId=133, DataTimeoutSupport=false, ComTimeout=0, ComSignalType=UINT8, Direction=Rx, InputName=VC_Data_5E0_MsgCntr, offset=0, factor=1, enumValue=, unitName=, max=14, min=0, compuMethodType=, ComSystemTemplateSystemSignalRef=Cfg_D_Rx_BODY_LE1_CAN_VC_Data_5E0
        Cfg_D_Rx_BODY_LE1_CAN_VC_Data_5E0_VC_Data_5E0_Payload: ComNotification=Com_CbkRxAck_Cfg_D_Rx_BODY_LE1_CAN_VC_Data_5E0_VC_Data_5E0_Payload, ComTimeoutNotification=, ComBitPosition=23, ComBitSize=48, ComFirstTimeout=0, ComHandleId=134, DataTimeoutSupport=false, ComTimeout=0, ComSignalType=UINT64, Direction=Rx, InputName=VC_Data_5E0_Payload, offset=0, factor=1, enumValue=, unitName=, max=281474976710655, min=0, compuMethodType=, ComSystemTemplateSystemSignalRef=Cfg_D_Rx_BODY_LE1_CAN_VC_Data_5E0
      ComTimeBase: ComGwTimeBase=10, ComRxTimeBase=10, ComTxTimeBase=10
