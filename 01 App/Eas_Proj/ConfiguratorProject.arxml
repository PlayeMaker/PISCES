[part 3 of 4: package /EcucDefs]
AUTOSAR XML (schema 00046)
package /EcucDefs  (continued)
  module config Com: implementation-config-variant=STD_CONFIG_VARIANTS_POSTBUILD, module_version_def=4.2.0, module_autosar_version=Ar470  (continued)
    Cfg_P (ComConfig): UserDefine=false
      17 x ComIPdu, all with ComIPduCallout=, ComIPduCancellationSupport=false, ComIPduSignalProcessing=DEFERRED, ComIPduTriggerTransmitCallout=, ComIPduType=NORMAL, IPduDLC=8, ComMetaDataDefault=, ComPduTimeoutNotificationEnable=false, ComRxTimePeriod=0, AutoCreateComIPduCallout=false, UserDefine=false, NetworkName=:
        Cfg_P_Tx_BODY_LE1_CAN_MCM_P_1B7: ComIPduDirection=SEND, ComIPduHandleId=0, PduTimeoutSupport=false, ComPduIdRef=Cfg_P_Tx_BODY_LE1_CAN_MCM_P_1B7, ComIPduGroupRef=BODY_LE1_CANTx, ComIPduSignalRef=Cfg_P_Tx_BODY_LE1_CAN_MCM_P_1B7_PassKneadingMassgSkillsSts5, ComIPduSignalRef=Cfg_P_Tx_BODY_LE1_CAN_MCM_P_1B7_PassKneadingMassgLvlSts5, ComIPduSignalRef=Cfg_P_Tx_BODY_LE1_CAN_MCM_P_1B7_PassKneadingMassgLvlSts6, ComIPduSignalRef=Cfg_P_Tx_BODY_LE1_CAN_MCM_P_1B7_PassKneadingMassgTime5, ComIPduSignalRef=Cfg_P_Tx_BODY_LE1_CAN_MCM_P_1B7_PassKneadingMassgSkillsSts6, ComIPduSignalRef=Cfg_P_Tx_BODY_LE1_CAN_MCM_P_1B7_PassKneadingMassgSkillsSts7, ComIPduSignalRef=Cfg_P_Tx_BODY_LE1_CAN_MCM_P_1B7_PassKneadingMassgTime6, ComIPduSignalRef=Cfg_P_Tx_BODY_LE1_CAN_MCM_P_1B7_PassKneadingMassgTime7, ComIPduSignalRef=Cfg_P_Tx_BODY_LE1_CAN_MCM_P_1B7_PassKneadingMassgSkillsSts8, ComIPduSignalRef=Cfg_P_Tx_BODY_LE1_CAN_MCM_P_1B7_PassKneadingMassgLvlSts7, ComIPduSignalRef=Cfg_P_Tx_BODY_LE1_CAN_MCM_P_1B7_PassKneadingMassgLvlSts8, ComIPduSignalRef=Cfg_P_Tx_BODY_LE1_CAN_MCM_P_1B7_PassKneadingMassgTime8
          ComTxIPdu: ComMinimumDelayTime=0, ComTxIPduClearUpdateBit=Confirmation, ComTxIPduUnusedAreasDefault=0x0
            ComTxModeTrue
              ComTxMode: ComTxModeMode=PERIODIC, ComTxModeNumberOfRepetitions=0, ComTxModeRepetitionPeriod=0, ComTxModeTimeOffset=0, ComTxModeTimePeriod=50
        Cfg_P_Tx_BODY_LE1_CAN_MCM_P_1E2: ComIPduDirection=SEND, ComIPduHandleId=1, PduTimeoutSupport=false, ComPduIdRef=Cfg_P_Tx_BODY_LE1_CAN_MCM_P_1E2, ComIPduGroupRef=BODY_LE1_CANTx, ComIPduSignalRef=Cfg_P_Tx_BODY_LE1_CAN_MCM_P_1E2_PassSeatmassgValveSts, ComIPduSignalRef=Cfg_P_Tx_BODY_LE1_CAN_MCM_P_1E2_PassSeatmassgHeatCSts, ComIPduSignalRef=Cfg_P_Tx_BODY_LE1_CAN_MCM_P_1E2_PassSeatLumbarValueSts, ComIPduSignalRef=Cfg_P_Tx_BODY_LE1_CAN_MCM_P_1E2_PassSeatUpperValueSts, ComIPduSignalRef=Cfg_P_Tx_BODY_LE1_CAN_MCM_P_1E2_PassSeatCushionValueSts, ComIPduSignalRef=Cfg_P_Tx_BODY_LE1_CAN_MCM_P_1E2_PassSeatBlosterValueSts, ComIPduSignalRef=Cfg_P_Tx_BODY_LE1_CAN_MCM_P_1E2_PassMassSwitchSts, ComIPduSignalRef=Cfg_P_Tx_BODY_LE1_CAN_MCM_P_1E2_PassSeatLumbarTopPos, ComIPduSignalRef=Cfg_P_Tx_BODY_LE1_CAN_MCM_P_1E2_PassSeatLumbarMidPos, ComIPduSignalRef=Cfg_P_Tx_BODY_LE1_CAN_MCM_P_1E2_PassSeatLumbarBottomPos, ComIPduSignalRef=Cfg_P_Tx_BODY_LE1_CAN_MCM_P_1E2_PassSeatBolsterValueBLPos, ComIPduSignalRef=Cfg_P_Tx_BODY_LE1_CAN_MCM_P_1E2_PassSeatBolsterValueBRPos, ComIPduSignalRef=Cfg_P_Tx_BODY_LE1_CAN_MCM_P_1E2_PassSeatCushionValue6Pos
          ComTxIPdu: ComMinimumDelayTime=0, ComTxIPduClearUpdateBit=Confirmation, ComTxIPduUnusedAreasDefault=0x0
            ComTxModeTrue
              ComTxMode: ComTxModeMode=PERIODIC, ComTxModeNumberOfRepetitions=0, ComTxModeRepetitionPeriod=0, ComTxModeTimeOffset=0, ComTxModeTimePeriod=50
        Cfg_P_Tx_BODY_LE1_CAN_MCM_P_1E3: ComIPduDirection=SEND, ComIPduHandleId=2, PduTimeoutSupport=false, ComPduIdRef=Cfg_P_Tx_BODY_LE1_CAN_MCM_P_1E3, ComIPduGroupRef=BODY_LE1_CANTx, ComIPduSignalRef=Cfg_P_Tx_BODY_LE1_CAN_MCM_P_1E3_PassSeatCushionValue5Pos, ComIPduSignalRef=Cfg_P_Tx_BODY_LE1_CAN_MCM_P_1E3_PassSeatCushionValue4Pos, ComIPduSignalRef=Cfg_P_Tx_BODY_LE1_CAN_MCM_P_1E3_PassSeatCushionValue2Pos, ComIPduSignalRef=Cfg_P_Tx_BODY_LE1_CAN_MCM_P_1E3_PassSeatCushionValue1Pos, ComIPduSignalRef=Cfg_P_Tx_BODY_LE1_CAN_MCM_P_1E3_PassSeatUpperValueLPos, ComIPduSignalRef=Cfg_P_Tx_BODY_LE1_CAN_MCM_P_1E3_PassSeatUpperValueMPos, ComIPduSignalRef=Cfg_P_Tx_BODY_LE1_CAN_MCM_P_1E3_PassSeatUpperValueRPos, ComIPduSignalRef=Cfg_P_Tx_BODY_LE1_CAN_MCM_P_1E3_PassPumpSts
          ComTxIPdu: ComMinimumDelayTime=0, ComTxIPduClearUpdateBit=Confirmation, ComTxIPduUnusedAreasDefault=0x0
            ComTxModeTrue
              ComTxMode: ComTxModeMode=PERIODIC, ComTxModeNumberOfRepetitions=0, ComTxModeRepetitionPeriod=0, ComTxModeTimeOffset=0, ComTxModeTimePeriod=50
        Cfg_P_Tx_BODY_LE1_CAN_MCM_P_1E4: ComIPduDirection=SEND, ComIPduHandleId=3, PduTimeoutSupport=false, ComPduIdRef=Cfg_P_Tx_BODY_LE1_CAN_MCM_P_1E4, ComIPduGroupRef=BODY_LE1_CANTx, ComIPduSignalRef=Cfg_P_Tx_BODY_LE1_CAN_MCM_P_1E4_PassKneadingMassgSkillsSts9, ComIPduSignalRef=Cfg_P_Tx_BODY_LE1_CAN_MCM_P_1E4_PassLumControlSts, ComIPduSignalRef=Cfg_P_Tx_BODY_LE1_CAN_MCM_P_1E4_PassLumSwitchSts, ComIPduSignalRef=Cfg_P_Tx_BODY_LE1_CAN_MCM_P_1E4_PassSystemFailr, ComIPduSignalRef=Cfg_P_Tx_BODY_LE1_CAN_MCM_P_1E4_PassSeatMassFailr, ComIPduSignalRef=Cfg_P_Tx_BODY_LE1_CAN_MCM_P_1E4_PassSeatCushionValue3Pos, ComIPduSignalRef=Cfg_P_Tx_BODY_LE1_CAN_MCM_P_1E4_PassLumbarTopWorkSts, ComIPduSignalRef=Cfg_P_Tx_BODY_LE1_CAN_MCM_P_1E4_PassLumbarMidWorkSts, ComIPduSignalRef=Cfg_P_Tx_BODY_LE1_CAN_MCM_P_1E4_PassLumbarBottomWorkSts, ComIPduSignalRef=Cfg_P_Tx_BODY_LE1_CAN_MCM_P_1E4_PassHeat1Sts, ComIPduSignalRef=Cfg_P_Tx_BODY_LE1_CAN_MCM_P_1E4_PassHeat2Sts, ComIPduSignalRef=Cfg_P_Tx_BODY_LE1_CAN_MCM_P_1E4_PassHeat3Sts, ComIPduSignalRef=Cfg_P_Tx_BODY_LE1_CAN_MCM_P_1E4_PassHeat4Sts, ComIPduSignalRef=Cfg_P_Tx_BODY_LE1_CAN_MCM_P_1E4_PassHeat5Sts, ComIPduSignalRef=Cfg_P_Tx_BODY_LE1_CAN_MCM_P_1E4_PassHeat6Sts, ComIPduSignalRef=Cfg_P_Tx_BODY_LE1_CAN_MCM_P_1E4_PassHeat5ErrSts, ComIPduSignalRef=Cfg_P_Tx_BODY_LE1_CAN_MCM_P_1E4_PassKneadingMassgLvlSts9, ComIPduSignalRef=Cfg_P_Tx_BODY_LE1_CAN_MCM_P_1E4_PassKneadingMassgTime9
          ComTxIPdu: ComMinimumDelayTime=0, ComTxIPduClearUpdateBit=Confirmation, ComTxIPduUnusedAreasDefault=0x0
            ComTxModeTrue
              ComTxMode: ComTxModeMode=PERIODIC, ComTxModeNumberOfRepetitions=0, ComTxModeRepetitionPeriod=0, ComTxModeTimeOffset=0, ComTxModeTimePeriod=50
        Cfg_P_Tx_BODY_LE1_CAN_MCM_P_1EB: ComIPduDirection=SEND, ComIPduHandleId=4, PduTimeoutSupport=false, ComPduIdRef=Cfg_P_Tx_BODY_LE1_CAN_MCM_P_1EB, ComIPduGroupRef=BODY_LE1_CANTx, ComIPduSignalRef=Cfg_P_Tx_BODY_LE1_CAN_MCM_P_1EB_PassKneadingMassgTime10, ComIPduSignalRef=Cfg_P_Tx_BODY_LE1_CAN_MCM_P_1EB_PassKneadingMassgSkillsSts10, ComIPduSignalRef=Cfg_P_Tx_BODY_LE1_CAN_MCM_P_1EB_PassKneadingMassgLvlSts10, ComIPduSignalRef=Cfg_P_Tx_BODY_LE1_CAN_MCM_P_1EB_PassMassageHeatNTC1, ComIPduSignalRef=Cfg_P_Tx_BODY_LE1_CAN_MCM_P_1EB_PassMassageHeatNTC2, ComIPduSignalRef=Cfg_P_Tx_BODY_LE1_CAN_MCM_P_1EB_PassMassageHeatNTC3, ComIPduSignalRef=Cfg_P_Tx_BODY_LE1_CAN_MCM_P_1EB_PassMassageHeatNTC4, ComIPduSignalRef=Cfg_P_Tx_BODY_LE1_CAN_MCM_P_1EB_PassMassageHeatNTC5, ComIPduSignalRef=Cfg_P_Tx_BODY_LE1_CAN_MCM_P_1EB_PassMassageHeatNTC6
          ComTxIPdu: ComMinimumDelayTime=0, ComTxIPduClearUpdateBit=Confirmation, ComTxIPduUnusedAreasDefault=0x0
            ComTxModeTrue
              ComTxMode: ComTxModeMode=PERIODIC, ComTxModeNumberOfRepetitions=0, ComTxModeRepetitionPeriod=0, ComTxModeTimeOffset=0, ComTxModeTimePeriod=50
        Cfg_P_Tx_BODY_LE1_CAN_MCM_P_1ED: ComIPduDirection=SEND, ComIPduHandleId=5, PduTimeoutSupport=false, ComPduIdRef=Cfg_P_Tx_BODY_LE1_CAN_MCM_P_1ED, ComIPduGroupRef=BODY_LE1_CANTx, ComIPduSignalRef=Cfg_P_Tx_BODY_LE1_CAN_MCM_P_1ED_PassMassageHeatNTC7, ComIPduSignalRef=Cfg_P_Tx_BODY_LE1_CAN_MCM_P_1ED_PassMassageHeatNTC8, ComIPduSignalRef=Cfg_P_Tx_BODY_LE1_CAN_MCM_P_1ED_PassMassageHeatNTC9, ComIPduSignalRef=Cfg_P_Tx_BODY_LE1_CAN_MCM_P_1ED_PassMassageHeatNTC10, ComIPduSignalRef=Cfg_P_Tx_BODY_LE1_CAN_MCM_P_1ED_PassMassageHeatNTC11, ComIPduSignalRef=Cfg_P_Tx_BODY_LE1_CAN_MCM_P_1ED_PassMassageHeatNTC12
          ComTxIPdu: ComMinimumDelayTime=0, ComTxIPduClearUpdateBit=Confirmation, ComTxIPduUnusedAreasDefault=0x0
            ComTxModeTrue
              ComTxMode: ComTxModeMode=PERIODIC, ComTxModeNumberOfRepetitions=0, ComTxModeRepetitionPeriod=0, ComTxModeTimeOffset=0, ComTxModeTimePeriod=50
        Cfg_P_Rx_BODY_LE1_CAN_BCU_11E: ComIPduDirection=RECEIVE, ComIPduHandleId=0, PduTimeoutSupport=false, ComPduIdRef=Cfg_P_Rx_BODY_LE1_CAN_BCU_11E, ComIPduGroupRef=BODY_LE1_CANRx, ComIPduSignalRef=Cfg_P_Rx_BODY_LE1_CAN_BCU_11E_VehSpdSts_Rdnt1, ComIPduSignalRef=Cfg_P_Rx_BODY_LE1_CAN_BCU_11E_VehSpd_Rdnt1
        Cfg_P_Rx_BODY_LE1_CAN_ZONE_13C: ComIPduDirection=RECEIVE, ComIPduHandleId=1, PduTimeoutSupport=true, PduFirstTimeoutValue=500, PduTimeoutValue=500, ComPduIdRef=Cfg_P_Rx_BODY_LE1_CAN_ZONE_13C, ComIPduGroupRef=BODY_LE1_CANRx, ComIPduSignalRef=Cfg_P_Rx_BODY_LE1_CAN_ZONE_13C_ZONE_13C_CRC, ComIPduSignalRef=Cfg_P_Rx_BODY_LE1_CAN_ZONE_13C_ZONE_13C_MsgCntr, ComIPduSignalRef=Cfg_P_Rx_BODY_LE1_CAN_ZONE_13C_OperatorState_SrvSts, ComIPduSignalRef=Cfg_P_Rx_BODY_LE1_CAN_ZONE_13C_DrvState_SrvSts, ComIPduSignalRef=Cfg_P_Rx_BODY_LE1_CAN_ZONE_13C_VehStateDetailed_SrvSts, ComIPduSignalRef=Cfg_P_Rx_BODY_LE1_CAN_ZONE_13C_DrvState, ComIPduSignalRef=Cfg_P_Rx_BODY_LE1_CAN_ZONE_13C_OperatorState, ComIPduSignalRef=Cfg_P_Rx_BODY_LE1_CAN_ZONE_13C_VehStateDetailed, ComIPduSignalRef=Cfg_P_Rx_BODY_LE1_CAN_ZONE_13C_VehModeDef
        Cfg_P_Rx_BODY_LE1_CAN_ZONE_MCM_06: ComIPduDirection=RECEIVE, ComIPduHandleId=2, PduTimeoutSupport=false, ComPduIdRef=Cfg_P_Rx_BODY_LE1_CAN_ZONE_MCM_06, ComIPduGroupRef=BODY_LE1_CANRx, ComIPduSignalRef=Cfg_P_Rx_BODY_LE1_CAN_ZONE_MCM_06_PassKneadingMassgSkillsCmd5, ComIPduSignalRef=Cfg_P_Rx_BODY_LE1_CAN_ZONE_MCM_06_PassKneadingMassgTimesCmd5, ComIPduSignalRef=Cfg_P_Rx_BODY_LE1_CAN_ZONE_MCM_06_PassKneadingMassgLvlCmd5, ComIPduSignalRef=Cfg_P_Rx_BODY_LE1_CAN_ZONE_MCM_06_PassKneadingMassgLvlCmd6, ComIPduSignalRef=Cfg_P_Rx_BODY_LE1_CAN_ZONE_MCM_06_PassKneadingMassgLvlCmd7, ComIPduSignalRef=Cfg_P_Rx_BODY_LE1_CAN_ZONE_MCM_06_PassKneadingMassgLvlCmd8, ComIPduSignalRef=Cfg_P_Rx_BODY_LE1_CAN_ZONE_MCM_06_PassKneadingMassgSkillsCmd6, ComIPduSignalRef=Cfg_P_Rx_BODY_LE1_CAN_ZONE_MCM_06_PassKneadingMassgTimesCmd6, ComIPduSignalRef=Cfg_P_Rx_BODY_LE1_CAN_ZONE_MCM_06_PassKneadingMassgSkillsCmd7, ComIPduSignalRef=Cfg_P_Rx_BODY_LE1_CAN_ZONE_MCM_06_PassKneadingMassgTimesCmd7, ComIPduSignalRef=Cfg_P_Rx_BODY_LE1_CAN_ZONE_MCM_06_PassKneadingMassgSkillsCmd8, ComIPduSignalRef=Cfg_P_Rx_BODY_LE1_CAN_ZONE_MCM_06_PassKneadingMassgTimesCmd8, ComIPduSignalRef=Cfg_P_Rx_BODY_LE1_CAN_ZONE_MCM_06_PassKneadingMassgSkillsCmd9, ComIPduSignalRef=Cfg_P_Rx_BODY_LE1_CAN_ZONE_MCM_06_PassKneadingMassgTimesCmd9, ComIPduSignalRef=Cfg_P_Rx_BODY_LE1_CAN_ZONE_MCM_06_PassKneadingMassgSkillsCmd10, ComIPduSignalRef=Cfg_P_Rx_BODY_LE1_CAN_ZONE_MCM_06_PassKneadingMassgTimesCmd10, ComIPduSignalRef=Cfg_P_Rx_BODY_LE1_CAN_ZONE_MCM_06_PassKneadingMassgLvlCmd9, ComIPduSignalRef=Cfg_P_Rx_BODY_LE1_CAN_ZONE_MCM_06_PassKneadingMassgLvlCmd10
        Cfg_P_Rx_BODY_LE1_CAN_ZONE_1CF: ComIPduDirection=RECEIVE, ComIPduHandleId=3, PduTimeoutSupport=false, ComPduIdRef=Cfg_P_Rx_BODY_LE1_CAN_ZONE_1CF, ComIPduGroupRef=BODY_LE1_CANRx, ComIPduSignalRef=Cfg_P_Rx_BODY_LE1_CAN_ZONE_1CF_PassHeat1_pct, ComIPduSignalRef=Cfg_P_Rx_BODY_LE1_CAN_ZONE_1CF_PassHeat2_pct, ComIPduSignalRef=Cfg_P_Rx_BODY_LE1_CAN_ZONE_1CF_PassHeat3_pct, ComIPduSignalRef=Cfg_P_Rx_BODY_LE1_CAN_ZONE_1CF_PassHeat4_pct, ComIPduSignalRef=Cfg_P_Rx_BODY_LE1_CAN_ZONE_1CF_PassHeat5_pct, ComIPduSignalRef=Cfg_P_Rx_BODY_LE1_CAN_ZONE_1CF_PassHeat6_pct
        Cfg_P_Rx_BODY_LE1_CAN_Zone_FL_MCM_03: ComIPduDirection=RECEIVE, ComIPduHandleId=4, PduTimeoutSupport=true, PduFirstTimeoutValue=500, PduTimeoutValue=500, ComPduIdRef=Cfg_P_Rx_BODY_LE1_CAN_Zone_FL_MCM_03, ComIPduGroupRef=BODY_LE1_CANRx, ComIPduSignalRef=Cfg_P_Rx_BODY_LE1_CAN_Zone_FL_MCM_03_PassSeatmassgValve1Cmd, ComIPduSignalRef=Cfg_P_Rx_BODY_LE1_CAN_Zone_FL_MCM_03_PassSeatmassgValve2Cmd, ComIPduSignalRef=Cfg_P_Rx_BODY_LE1_CAN_Zone_FL_MCM_03_PassSeatmassgValve3Cmd, ComIPduSignalRef=Cfg_P_Rx_BODY_LE1_CAN_Zone_FL_MCM_03_PassSeatmassgValve4Cmd, ComIPduSignalRef=Cfg_P_Rx_BODY_LE1_CAN_Zone_FL_MCM_03_PassSeatmassgValve5Cmd, ComIPduSignalRef=Cfg_P_Rx_BODY_LE1_CAN_Zone_FL_MCM_03_PassSeatmassgValve6Cmd, ComIPduSignalRef=Cfg_P_Rx_BODY_LE1_CAN_Zone_FL_MCM_03_PassSeatmassgValve7Cmd, ComIPduSignalRef=Cfg_P_Rx_BODY_LE1_CAN_Zone_FL_MCM_03_PassSeatmassgValve8Cmd, ComIPduSignalRef=Cfg_P_Rx_BODY_LE1_CAN_Zone_FL_MCM_03_PassSeatmassgValve9Cmd, ComIPduSignalRef=Cfg_P_Rx_BODY_LE1_CAN_Zone_FL_MCM_03_PassSeatmassgValve10Cmd, ComIPduSignalRef=Cfg_P_Rx_BODY_LE1_CAN_Zone_FL_MCM_03_PassSeatmassgValve11Cmd, ComIPduSignalRef=Cfg_P_Rx_BODY_LE1_CAN_Zone_FL_MCM_03_PassSeatmassgValve12Cmd, ComIPduSignalRef=Cfg_P_Rx_BODY_LE1_CAN_Zone_FL_MCM_03_PassSeatmassgHeat1Cmd, ComIPduSignalRef=Cfg_P_Rx_BODY_LE1_CAN_Zone_FL_MCM_03_PassSeatmassgHeat2Cmd, ComIPduSignalRef=Cfg_P_Rx_BODY_LE1_CAN_Zone_FL_MCM_03_PassSeatmassgHeat3Cmd, ComIPduSignalRef=Cfg_P_Rx_BODY_LE1_CAN_Zone_FL_MCM_03_PassSeatmassgHeat4Cmd, ComIPduSignalRef=Cfg_P_Rx_BODY_LE1_CAN_Zone_FL_MCM_03_PassSeatmassgHeat5Cmd, ComIPduSignalRef=Cfg_P_Rx_BODY_LE1_CAN_Zone_FL_MCM_03_PassSeatmassgHeat6Cmd, ComIPduSignalRef=Cfg_P_Rx_BODY_LE1_CAN_Zone_FL_MCM_03_PassSeatmassgHeat7Cmd, ComIPduSignalRef=Cfg_P_Rx_BODY_LE1_CAN_Zone_FL_MCM_03_PassSeatmassgHeat8Cmd, ComIPduSignalRef=Cfg_P_Rx_BODY_LE1_CAN_Zone_FL_MCM_03_PassSeatmassgHeat9Cmd, ComIPduSignalRef=Cfg_P_Rx_BODY_LE1_CAN_Zone_FL_MCM_03_PassSeatmassgHeat10Cmd, ComIPduSignalRef=Cfg_P_Rx_BODY_LE1_CAN_Zone_FL_MCM_03_PassSeatmassgHeat11Cmd, ComIPduSignalRef=Cfg_P_Rx_BODY_LE1_CAN_Zone_FL_MCM_03_PassSeatmassgHeat12Cmd, ComIPduSignalRef=Cfg_P_Rx_BODY_LE1_CAN_Zone_FL_MCM_03_PassSeatLumbarTopValue1Cmd, ComIPduSignalRef=Cfg_P_Rx_BODY_LE1_CAN_Zone_FL_MCM_03_PassSeatLumbarMidValue2Cmd, ComIPduSignalRef=Cfg_P_Rx_BODY_LE1_CAN_Zone_FL_MCM_03_PassSeatLumbarBottomValue3Cmd, ComIPduSignalRef=Cfg_P_Rx_BODY_LE1_CAN_Zone_FL_MCM_03_PassSeatBolsterValueBLCmd, ComIPduSignalRef=Cfg_P_Rx_BODY_LE1_CAN_Zone_FL_MCM_03_PassSeatBolsterValueBRCmd, ComIPduSignalRef=Cfg_P_Rx_BODY_LE1_CAN_Zone_FL_MCM_03_PassSeatCushionValue6Cmd, ComIPduSignalRef=Cfg_P_Rx_BODY_LE1_CAN_Zone_FL_MCM_03_PassSeatCushionValue5Cmd, ComIPduSignalRef=Cfg_P_Rx_BODY_LE1_CAN_Zone_FL_MCM_03_PassSeatCushionValue4Cmd
        Cfg_P_Rx_BODY_LE1_CAN_Zone_FL_MCM_04: ComIPduDirection=RECEIVE, ComIPduHandleId=5, PduTimeoutSupport=true, PduFirstTimeoutValue=500, PduTimeoutValue=500, ComPduIdRef=Cfg_P_Rx_BODY_LE1_CAN_Zone_FL_MCM_04, ComIPduGroupRef=BODY_LE1_CANRx, ComIPduSignalRef=Cfg_P_Rx_BODY_LE1_CAN_Zone_FL_MCM_04_PassPumpCmd, ComIPduSignalRef=Cfg_P_Rx_BODY_LE1_CAN_Zone_FL_MCM_04_PassSeatUpperValueLCmd, ComIPduSignalRef=Cfg_P_Rx_BODY_LE1_CAN_Zone_FL_MCM_04_PassSeatUpperValueMCmd, ComIPduSignalRef=Cfg_P_Rx_BODY_LE1_CAN_Zone_FL_MCM_04_PassSeatUpperValueRCmd, ComIPduSignalRef=Cfg_P_Rx_BODY_LE1_CAN_Zone_FL_MCM_04_PassSeatCushionValue2Cmd, ComIPduSignalRef=Cfg_P_Rx_BODY_LE1_CAN_Zone_FL_MCM_04_PassSeatCushionValue3Cmd, ComIPduSignalRef=Cfg_P_Rx_BODY_LE1_CAN_Zone_FL_MCM_04_PassSeatCushionValue1Cmd
        Cfg_P_Rx_BODY_LE1_CAN_ZONE_2EF: ComIPduDirection=RECEIVE, ComIPduHandleId=6, PduTimeoutSupport=false, ComPduIdRef=Cfg_P_Rx_BODY_LE1_CAN_ZONE_2EF, ComIPduGroupRef=BODY_LE1_CANRx, ComIPduSignalRef=Cfg_P_Rx_BODY_LE1_CAN_ZONE_2EF_BattVolt_LBMR
        Cfg_P_Rx_BODY_LE1_CAN_ZONE_3A9: ComIPduDirection=RECEIVE, ComIPduHandleId=7, PduTimeoutSupport=true, PduFirstTimeoutValue=500, PduTimeoutValue=500, ComPduIdRef=Cfg_P_Rx_BODY_LE1_CAN_ZONE_3A9, ComIPduGroupRef=BODY_LE1_CANRx, ComIPduSignalRef=Cfg_P_Rx_BODY_LE1_CAN_ZONE_3A9_VehOdometer
        Cfg_P_Rx_BODY_LE1_CAN_ZONE_3B2: ComIPduDirection=RECEIVE, ComIPduHandleId=8, PduTimeoutSupport=true, PduFirstTimeoutValue=500, PduTimeoutValue=6000, ComPduIdRef=Cfg_P_Rx_BODY_LE1_CAN_ZONE_3B2, ComIPduGroupRef=BODY_LE1_CANRx, ComIPduSignalRef=Cfg_P_Rx_BODY_LE1_CAN_ZONE_3B2_Yr, ComIPduSignalRef=Cfg_P_Rx_BODY_LE1_CAN_ZONE_3B2_Mth, ComIPduSignalRef=Cfg_P_Rx_BODY_LE1_CAN_ZONE_3B2_Day, ComIPduSignalRef=Cfg_P_Rx_BODY_LE1_CAN_ZONE_3B2_Hr, ComIPduSignalRef=Cfg_P_Rx_BODY_LE1_CAN_ZONE_3B2_Min, ComIPduSignalRef=Cfg_P_Rx_BODY_LE1_CAN_ZONE_3B2_Sec, ComIPduSignalRef=Cfg_P_Rx_BODY_LE1_CAN_ZONE_3B2_MSec
        Cfg_P_Rx_BODY_LE1_CAN_ZONE_PNC: ComIPduDirection=RECEIVE, ComIPduHandleId=9, PduTimeoutSupport=false, ComPduIdRef=Cfg_P_Rx_BODY_LE1_CAN_ZONE_PNC, ComIPduGroupRef=BODY_LE1_CANRx, ComIPduSignalRef=Cfg_P_Rx_BODY_LE1_CAN_ZONE_PNC_PNC_DFT, ComIPduSignalRef=Cfg_P_Rx_BODY_LE1_CAN_ZONE_PNC_PNC1_Sts, ComIPduSignalRef=Cfg_P_Rx_BODY_LE1_CAN_ZONE_PNC_PNC2_Sts, ComIPduSignalRef=Cfg_P_Rx_BODY_LE1_CAN_ZONE_PNC_PNC3_Sts, ComIPduSignalRef=Cfg_P_Rx_BODY_LE1_CAN_ZONE_PNC_PNC4_Sts, ComIPduSignalRef=Cfg_P_Rx_BODY_LE1_CAN_ZONE_PNC_PNC5_Sts, ComIPduSignalRef=Cfg_P_Rx_BODY_LE1_CAN_ZONE_PNC_PNC6_Sts, ComIPduSignalRef=Cfg_P_Rx_BODY_LE1_CAN_ZONE_PNC_PNC7_Sts, ComIPduSignalRef=Cfg_P_Rx_BODY_LE1_CAN_ZONE_PNC_PNC8_Sts, ComIPduSignalRef=Cfg_P_Rx_BODY_LE1_CAN_ZONE_PNC_PNC9_Sts, ComIPduSignalRef=Cfg_P_Rx_BODY_LE1_CAN_ZONE_PNC_PNC10_Sts, ComIPduSignalRef=Cfg_P_Rx_BODY_LE1_CAN_ZONE_PNC_PNC11_Sts, ComIPduSignalRef=Cfg_P_Rx_BODY_LE1_CAN_ZONE_PNC_PNC12_Sts, ComIPduSignalRef=Cfg_P_Rx_BODY_LE1_CAN_ZONE_PNC_PNC13_Sts, ComIPduSignalRef=Cfg_P_Rx_BODY_LE1_CAN_ZONE_PNC_PNC14_Sts, ComIPduSignalRef=Cfg_P_Rx_BODY_LE1_CAN_ZONE_PNC_PNC15_Sts, ComIPduSignalRef=Cfg_P_Rx_BODY_LE1_CAN_ZONE_PNC_PNC16_Sts, ComIPduSignalRef=Cfg_P_Rx_BODY_LE1_CAN_ZONE_PNC_PNC17_Sts, ComIPduSignalRef=Cfg_P_Rx_BODY_LE1_CAN_ZONE_PNC_PNC18_Sts, ComIPduSignalRef=Cfg_P_Rx_BODY_LE1_CAN_ZONE_PNC_PNC19_Sts, ComIPduSignalRef=Cfg_P_Rx_BODY_LE1_CAN_ZONE_PNC_PNC20_Sts, ComIPduSignalRef=Cfg_P_Rx_BODY_LE1_CAN_ZONE_PNC_PNC21_Sts, ComIPduSignalRef=Cfg_P_Rx_BODY_LE1_CAN_ZONE_PNC_PNC22_Sts, ComIPduSignalRef=Cfg_P_Rx_BODY_LE1_CAN_ZONE_PNC_PNC23_Sts, ComIPduSignalRef=Cfg_P_Rx_BODY_LE1_CAN_ZONE_PNC_PNC24_Sts, ComIPduSignalRef=Cfg_P_Rx_BODY_LE1_CAN_ZONE_PNC_PNC25_Sts, ComIPduSignalRef=Cfg_P_Rx_BODY_LE1_CAN_ZONE_PNC_PNC26_Sts, ComIPduSignalRef=Cfg_P_Rx_BODY_LE1_CAN_ZONE_PNC_PNC27_Sts, ComIPduSignalRef=Cfg_P_Rx_BODY_LE1_CAN_ZONE_PNC_PNC28_Sts, ComIPduSignalRef=Cfg_P_Rx_BODY_LE1_CAN_ZONE_PNC_PNC29_Sts, ComIPduSignalRef=Cfg_P_Rx_BODY_LE1_CAN_ZONE_PNC_PNC30_Sts, ComIPduSignalRef=Cfg_P_Rx_BODY_LE1_CAN_ZONE_PNC_PNC31_Sts, ComIPduSignalRef=Cfg_P_Rx_BODY_LE1_CAN_ZONE_PNC_PNC32_Sts, ComIPduSignalRef=Cfg_P_Rx_BODY_LE1_CAN_ZONE_PNC_PNC33_Sts, ComIPduSignalRef=Cfg_P_Rx_BODY_LE1_CAN_ZONE_PNC_PNC34_Sts, ComIPduSignalRef=Cfg_P_Rx_BODY_LE1_CAN_ZONE_PNC_PNC35_Sts, ComIPduSignalRef=Cfg_P_Rx_BODY_LE1_CAN_ZONE_PNC_PNC36_Sts, ComIPduSignalRef=Cfg_P_Rx_BODY_LE1_CAN_ZONE_PNC_PNC37_Sts, ComIPduSignalRef=Cfg_P_Rx_BODY_LE1_CAN_ZONE_PNC_PNC38_Sts, ComIPduSignalRef=Cfg_P_Rx_BODY_LE1_CAN_ZONE_PNC_PNC39_Sts, ComIPduSignalRef=Cfg_P_Rx_BODY_LE1_CAN_ZONE_PNC_PNC40_Sts, ComIPduSignalRef=Cfg_P_Rx_BODY_LE1_CAN_ZONE_PNC_PNC41_Sts, ComIPduSignalRef=Cfg_P_Rx_BODY_LE1_CAN_ZONE_PNC_PNC43_Sts, ComIPduSignalRef=Cfg_P_Rx_BODY_LE1_CAN_ZONE_PNC_PNC42_Sts, ComIPduSignalRef=Cfg_P_Rx_BODY_LE1_CAN_ZONE_PNC_PNC44_Sts, ComIPduSignalRef=Cfg_P_Rx_BODY_LE1_CAN_ZONE_PNC_PNC45_Sts, ComIPduSignalRef=Cfg_P_Rx_BODY_LE1_CAN_ZONE_PNC_PNC46_Sts, ComIPduSignalRef=Cfg_P_Rx_BODY_LE1_CAN_ZONE_PNC_PNC47_Sts, ComIPduSignalRef=Cfg_P_Rx_BODY_LE1_CAN_ZONE_PNC_PNC48_Sts
        Cfg_P_Rx_BODY_LE1_CAN_VC_Data_5E0: ComIPduDirection=RECEIVE, ComIPduHandleId=10, PduTimeoutSupport=false, ComPduIdRef=Cfg_P_Rx_BODY_LE1_CAN_VC_Data_5E0, ComIPduGroupRef=BODY_LE1_CANRx, ComIPduSignalRef=Cfg_P_Rx_BODY_LE1_CAN_VC_Data_5E0_VC_Data_5E0_CRC, ComIPduSignalRef=Cfg_P_Rx_BODY_LE1_CAN_VC_Data_5E0_VC_Data_5E0_MsgCntr, ComIPduSignalRef=Cfg_P_Rx_BODY_LE1_CAN_VC_Data_5E0_VC_Data_5E0_Payload
      BODY_LE1_CANTx (ComIPduGroup): ComIPduGroupHandleId=0, UserDefine=false, IsRx=false
      BODY_LE1_CANRx (ComIPduGroup): ComIPduGroupHandleId=1, UserDefine=false, IsRx=true
      201 x ComSignal, all with ComErrorNotification=, ComInvalidNotification=, ComDataInvalidAction=NONE, DataInvalidSupport=false, ComRxDataTimeoutAction=NONE, ComSignalDataInvalidValue=, ComNotificationEnable=true, ComSignalEndianness=BIG_ENDIAN, ComSignalInitValue=0, ComTimeoutSubstitutionValue=0, ComSignalLength=0, ComTransferProperty=PENDING, ComUpdateBitPosition=, UserDefine=false, inputFile=, SomeIpSignalMessageType=, isMSignal=false:
        Cfg_P_Tx_BODY_LE1_CAN_MCM_P_1B7_PassKneadingMassgSkillsSts5: ComNotification=Com_CbkTxAck_Cfg_P_Tx_BODY_LE1_CAN_MCM_P_1B7_PassKneadingMassgSkillsSts5, ComTimeoutNotification=, ComBitPosition=3, ComBitSize=4, ComFirstTimeout=0, ComHandleId=0, ComSignalInActiveValue=0, DataTimeoutSupport=false, ComTimeout=0, ComSignalType=UINT8, Direction=Tx, InputName=PassKneadingMassgSkillsSts5, offset=0, factor=1, enumValue=, unitName=, max=15, min=0, compuMethodType=, ComSystemTemplateSystemSignalRef=Cfg_P_Tx_BODY_LE1_CAN_MCM_P_1B7
        Cfg_P_Tx_BODY_LE1_CAN_MCM_P_1B7_PassKneadingMassgLvlSts5: ComNotification=Com_CbkTxAck_Cfg_P_Tx_BODY_LE1_CAN_MCM_P_1B7_PassKneadingMassgLvlSts5, ComTimeoutNotification=, ComBitPosition=5, ComBitSize=2, ComFirstTimeout=0, ComHandleId=1, ComSignalInActiveValue=0, DataTimeoutSupport=false, ComTimeout=0, ComSignalType=UINT8, Direction=Tx, InputName=PassKneadingMassgLvlSts5, offset=0, factor=1, enumValue=0%Idle&1%intensity 1&2%intensity 2, unitName=, max=3, min=0, compuMethodType=, ComSystemTemplateSystemSignalRef=Cfg_P_Tx_BODY_LE1_CAN_MCM_P_1B7
        Cfg_P_Tx_BODY_LE1_CAN_MCM_P_1B7_PassKneadingMassgLvlSts6: ComNotification=Com_CbkTxAck_Cfg_P_Tx_BODY_LE1_CAN_MCM_P_1B7_PassKneadingMassgLvlSts6, ComTimeoutNotification=, ComBitPosition=7, ComBitSize=2, ComFirstTimeout=0, ComHandleId=2, ComSignalInActiveValue=0, DataTimeoutSupport=false, ComTimeout=0, ComSignalType=UINT8, Direction=Tx, InputName=PassKneadingMassgLvlSts6, offset=0, factor=1, enumValue=0%Idle&1%intensity 1&2%intensity 2, unitName=, max=3, min=0, compuMethodType=, ComSystemTemplateSystemSignalRef=Cfg_P_Tx_BODY_LE1_CAN_MCM_P_1B7
        Cfg_P_Tx_BODY_LE1_CAN_MCM_P_1B7_PassKneadingMassgTime5: ComNotification=Com_CbkTxAck_Cfg_P_Tx_BODY_LE1_CAN_MCM_P_1B7_PassKneadingMassgTime5, ComTimeoutNotification=, ComBitPosition=15, ComBitSize=8, ComFirstTimeout=0, ComHandleId=3, ComSignalInActiveValue=0, DataTimeoutSupport=false, ComTimeout=0, ComSignalType=UINT8, Direction=Tx, InputName=PassKneadingMassgTime5, offset=0, factor=0.1, enumValue=, unitName=, max=25.5, min=0, compuMethodType=INTERNALTOPHYS, ComSystemTemplateSystemSignalRef=Cfg_P_Tx_BODY_LE1_CAN_MCM_P_1B7
        Cfg_P_Tx_BODY_LE1_CAN_MCM_P_1B7_PassKneadingMassgSkillsSts6: ComNotification=Com_CbkTxAck_Cfg_P_Tx_BODY_LE1_CAN_MCM_P_1B7_PassKneadingMassgSkillsSts6, ComTimeoutNotification=, ComBitPosition=19, ComBitSize=4, ComFirstTimeout=0, ComHandleId=4, ComSignalInActiveValue=0, DataTimeoutSupport=false, ComTimeout=0, ComSignalType=UINT8, Direction=Tx, InputName=PassKneadingMassgSkillsSts6, offset=0, factor=1, enumValue=, unitName=, max=15, min=0, compuMethodType=, ComSystemTemplateSystemSignalRef=Cfg_P_Tx_BODY_LE1_CAN_MCM_P_1B7
        Cfg_P_Tx_BODY_LE1_CAN_MCM_P_1B7_PassKneadingMassgSkillsSts7: ComNotification=Com_CbkTxAck_Cfg_P_Tx_BODY_LE1_CAN_MCM_P_1B7_PassKneadingMassgSkillsSts7, ComTimeoutNotification=, ComBitPosition=23, ComBitSize=4, ComFirstTimeout=0, ComHandleId=5, ComSignalInActiveValue=0, DataTimeoutSupport=false, ComTimeout=0, ComSignalType=UINT8, Direction=Tx, InputName=PassKneadingMassgSkillsSts7, offset=0, factor=1, enumValue=, unitName=, max=15, min=0, compuMethodType=, ComSystemTemplateSystemSignalRef=Cfg_P_Tx_BODY_LE1_CAN_MCM_P_1B7
        Cfg_P_Tx_BODY_LE1_CAN_MCM_P_1B7_PassKneadingMassgTime6: ComNotification=Com_CbkTxAck_Cfg_P_Tx_BODY_LE1_CAN_MCM_P_1B7_PassKneadingMassgTime6, ComTimeoutNotification=, ComBitPosition=31, ComBitSize=8, ComFirstTimeout=0, ComHandleId=6, ComSignalInActiveValue=0, DataTimeoutSupport=false, ComTimeout=0, ComSignalType=UINT8, Direction=Tx, InputName=PassKneadingMassgTime6, offset=0, factor=0.1, enumValue=, unitName=, max=25.5, min=0, compuMethodType=INTERNALTOPHYS, ComSystemTemplateSystemSignalRef=Cfg_P_Tx_BODY_LE1_CAN_MCM_P_1B7
        Cfg_P_Tx_BODY_LE1_CAN_MCM_P_1B7_PassKneadingMassgTime7: ComNotification=Com_CbkTxAck_Cfg_P_Tx_BODY_LE1_CAN_MCM_P_1B7_PassKneadingMassgTime7, ComTimeoutNotification=, ComBitPosition=39, ComBitSize=8, ComFirstTimeout=0, ComHandleId=7, ComSignalInActiveValue=0, DataTimeoutSupport=false, ComTimeout=0, ComSignalType=UINT8, Direction=Tx, InputName=PassKneadingMassgTime7, offset=0, factor=0.1, enumValue=, unitName=, max=25.5, min=0, compuMethodType=INTERNALTOPHYS, ComSystemTemplateSystemSignalRef=Cfg_P_Tx_BODY_LE1_CAN_MCM_P_1B7
        Cfg_P_Tx_BODY_LE1_CAN_MCM_P_1B7_PassKneadingMassgSkillsSts8: ComNotification=Com_CbkTxAck_Cfg_P_Tx_BODY_LE1_CAN_MCM_P_1B7_PassKneadingMassgSkillsSts8, ComTimeoutNotification=, ComBitPosition=43, ComBitSize=4, ComFirstTimeout=0, ComHandleId=8, ComSignalInActiveValue=0, DataTimeoutSupport=false, ComTimeout=0, ComSignalType=UINT8, Direction=Tx, InputName=PassKneadingMassgSkillsSts8, offset=0, factor=1, enumValue=, unitName=, max=15, min=0, compuMethodType=, ComSystemTemplateSystemSignalRef=Cfg_P_Tx_BODY_LE1_CAN_MCM_P_1B7
        Cfg_P_Tx_BODY_LE1_CAN_MCM_P_1B7_PassKneadingMassgLvlSts7: ComNotification=Com_CbkTxAck_Cfg_P_Tx_BODY_LE1_CAN_MCM_P_1B7_PassKneadingMassgLvlSts7, ComTimeoutNotification=, ComBitPosition=45, ComBitSize=2, ComFirstTimeout=0, ComHandleId=9, ComSignalInActiveValue=0, DataTimeoutSupport=false, ComTimeout=0, ComSignalType=UINT8, Direction=Tx, InputName=PassKneadingMassgLvlSts7, offset=0, factor=1, enumValue=0%Idle&1%intensity 1&2%intensity 2, unitName=, max=3, min=0, compuMethodType=, ComSystemTemplateSystemSignalRef=Cfg_P_Tx_BODY_LE1_CAN_MCM_P_1B7
        Cfg_P_Tx_BODY_LE1_CAN_MCM_P_1B7_PassKneadingMassgLvlSts8: ComNotification=Com_CbkTxAck_Cfg_P_Tx_BODY_LE1_CAN_MCM_P_1B7_PassKneadingMassgLvlSts8, ComTimeoutNotification=, ComBitPosition=47, ComBitSize=2, ComFirstTimeout=0, ComHandleId=10, ComSignalInActiveValue=0, DataTimeoutSupport=false, ComTimeout=0, ComSignalType=UINT8, Direction=Tx, InputName=PassKneadingMassgLvlSts8, offset=0, factor=1, enumValue=0%Idle&1%intensity 1&2%intensity 2, unitName=, max=3, min=0, compuMethodType=, ComSystemTemplateSystemSignalRef=Cfg_P_Tx_BODY_LE1_CAN_MCM_P_1B7
        Cfg_P_Tx_BODY_LE1_CAN_MCM_P_1B7_PassKneadingMassgTime8: ComNotification=Com_CbkTxAck_Cfg_P_Tx_BODY_LE1_CAN_MCM_P_1B7_PassKneadingMassgTime8, ComTimeoutNotification=, ComBitPosition=55, ComBitSize=8, ComFirstTimeout=0, ComHandleId=11, ComSignalInActiveValue=0, DataTimeoutSupport=false, ComTimeout=0, ComSignalType=UINT8, Direction=Tx, InputName=PassKneadingMassgTime8, offset=0, factor=0.1, enumValue=, unitName=, max=25.5, min=0, compuMethodType=INTERNALTOPHYS, ComSystemTemplateSystemSignalRef=Cfg_P_Tx_BODY_LE1_CAN_MCM_P_1B7
        Cfg_P_Tx_BODY_LE1_CAN_MCM_P_1E2_PassSeatmassgValveSts: ComNotification=Com_CbkTxAck_Cfg_P_Tx_BODY_LE1_CAN_MCM_P_1E2_PassSeatmassgValveSts, ComTimeoutNotification=, ComBitPosition=1, ComBitSize=2, ComFirstTimeout=0, ComHandleId=12, ComSignalInActiveValue=0, DataTimeoutSupport=false, ComTimeout=0, ComSignalType=UINT8, Direction=Tx, InputName=PassSeatmassgValveSts, offset=0, factor=1, enumValue=0%Normal&1%Action&2%Err&3%Reserved, unitName=, max=3, min=0, compuMethodType=, ComSystemTemplateSystemSignalRef=Cfg_P_Tx_BODY_LE1_CAN_MCM_P_1E2
        Cfg_P_Tx_BODY_LE1_CAN_MCM_P_1E2_PassSeatmassgHeatCSts: ComNotification=Com_CbkTxAck_Cfg_P_Tx_BODY_LE1_CAN_MCM_P_1E2_PassSeatmassgHeatCSts, ComTimeoutNotification=, ComBitPosition=3, ComBitSize=2, ComFirstTimeout=0, ComHandleId=13, ComSignalInActiveValue=0, DataTimeoutSupport=false, ComTimeout=0, ComSignalType=UINT8, Direction=Tx, InputName=PassSeatmassgHeatCSts, offset=0, factor=1, enumValue=0%Normal&1%Action&2%Err&3%Reserved, unitName=, max=3, min=0, compuMethodType=, ComSystemTemplateSystemSignalRef=Cfg_P_Tx_BODY_LE1_CAN_MCM_P_1E2
        Cfg_P_Tx_BODY_LE1_CAN_MCM_P_1E2_PassSeatLumbarValueSts: ComNotification=Com_CbkTxAck_Cfg_P_Tx_BODY_LE1_CAN_MCM_P_1E2_PassSeatLumbarValueSts, ComTimeoutNotification=, ComBitPosition=5, ComBitSize=2, ComFirstTimeout=0, ComHandleId=14, ComSignalInActiveValue=0, DataTimeoutSupport=false, ComTimeout=0, ComSignalType=UINT8, Direction=Tx, InputName=PassSeatLumbarValueSts, offset=0, factor=1, enumValue=0%Normal&1%Action&2%Err&3%Reserved, unitName=, max=3, min=0, compuMethodType=, ComSystemTemplateSystemSignalRef=Cfg_P_Tx_BODY_LE1_CAN_MCM_P_1E2
        Cfg_P_Tx_BODY_LE1_CAN_MCM_P_1E2_PassSeatUpperValueSts: ComNotification=Com_CbkTxAck_Cfg_P_Tx_BODY_LE1_CAN_MCM_P_1E2_PassSeatUpperValueSts, ComTimeoutNotification=, ComBitPosition=7, ComBitSize=2, ComFirstTimeout=0, ComHandleId=15, ComSignalInActiveValue=0, DataTimeoutSupport=false, ComTimeout=0, ComSignalType=UINT8, Direction=Tx, InputName=PassSeatUpperValueSts, offset=0, factor=1, enumValue=0%Normal&1%Action&2%Err&3%Reserved, unitName=, max=3, min=0, compuMethodType=, ComSystemTemplateSystemSignalRef=Cfg_P_Tx_BODY_LE1_CAN_MCM_P_1E2
        Cfg_P_Tx_BODY_LE1_CAN_MCM_P_1E2_PassSeatCushionValueSts: ComNotification=Com_CbkTxAck_Cfg_P_Tx_BODY_LE1_CAN_MCM_P_1E2_PassSeatCushionValueSts, ComTimeoutNotification=, ComBitPosition=11, ComBitSize=2, ComFirstTimeout=0, ComHandleId=16, ComSignalInActiveValue=0, DataTimeoutSupport=false, ComTimeout=0, ComSignalType=UINT8, Direction=Tx, InputName=PassSeatCushionValueSts, offset=0, factor=1, enumValue=0%Normal&1%Action&2%Err&3%Reserved, unitName=, max=3, min=0, compuMethodType=, ComSystemTemplateSystemSignalRef=Cfg_P_Tx_BODY_LE1_CAN_MCM_P_1E2
        Cfg_P_Tx_BODY_LE1_CAN_MCM_P_1E2_PassSeatBlosterValueSts: ComNotification=Com_CbkTxAck_Cfg_P_Tx_BODY_LE1_CAN_MCM_P_1E2_PassSeatBlosterValueSts, ComTimeoutNotification=, ComBitPosition=13, ComBitSize=2, ComFirstTimeout=0, ComHandleId=17, ComSignalInActiveValue=0, DataTimeoutSupport=false, ComTimeout=0, ComSignalType=UINT8, Direction=Tx, InputName=PassSeatBlosterValueSts, offset=0, factor=1, enumValue=0%Normal&1%Action&2%Err&3%Reserved, unitName=, max=3, min=0, compuMethodType=, ComSystemTemplateSystemSignalRef=Cfg_P_Tx_BODY_LE1_CAN_MCM_P_1E2
        Cfg_P_Tx_BODY_LE1_CAN_MCM_P_1E2_PassMassSwitchSts: ComNotification=Com_CbkTxAck_Cfg_P_Tx_BODY_LE1_CAN_MCM_P_1E2_PassMassSwitchSts, ComTimeoutNotification=, ComBitPosition=15, ComBitSize=2, ComFirstTimeout=0, ComHandleId=18, ComSignalInActiveValue=0, DataTimeoutSupport=false, ComTimeout=0, ComSignalType=UINT8, Direction=Tx, InputName=PassMassSwitchSts, offset=0, factor=1, enumValue=0%No Press&1%Press&2%Err&3%Reserved, unitName=, max=3, min=0, compuMethodType=, ComSystemTemplateSystemSignalRef=Cfg_P_Tx_BODY_LE1_CAN_MCM_P_1E2
        Cfg_P_Tx_BODY_LE1_CAN_MCM_P_1E2_PassSeatLumbarTopPos: ComNotification=Com_CbkTxAck_Cfg_P_Tx_BODY_LE1_CAN_MCM_P_1E2_PassSeatLumbarTopPos, ComTimeoutNotification=, ComBitPosition=23, ComBitSize=8, ComFirstTimeout=0, ComHandleId=19, ComSignalInActiveValue=0, DataTimeoutSupport=false, ComTimeout=0, ComSignalType=UINT8, Direction=Tx, InputName=PassSeatLumbarTopPos, offset=0, factor=1, enumValue=, unitName=, max=255, min=0, compuMethodType=, ComSystemTemplateSystemSignalRef=Cfg_P_Tx_BODY_LE1_CAN_MCM_P_1E2
        Cfg_P_Tx_BODY_LE1_CAN_MCM_P_1E2_PassSeatLumbarMidPos: ComNotification=Com_CbkTxAck_Cfg_P_Tx_BODY_LE1_CAN_MCM_P_1E2_PassSeatLumbarMidPos, ComTimeoutNotification=, ComBitPosition=31, ComBitSize=8, ComFirstTimeout=0, ComHandleId=20, ComSignalInActiveValue=0, DataTimeoutSupport=false, ComTimeout=0, ComSignalType=UINT8, Direction=Tx, InputName=PassSeatLumbarMidPos, offset=0, factor=1, enumValue=, unitName=, max=255, min=0, compuMethodType=, ComSystemTemplateSystemSignalRef=Cfg_P_Tx_BODY_LE1_CAN_MCM_P_1E2
        Cfg_P_Tx_BODY_LE1_CAN_MCM_P_1E2_PassSeatLumbarBottomPos: ComNotification=Com_CbkTxAck_Cfg_P_Tx_BODY_LE1_CAN_MCM_P_1E2_PassSeatLumbarBottomPos, ComTimeoutNotification=, ComBitPosition=39, ComBitSize=8, ComFirstTimeout=0, ComHandleId=21, ComSignalInActiveValue=0, DataTimeoutSupport=false, ComTimeout=0, ComSignalType=UINT8, Direction=Tx, InputName=PassSeatLumbarBottomPos, offset=0, factor=1, enumValue=, unitName=, max=255, min=0, compuMethodType=, ComSystemTemplateSystemSignalRef=Cfg_P_Tx_BODY_LE1_CAN_MCM_P_1E2
        Cfg_P_Tx_BODY_LE1_CAN_MCM_P_1E2_PassSeatBolsterValueBLPos: ComNotification=Com_CbkTxAck_Cfg_P_Tx_BODY_LE1_CAN_MCM_P_1E2_PassSeatBolsterValueBLPos, ComTimeoutNotification=, ComBitPosition=47, ComBitSize=8, ComFirstTimeout=0, ComHandleId=22, ComSignalInActiveValue=0, DataTimeoutSupport=false, ComTimeout=0, ComSignalType=UINT8, Direction=Tx, InputName=PassSeatBolsterValueBLPos, offset=0, factor=1, enumValue=, unitName=, max=255, min=0, compuMethodType=, ComSystemTemplateSystemSignalRef=Cfg_P_Tx_BODY_LE1_CAN_MCM_P_1E2
        Cfg_P_Tx_BODY_LE1_CAN_MCM_P_1E2_PassSeatBolsterValueBRPos: ComNotification=Com_CbkTxAck_Cfg_P_Tx_BODY_LE1_CAN_MCM_P_1E2_PassSeatBolsterValueBRPos, ComTimeoutNotification=, ComBitPosition=55, ComBitSize=8, ComFirstTimeout=0, ComHandleId=23, ComSignalInActiveValue=0, DataTimeoutSupport=false, ComTimeout=0, ComSignalType=UINT8, Direction=Tx, InputName=PassSeatBolsterValueBRPos, offset=0, factor=1, enumValue=, unitName=, max=255, min=0, compuMethodType=, ComSystemTemplateSystemSignalRef=Cfg_P_Tx_BODY_LE1_CAN_MCM_P_1E2
        Cfg_P_Tx_BODY_LE1_CAN_MCM_P_1E2_PassSeatCushionValue6Pos: ComNotification=Com_CbkTxAck_Cfg_P_Tx_BODY_LE1_CAN_MCM_P_1E2_PassSeatCushionValue6Pos, ComTimeoutNotification=, ComBitPosition=63, ComBitSize=8, ComFirstTimeout=0, ComHandleId=24, ComSignalInActiveValue=0, DataTimeoutSupport=false, ComTimeout=0, ComSignalType=UINT8, Direction=Tx, InputName=PassSeatCushionValue6Pos, offset=0, factor=1, enumValue=, unitName=, max=255, min=0, compuMethodType=, ComSystemTemplateSystemSignalRef=Cfg_P_Tx_BODY_LE1_CAN_MCM_P_1E2
        Cfg_P_Tx_BODY_LE1_CAN_MCM_P_1E3_PassSeatCushionValue5Pos: ComNotification=Com_CbkTxAck_Cfg_P_Tx_BODY_LE1_CAN_MCM_P_1E3_PassSeatCushionValue5Pos, ComTimeoutNotification=, ComBitPosition=7, ComBitSize=8, ComFirstTimeout=0, ComHandleId=25, ComSignalInActiveValue=0, DataTimeoutSupport=false, ComTimeout=0, ComSignalType=UINT8, Direction=Tx, InputName=PassSeatCushionValue5Pos, offset=0, factor=1, enumValue=, unitName=, max=255, min=0, compuMethodType=, ComSystemTemplateSystemSignalRef=Cfg_P_Tx_BODY_LE1_CAN_MCM_P_1E3
        Cfg_P_Tx_BODY_LE1_CAN_MCM_P_1E3_PassSeatCushionValue4Pos: ComNotification=Com_CbkTxAck_Cfg_P_Tx_BODY_LE1_CAN_MCM_P_1E3_PassSeatCushionValue4Pos, ComTimeoutNotification=, ComBitPosition=15, ComBitSize=8, ComFirstTimeout=0, ComHandleId=26, ComSignalInActiveValue=0, DataTimeoutSupport=false, ComTimeout=0, ComSignalType=UINT8, Direction=Tx, InputName=PassSeatCushionValue4Pos, offset=0, factor=1, enumValue=, unitName=, max=255, min=0, compuMethodType=, ComSystemTemplateSystemSignalRef=Cfg_P_Tx_BODY_LE1_CAN_MCM_P_1E3
        Cfg_P_Tx_BODY_LE1_CAN_MCM_P_1E3_PassSeatCushionValue2Pos: ComNotification=Com_CbkTxAck_Cfg_P_Tx_BODY_LE1_CAN_MCM_P_1E3_PassSeatCushionValue2Pos, ComTimeoutNotification=, ComBitPosition=23, ComBitSize=8, ComFirstTimeout=0, ComHandleId=27, ComSignalInActiveValue=0, DataTimeoutSupport=false, ComTimeout=0, ComSignalType=UINT8, Direction=Tx, InputName=PassSeatCushionValue2Pos, offset=0, factor=1, enumValue=, unitName=, max=255, min=0, compuMethodType=, ComSystemTemplateSystemSignalRef=Cfg_P_Tx_BODY_LE1_CAN_MCM_P_1E3
        Cfg_P_Tx_BODY_LE1_CAN_MCM_P_1E3_PassSeatCushionValue1Pos: ComNotification=Com_CbkTxAck_Cfg_P_Tx_BODY_LE1_CAN_MCM_P_1E3_PassSeatCushionValue1Pos, ComTimeoutNotification=, ComBitPosition=31, ComBitSize=8, ComFirstTimeout=0, ComHandleId=28, ComSignalInActiveValue=0, DataTimeoutSupport=false, ComTimeout=0, ComSignalType=UINT8, Direction=Tx, InputName=PassSeatCushionValue1Pos, offset=0, factor=1, enumValue=, unitName=, max=255, min=0, compuMethodType=, ComSystemTemplateSystemSignalRef=Cfg_P_Tx_BODY_LE1_CAN_MCM_P_1E3
        Cfg_P_Tx_BODY_LE1_CAN_MCM_P_1E3_PassSeatUpperValueLPos: ComNotification=Com_CbkTxAck_Cfg_P_Tx_BODY_LE1_CAN_MCM_P_1E3_PassSeatUpperValueLPos, ComTimeoutNotification=, ComBitPosition=39, ComBitSize=8, ComFirstTimeout=0, ComHandleId=29, ComSignalInActiveValue=0, DataTimeoutSupport=false, ComTimeout=0, ComSignalType=UINT8, Direction=Tx, InputName=PassSeatUpperValueLPos, offset=0, factor=1, enumValue=, unitName=, max=255, min=0, compuMethodType=, ComSystemTemplateSystemSignalRef=Cfg_P_Tx_BODY_LE1_CAN_MCM_P_1E3
        Cfg_P_Tx_BODY_LE1_CAN_MCM_P_1E3_PassSeatUpperValueMPos: ComNotification=Com_CbkTxAck_Cfg_P_Tx_BODY_LE1_CAN_MCM_P_1E3_PassSeatUpperValueMPos, ComTimeoutNotification=, ComBitPosition=47, ComBitSize=8, ComFirstTimeout=0, ComHandleId=30, ComSignalInActiveValue=0, DataTimeoutSupport=false, ComTimeout=0, ComSignalType=UINT8, Direction=Tx, InputName=PassSeatUpperValueMPos, offset=0, factor=1, enumValue=, unitName=, max=255, min=0, compuMethodType=, ComSystemTemplateSystemSignalRef=Cfg_P_Tx_BODY_LE1_CAN_MCM_P_1E3
        Cfg_P_Tx_BODY_LE1_CAN_MCM_P_1E3_PassSeatUpperValueRPos: ComNotification=Com_CbkTxAck_Cfg_P_Tx_BODY_LE1_CAN_MCM_P_1E3_PassSeatUpperValueRPos, ComTimeoutNotification=, ComBitPosition=55, ComBitSize=8, ComFirstTimeout=0, ComHandleId=31, ComSignalInActiveValue=0, DataTimeoutSupport=false, ComTimeout=0, ComSignalType=UINT8, Direction=Tx, InputName=PassSeatUpperValueRPos, offset=0, factor=1, enumValue=, unitName=, max=255, min=0, compuMethodType=, ComSystemTemplateSystemSignalRef=Cfg_P_Tx_BODY_LE1_CAN_MCM_P_1E3
        Cfg_P_Tx_BODY_LE1_CAN_MCM_P_1E3_PassPumpSts: ComNotification=Com_CbkTxAck_Cfg_P_Tx_BODY_LE1_CAN_MCM_P_1E3_PassPumpSts, ComTimeoutNotification=, ComBitPosition=63, ComBitSize=8, ComFirstTimeout=0, ComHandleId=32, ComSignalInActiveValue=0, DataTimeoutSupport=false, ComTimeout=0, ComSignalType=UINT8, Direction=Tx, InputName=PassPumpSts, offset=0, factor=1, enumValue=, unitName=, max=255, min=0, compuMethodType=, ComSystemTemplateSystemSignalRef=Cfg_P_Tx_BODY_LE1_CAN_MCM_P_1E3
        Cfg_P_Tx_BODY_LE1_CAN_MCM_P_1E4_PassKneadingMassgSkillsSts9: ComNotification=Com_CbkTxAck_Cfg_P_Tx_BODY_LE1_CAN_MCM_P_1E4_PassKneadingMassgSkillsSts9, ComTimeoutNotification=, ComBitPosition=11, ComBitSize=4, ComFirstTimeout=0, ComHandleId=33, ComSignalInActiveValue=0, DataTimeoutSupport=false, ComTimeout=0, ComSignalType=UINT8, Direction=Tx, InputName=PassKneadingMassgSkillsSts9, offset=0, factor=1, enumValue=, unitName=, max=15, min=0, compuMethodType=, ComSystemTemplateSystemSignalRef=Cfg_P_Tx_BODY_LE1_CAN_MCM_P_1E4
        Cfg_P_Tx_BODY_LE1_CAN_MCM_P_1E4_PassLumControlSts: ComNotification=Com_CbkTxAck_Cfg_P_Tx_BODY_LE1_CAN_MCM_P_1E4_PassLumControlSts, ComTimeoutNotification=, ComBitPosition=18, ComBitSize=3, ComFirstTimeout=0, ComHandleId=34, ComSignalInActiveValue=0, DataTimeoutSupport=false, ComTimeout=0, ComSignalType=UINT8, Direction=Tx, InputName=PassLumControlSts, offset=0, factor=1, enumValue=0%No action&1%Manual control&2%Recall&3%System failure&4%Reserved&5%Reserved&6%Reserved&7%Reserved, unitName=, max=7, min=0, compuMethodType=, ComSystemTemplateSystemSignalRef=Cfg_P_Tx_BODY_LE1_CAN_MCM_P_1E4
        Cfg_P_Tx_BODY_LE1_CAN_MCM_P_1E4_PassLumSwitchSts: ComNotification=Com_CbkTxAck_Cfg_P_Tx_BODY_LE1_CAN_MCM_P_1E4_PassLumSwitchSts, ComTimeoutNotification=, ComBitPosition=21, ComBitSize=3, ComFirstTimeout=0, ComHandleId=35, ComSignalInActiveValue=0, DataTimeoutSupport=false, ComTimeout=0, ComSignalType=UINT8, Direction=Tx, InputName=PassLumSwitchSts, offset=0, factor=1, enumValue=0%No Press&1%Forward&2%Reward&3%Up&4%Down&5%Erro, unitName=, max=7, min=0, compuMethodType=, ComSystemTemplateSystemSignalRef=Cfg_P_Tx_BODY_LE1_CAN_MCM_P_1E4
        Cfg_P_Tx_BODY_LE1_CAN_MCM_P_1E4_PassSystemFailr: ComNotification=Com_CbkTxAck_Cfg_P_Tx_BODY_LE1_CAN_MCM_P_1E4_PassSystemFailr, ComTimeoutNotification=, ComBitPosition=22, ComBitSize=1, ComFirstTimeout=0, ComHandleId=36, ComSignalInActiveValue=0, DataTimeoutSupport=false, ComTimeout=0, ComSignalType=UINT8, Direction=Tx, InputName=PassSystemFailr, offset=0, factor=1, enumValue=0%no Failure&1%Failure, unitName=, max=1, min=0, compuMethodType=, ComSystemTemplateSystemSignalRef=Cfg_P_Tx_BODY_LE1_CAN_MCM_P_1E4
        Cfg_P_Tx_BODY_LE1_CAN_MCM_P_1E4_PassSeatMassFailr: ComNotification=Com_CbkTxAck_Cfg_P_Tx_BODY_LE1_CAN_MCM_P_1E4_PassSeatMassFailr, ComTimeoutNotification=, ComBitPosition=23, ComBitSize=1, ComFirstTimeout=0, ComHandleId=37, ComSignalInActiveValue=0, DataTimeoutSupport=false, ComTimeout=0, ComSignalType=UINT8, Direction=Tx, InputName=PassSeatMassFailr, offset=0, factor=1, enumValue=0%no Failure&1%Failure, unitName=, max=1, min=0, compuMethodType=, ComSystemTemplateSystemSignalRef=Cfg_P_Tx_BODY_LE1_CAN_MCM_P_1E4
        Cfg_P_Tx_BODY_LE1_CAN_MCM_P_1E4_PassSeatCushionValue3Pos: ComNotification=Com_CbkTxAck_Cfg_P_Tx_BODY_LE1_CAN_MCM_P_1E4_PassSeatCushionValue3Pos, ComTimeoutNotification=, ComBitPosition=31, ComBitSize=8, ComFirstTimeout=0, ComHandleId=38, ComSignalInActiveValue=0, DataTimeoutSupport=false, ComTimeout=0, ComSignalType=UINT8, Direction=Tx, InputName=PassSeatCushionValue3Pos, offset=0, factor=1, enumValue=, unitName=, max=100, min=0, compuMethodType=, ComSystemTemplateSystemSignalRef=Cfg_P_Tx_BODY_LE1_CAN_MCM_P_1E4
        Cfg_P_Tx_BODY_LE1_CAN_MCM_P_1E4_PassLumbarTopWorkSts: ComNotification=Com_CbkTxAck_Cfg_P_Tx_BODY_LE1_CAN_MCM_P_1E4_PassLumbarTopWorkSts, ComTimeoutNotification=, ComBitPosition=33, ComBitSize=2, ComFirstTimeout=0, ComHandleId=39, ComSignalInActiveValue=0, DataTimeoutSupport=false, ComTimeout=0, ComSignalType=UINT8, Direction=Tx, InputName=PassLumbarTopWorkSts, offset=0, factor=1, enumValue=0%No action&1%Inflation&2%Deflation&3%Idle, unitName=, max=3, min=0, compuMethodType=, ComSystemTemplateSystemSignalRef=Cfg_P_Tx_BODY_LE1_CAN_MCM_P_1E4
        Cfg_P_Tx_BODY_LE1_CAN_MCM_P_1E4_PassLumbarMidWorkSts: ComNotification=Com_CbkTxAck_Cfg_P_Tx_BODY_LE1_CAN_MCM_P_1E4_PassLumbarMidWorkSts, ComTimeoutNotification=, ComBitPosition=35, ComBitSize=2, ComFirstTimeout=0, ComHandleId=40, ComSignalInActiveValue=0, DataTimeoutSupport=false, ComTimeout=0, ComSignalType=UINT8, Direction=Tx, InputName=PassLumbarMidWorkSts, offset=0, factor=1, enumValue=0%No action&1%Inflation&2%Deflation&3%Idle, unitName=, max=3, min=0, compuMethodType=, ComSystemTemplateSystemSignalRef=Cfg_P_Tx_BODY_LE1_CAN_MCM_P_1E4
        Cfg_P_Tx_BODY_LE1_CAN_MCM_P_1E4_PassLumbarBottomWorkSts: ComNotification=Com_CbkTxAck_Cfg_P_Tx_BODY_LE1_CAN_MCM_P_1E4_PassLumbarBottomWorkSts, ComTimeoutNotification=, ComBitPosition=37, ComBitSize=2, ComFirstTimeout=0, ComHandleId=41, ComSignalInActiveValue=0, DataTimeoutSupport=false, ComTimeout=0, ComSignalType=UINT8, Direction=Tx, InputName=PassLumbarBottomWorkSts, offset=0, factor=1, enumValue=0%No action&1%Inflation&2%Deflation&3%Idle, unitName=, max=3, min=0, compuMethodType=, ComSystemTemplateSystemSignalRef=Cfg_P_Tx_BODY_LE1_CAN_MCM_P_1E4
        Cfg_P_Tx_BODY_LE1_CAN_MCM_P_1E4_PassHeat1Sts: ComNotification=Com_CbkTxAck_Cfg_P_Tx_BODY_LE1_CAN_MCM_P_1E4_PassHeat1Sts, ComTimeoutNotification=, ComBitPosition=39, ComBitSize=2, ComFirstTimeout=0, ComHandleId=42, ComSignalInActiveValue=0, DataTimeoutSupport=false, ComTimeout=0, ComSignalType=UINT8, Direction=Tx, InputName=PassHeat1Sts, offset=0, factor=1, enumValue=0%no action&1%action&2%err&3%reserved, unitName=, max=3, min=0, compuMethodType=, ComSystemTemplateSystemSignalRef=Cfg_P_Tx_BODY_LE1_CAN_MCM_P_1E4
        Cfg_P_Tx_BODY_LE1_CAN_MCM_P_1E4_PassHeat2Sts: ComNotification=Com_CbkTxAck_Cfg_P_Tx_BODY_LE1_CAN_MCM_P_1E4_PassHeat2Sts, ComTimeoutNotification=, ComBitPosition=41, ComBitSize=2, ComFirstTimeout=0, ComHandleId=43, ComSignalInActiveValue=0, DataTimeoutSupport=false, ComTimeout=0, ComSignalType=UINT8, Direction=Tx, InputName=PassHeat2Sts, offset=0, factor=1, enumValue=0%no action&1%action&2%err&3%reserved, unitName=, max=3, min=0, compuMethodType=, ComSystemTemplateSystemSignalRef=Cfg_P_Tx_BODY_LE1_CAN_MCM_P_1E4
        Cfg_P_Tx_BODY_LE1_CAN_MCM_P_1E4_PassHeat3Sts: ComNotification=Com_CbkTxAck_Cfg_P_Tx_BODY_LE1_CAN_MCM_P_1E4_PassHeat3Sts, ComTimeoutNotification=, ComBitPosition=43, ComBitSize=2, ComFirstTimeout=0, ComHandleId=44, ComSignalInActiveValue=0, DataTimeoutSupport=false, ComTimeout=0, ComSignalType=UINT8, Direction=Tx, InputName=PassHeat3Sts, offset=0, factor=1, enumValue=0%no action&1%action&2%err&3%reserved, unitName=, max=3, min=0, compuMethodType=, ComSystemTemplateSystemSignalRef=Cfg_P_Tx_BODY_LE1_CAN_MCM_P_1E4
        Cfg_P_Tx_BODY_LE1_CAN_MCM_P_1E4_PassHeat4Sts: ComNotification=Com_CbkTxAck_Cfg_P_Tx_BODY_LE1_CAN_MCM_P_1E4_PassHeat4Sts, ComTimeoutNotification=, ComBitPosition=45, ComBitSize=2, ComFirstTimeout=0, ComHandleId=45, ComSignalInActiveValue=0, DataTimeoutSupport=false, ComTimeout=0, ComSignalType=UINT8, Direction=Tx, InputName=PassHeat4Sts, offset=0, factor=1, enumValue=0%no action&1%action&2%err&3%reserved, unitName=, max=3, min=0, compuMethodType=, ComSystemTemplateSystemSignalRef=Cfg_P_Tx_BODY_LE1_CAN_MCM_P_1E4
        Cfg_P_Tx_BODY_LE1_CAN_MCM_P_1E4_PassHeat5Sts: ComNotification=Com_CbkTxAck_Cfg_P_Tx_BODY_LE1_CAN_MCM_P_1E4_PassHeat5Sts, ComTimeoutNotification=, ComBitPosition=47, ComBitSize=2, ComFirstTimeout=0, ComHandleId=46, ComSignalInActiveValue=0, DataTimeoutSupport=false, ComTimeout=0, ComSignalType=UINT8, Direction=Tx, InputName=PassHeat5Sts, offset=0, factor=1, enumValue=0%no action&1%action&2%err&3%reserved, unitName=, max=3, min=0, compuMethodType=, ComSystemTemplateSystemSignalRef=Cfg_P_Tx_BODY_LE1_CAN_MCM_P_1E4
        Cfg_P_Tx_BODY_LE1_CAN_MCM_P_1E4_PassHeat6Sts: ComNotification=Com_CbkTxAck_Cfg_P_Tx_BODY_LE1_CAN_MCM_P_1E4_PassHeat6Sts, ComTimeoutNotification=, ComBitPosition=49, ComBitSize=2, ComFirstTimeout=0, ComHandleId=47, ComSignalInActiveValue=0, DataTimeoutSupport=false, ComTimeout=0, ComSignalType=UINT8, Direction=Tx, InputName=PassHeat6Sts, offset=0, factor=1, enumValue=0%no action&1%action&2%err&3%reserved, unitName=, max=3, min=0, compuMethodType=, ComSystemTemplateSystemSignalRef=Cfg_P_Tx_BODY_LE1_CAN_MCM_P_1E4
        Cfg_P_Tx_BODY_LE1_CAN_MCM_P_1E4_PassHeat5ErrSts: ComNotification=Com_CbkTxAck_Cfg_P_Tx_BODY_LE1_CAN_MCM_P_1E4_PassHeat5ErrSts, ComTimeoutNotification=, ComBitPosition=53, ComBitSize=4, ComFirstTimeout=0, ComHandleId=48, ComSignalInActiveValue=0, DataTimeoutSupport=false, ComTimeout=0, ComSignalType=UINT8, Direction=Tx, InputName=PassHeat5ErrSts, offset=0, factor=1, enumValue=0%No Error&1%Heater Short to GND&2%Heater short to PWR or Heater Open&3%Sensor short to GND&15%Invalid&4%Sensor short to PWR or Sensor Open&5%Over Current, unitName=, max=15, min=0, compuMethodType=, ComSystemTemplateSystemSignalRef=Cfg_P_Tx_BODY_LE1_CAN_MCM_P_1E4
        Cfg_P_Tx_BODY_LE1_CAN_MCM_P_1E4_PassKneadingMassgLvlSts9: ComNotification=Com_CbkTxAck_Cfg_P_Tx_BODY_LE1_CAN_MCM_P_1E4_PassKneadingMassgLvlSts9, ComTimeoutNotification=, ComBitPosition=55, ComBitSize=2, ComFirstTimeout=0, ComHandleId=49, ComSignalInActiveValue=0, DataTimeoutSupport=false, ComTimeout=0, ComSignalType=UINT8, Direction=Tx, InputName=PassKneadingMassgLvlSts9, offset=0, factor=1, enumValue=0%Idle&1%intensity 1&2%intensity 2, unitName=, max=3, min=0, compuMethodType=, ComSystemTemplateSystemSignalRef=Cfg_P_Tx_BODY_LE1_CAN_MCM_P_1E4
        Cfg_P_Tx_BODY_LE1_CAN_MCM_P_1E4_PassKneadingMassgTime9: ComNotification=Com_CbkTxAck_Cfg_P_Tx_BODY_LE1_CAN_MCM_P_1E4_PassKneadingMassgTime9, ComTimeoutNotification=, ComBitPosition=63, ComBitSize=8, ComFirstTimeout=0, ComHandleId=50, ComSignalInActiveValue=0, DataTimeoutSupport=false, ComTimeout=0, ComSignalType=UINT8, Direction=Tx, InputName=PassKneadingMassgTime9, offset=0, factor=0.1, enumValue=, unitName=, max=25.5, min=0, compuMethodType=INTERNALTOPHYS, ComSystemTemplateSystemSignalRef=Cfg_P_Tx_BODY_LE1_CAN_MCM_P_1E4
        Cfg_P_Tx_BODY_LE1_CAN_MCM_P_1EB_PassKneadingMassgTime10: ComNotification=Com_CbkTxAck_Cfg_P_Tx_BODY_LE1_CAN_MCM_P_1EB_PassKneadingMassgTime10, ComTimeoutNotification=, ComBitPosition=7, ComBitSize=8, ComFirstTimeout=0, ComHandleId=51, ComSignalInActiveValue=0, DataTimeoutSupport=false, ComTimeout=0, ComSignalType=UINT8, Direction=Tx, InputName=PassKneadingMassgTime10, offset=0, factor=0.1, enumValue=, unitName=, max=25.5, min=0, compuMethodType=INTERNALTOPHYS, ComSystemTemplateSystemSignalRef=Cfg_P_Tx_BODY_LE1_CAN_MCM_P_1EB
        Cfg_P_Tx_BODY_LE1_CAN_MCM_P_1EB_PassKneadingMassgSkillsSts10: ComNotification=Com_CbkTxAck_Cfg_P_Tx_BODY_LE1_CAN_MCM_P_1EB_PassKneadingMassgSkillsSts10, ComTimeoutNotification=, ComBitPosition=11, ComBitSize=4, ComFirstTimeout=0, ComHandleId=52, ComSignalInActiveValue=0, DataTimeoutSupport=false, ComTimeout=0, ComSignalType=UINT8, Direction=Tx, InputName=PassKneadingMassgSkillsSts10, offset=0, factor=1, enumValue=, unitName=, max=15, min=0, compuMethodType=, ComSystemTemplateSystemSignalRef=Cfg_P_Tx_BODY_LE1_CAN_MCM_P_1EB
        Cfg_P_Tx_BODY_LE1_CAN_MCM_P_1EB_PassKneadingMassgLvlSts10: ComNotification=Com_CbkTxAck_Cfg_P_Tx_BODY_LE1_CAN_MCM_P_1EB_PassKneadingMassgLvlSts10, ComTimeoutNotification=, ComBitPosition=13, ComBitSize=2, ComFirstTimeout=0, ComHandleId=53, ComSignalInActiveValue=0, DataTimeoutSupport=false, ComTimeout=0, ComSignalType=UINT8, Direction=Tx, InputName=PassKneadingMassgLvlSts10, offset=0, factor=1, enumValue=0%Idle&1%intensity 1&2%intensity 2, unitName=, max=3, min=0, compuMethodType=, ComSystemTemplateSystemSignalRef=Cfg_P_Tx_BODY_LE1_CAN_MCM_P_1EB
        Cfg_P_Tx_BODY_LE1_CAN_MCM_P_1EB_PassMassageHeatNTC1: ComNotification=Com_CbkTxAck_Cfg_P_Tx_BODY_LE1_CAN_MCM_P_1EB_PassMassageHeatNTC1, ComTimeoutNotification=, ComBitPosition=23, ComBitSize=8, ComFirstTimeout=0, ComHandleId=54, ComSignalInActiveValue=0, DataTimeoutSupport=false, ComTimeout=0, ComSignalType=UINT8, Direction=Tx, InputName=PassMassageHeatNTC1, offset=-40, factor=0.5, enumValue=, unitName=degC, max=87.5, min=-40, compuMethodType=INTERNALTOPHYS, ComSystemTemplateSystemSignalRef=Cfg_P_Tx_BODY_LE1_CAN_MCM_P_1EB
        Cfg_P_Tx_BODY_LE1_CAN_MCM_P_1EB_PassMassageHeatNTC2: ComNotification=Com_CbkTxAck_Cfg_P_Tx_BODY_LE1_CAN_MCM_P_1EB_PassMassageHeatNTC2, ComTimeoutNotification=, ComBitPosition=31, ComBitSize=8, ComFirstTimeout=0, ComHandleId=55, ComSignalInActiveValue=0, DataTimeoutSupport=false, ComTimeout=0, ComSignalType=UINT8, Direction=Tx, InputName=PassMassageHeatNTC2, offset=-40, factor=0.5, enumValue=, unitName=degC, max=87.5, min=-40, compuMethodType=INTERNALTOPHYS, ComSystemTemplateSystemSignalRef=Cfg_P_Tx_BODY_LE1_CAN_MCM_P_1EB
        Cfg_P_Tx_BODY_LE1_CAN_MCM_P_1EB_PassMassageHeatNTC3: ComNotification=Com_CbkTxAck_Cfg_P_Tx_BODY_LE1_CAN_MCM_P_1EB_PassMassageHeatNTC3, ComTimeoutNotification=, ComBitPosition=39, ComBitSize=8, ComFirstTimeout=0, ComHandleId=56, ComSignalInActiveValue=0, DataTimeoutSupport=false, ComTimeout=0, ComSignalType=UINT8, Direction=Tx, InputName=PassMassageHeatNTC3, offset=-40, factor=0.5, enumValue=, unitName=degC, max=87.5, min=-40, compuMethodType=INTERNALTOPHYS, ComSystemTemplateSystemSignalRef=Cfg_P_Tx_BODY_LE1_CAN_MCM_P_1EB
        Cfg_P_Tx_BODY_LE1_CAN_MCM_P_1EB_PassMassageHeatNTC4: ComNotification=Com_CbkTxAck_Cfg_P_Tx_BODY_LE1_CAN_MCM_P_1EB_PassMassageHeatNTC4, ComTimeoutNotification=, ComBitPosition=47, ComBitSize=8, ComFirstTimeout=0, ComHandleId=57, ComSignalInActiveValue=0, DataTimeoutSupport=false, ComTimeout=0, ComSignalType=UINT8, Direction=Tx, InputName=PassMassageHeatNTC4, offset=-40, factor=0.5, enumValue=, unitName=degC, max=87.5, min=-40, compuMethodType=INTERNALTOPHYS, ComSystemTemplateSystemSignalRef=Cfg_P_Tx_BODY_LE1_CAN_MCM_P_1EB
        Cfg_P_Tx_BODY_LE1_CAN_MCM_P_1EB_PassMassageHeatNTC5: ComNotification=Com_CbkTxAck_Cfg_P_Tx_BODY_LE1_CAN_MCM_P_1EB_PassMassageHeatNTC5, ComTimeoutNotification=, ComBitPosition=55, ComBitSize=8, ComFirstTimeout=0, ComHandleId=58, ComSignalInActiveValue=0, DataTimeoutSupport=false, ComTimeout=0, ComSignalType=UINT8, Direction=Tx, InputName=PassMassageHeatNTC5, offset=-40, factor=0.5, enumValue=, unitName=degC, max=87.5, min=-40, compuMethodType=INTERNALTOPHYS, ComSystemTemplateSystemSignalRef=Cfg_P_Tx_BODY_LE1_CAN_MCM_P_1EB
        Cfg_P_Tx_BODY_LE1_CAN_MCM_P_1EB_PassMassageHeatNTC6: ComNotification=Com_CbkTxAck_Cfg_P_Tx_BODY_LE1_CAN_MCM_P_1EB_PassMassageHeatNTC6, ComTimeoutNotification=, ComBitPosition=63, ComBitSize=8, ComFirstTimeout=0, ComHandleId=59, ComSignalInActiveValue=0, DataTimeoutSupport=false, ComTimeout=0, ComSignalType=UINT8, Direction=Tx, InputName=PassMassageHeatNTC6, offset=-40, factor=0.5, enumValue=, unitName=degC, max=87.5, min=-40, compuMethodType=INTERNALTOPHYS, ComSystemTemplateSystemSignalRef=Cfg_P_Tx_BODY_LE1_CAN_MCM_P_1EB
        Cfg_P_Tx_BODY_LE1_CAN_MCM_P_1ED_PassMassageHeatNTC7: ComNotification=Com_CbkTxAck_Cfg_P_Tx_BODY_LE1_CAN_MCM_P_1ED_PassMassageHeatNTC7, ComTimeoutNotification=, ComBitPosition=23, ComBitSize=8, ComFirstTimeout=0, ComHandleId=60, ComSignalInActiveValue=0, DataTimeoutSupport=false, ComTimeout=0, ComSignalType=UINT8, Direction=Tx, InputName=PassMassageHeatNTC7, offset=-40, factor=0.5, enumValue=, unitName=degC, max=87.5, min=-40, compuMethodType=INTERNALTOPHYS, ComSystemTemplateSystemSignalRef=Cfg_P_Tx_BODY_LE1_CAN_MCM_P_1ED
        Cfg_P_Tx_BODY_LE1_CAN_MCM_P_1ED_PassMassageHeatNTC8: ComNotification=Com_CbkTxAck_Cfg_P_Tx_BODY_LE1_CAN_MCM_P_1ED_PassMassageHeatNTC8, ComTimeoutNotification=, ComBitPosition=31, ComBitSize=8, ComFirstTimeout=0, ComHandleId=61, ComSignalInActiveValue=0, DataTimeoutSupport=false, ComTimeout=0, ComSignalType=UINT8, Direction=Tx, InputName=PassMassageHeatNTC8, offset=-40, factor=0.5, enumValue=, unitName=degC, max=87.5, min=-40, compuMethodType=INTERNALTOPHYS, ComSystemTemplateSystemSignalRef=Cfg_P_Tx_BODY_LE1_CAN_MCM_P_1ED
        Cfg_P_Tx_BODY_LE1_CAN_MCM_P_1ED_PassMassageHeatNTC9: ComNotification=Com_CbkTxAck_Cfg_P_Tx_BODY_LE1_CAN_MCM_P_1ED_PassMassageHeatNTC9, ComTimeoutNotification=, ComBitPosition=39, ComBitSize=8, ComFirstTimeout=0, ComHandleId=62, ComSignalInActiveValue=0, DataTimeoutSupport=false, ComTimeout=0, ComSignalType=UINT8, Direction=Tx, InputName=PassMassageHeatNTC9, offset=-40, factor=0.5, enumValue=, unitName=degC, max=87.5, min=-40, compuMethodType=INTERNALTOPHYS, ComSystemTemplateSystemSignalRef=Cfg_P_Tx_BODY_LE1_CAN_MCM_P_1ED
        Cfg_P_Tx_BODY_LE1_CAN_MCM_P_1ED_PassMassageHeatNTC10: ComNotification=Com_CbkTxAck_Cfg_P_Tx_BODY_LE1_CAN_MCM_P_1ED_PassMassageHeatNTC10, ComTimeoutNotification=, ComBitPosition=47, ComBitSize=8, ComFirstTimeout=0, ComHandleId=63, ComSignalInActiveValue=0, DataTimeoutSupport=false, ComTimeout=0, ComSignalType=UINT8, Direction=Tx, InputName=PassMassageHeatNTC10, offset=-40, factor=0.5, enumValue=, unitName=degC, max=87.5, min=-40, compuMethodType=INTERNALTOPHYS, ComSystemTemplateSystemSignalRef=Cfg_P_Tx_BODY_LE1_CAN_MCM_P_1ED
        Cfg_P_Tx_BODY_LE1_CAN_MCM_P_1ED_PassMassageHeatNTC11: ComNotification=Com_CbkTxAck_Cfg_P_Tx_BODY_LE1_CAN_MCM_P_1ED_PassMassageHeatNTC11, ComTimeoutNotification=, ComBitPosition=55, ComBitSize=8, ComFirstTimeout=0, ComHandleId=64, ComSignalInActiveValue=0, DataTimeoutSupport=false, ComTimeout=0, ComSignalType=UINT8, Direction=Tx, InputName=PassMassageHeatNTC11, offset=-40, factor=0.5, enumValue=, unitName=degC, max=87.5, min=-40, compuMethodType=INTERNALTOPHYS, ComSystemTemplateSystemSignalRef=Cfg_P_Tx_BODY_LE1_CAN_MCM_P_1ED
        Cfg_P_Tx_BODY_LE1_CAN_MCM_P_1ED_PassMassageHeatNTC12: ComNotification=Com_CbkTxAck_Cfg_P_Tx_BODY_LE1_CAN_MCM_P_1ED_PassMassageHeatNTC12, ComTimeoutNotification=, ComBitPosition=63, ComBitSize=8, ComFirstTimeout=0, ComHandleId=65, ComSignalInActiveValue=0, DataTimeoutSupport=false, ComTimeout=0, ComSignalType=UINT8, Direction=Tx, InputName=PassMassageHeatNTC12, offset=-40, factor=0.5, enumValue=, unitName=degC, max=87.5, min=-40, compuMethodType=INTERNALTOPHYS, ComSystemTemplateSystemSignalRef=Cfg_P_Tx_BODY_LE1_CAN_MCM_P_1ED
        Cfg_P_Rx_BODY_LE1_CAN_BCU_11E_VehSpdSts_Rdnt1: ComNotification=Com_CbkRxAck_Cfg_P_Rx_BODY_LE1_CAN_BCU_11E_VehSpdSts_Rdnt1, ComTimeoutNotification=, ComBitPosition=29, ComBitSize=1, ComFirstTimeout=0, ComHandleId=0, DataTimeoutSupport=false, ComTimeout=0, ComSignalType=UINT8, Direction=Rx, InputName=VehSpdSts_Rdnt1, offset=0, factor=1, enumValue=0%Inalid&1%Valid, unitName=, max=1, min=0, compuMethodType=, ComSystemTemplateSystemSignalRef=Cfg_P_Rx_BODY_LE1_CAN_BCU_11E
        Cfg_P_Rx_BODY_LE1_CAN_BCU_11E_VehSpd_Rdnt1: ComNotification=Com_CbkRxAck_Cfg_P_Rx_BODY_LE1_CAN_BCU_11E_VehSpd_Rdnt1, ComTimeoutNotification=, ComBitPosition=28, ComBitSize=13, ComFirstTimeout=0, ComHandleId=1, DataTimeoutSupport=false, ComTimeout=0, ComSignalType=UINT16, Direction=Rx, InputName=VehSpd_Rdnt1, offset=0, factor=0.05625, enumValue=, unitName=km/h, max=360, min=0, compuMethodType=INTERNALTOPHYS, ComSystemTemplateSystemSignalRef=Cfg_P_Rx_BODY_LE1_CAN_BCU_11E
        Cfg_P_Rx_BODY_LE1_CAN_ZONE_13C_ZONE_13C_CRC: ComNotification=Com_CbkRxAck_Cfg_P_Rx_BODY_LE1_CAN_ZONE_13C_ZONE_13C_CRC, ComTimeoutNotification=Com_CbkRxTOut_Cfg_P_Rx_BODY_LE1_CAN_ZONE_13C_ZONE_13C_CRC, ComBitPosition=7, ComBitSize=8, ComFirstTimeout=500, ComHandleId=2, DataTimeoutSupport=true, ComTimeout=500, ComSignalType=UINT8, Direction=Rx, InputName=ZONE_13C_CRC, offset=0, factor=1, enumValue=, unitName=, max=255, min=0, compuMethodType=, ComSystemTemplateSystemSignalRef=Cfg_P_Rx_BODY_LE1_CAN_ZONE_13C
        Cfg_P_Rx_BODY_LE1_CAN_ZONE_13C_ZONE_13C_MsgCntr: ComNotification=Com_CbkRxAck_Cfg_P_Rx_BODY_LE1_CAN_ZONE_13C_ZONE_13C_MsgCntr, ComTimeoutNotification=Com_CbkRxTOut_Cfg_P_Rx_BODY_LE1_CAN_ZONE_13C_ZONE_13C_MsgCntr, ComBitPosition=11, ComBitSize=4, ComFirstTimeout=500, ComHandleId=3, DataTimeoutSupport=true, ComTimeout=500, ComSignalType=UINT8, Direction=Rx, InputName=ZONE_13C_MsgCntr, offset=0, factor=1, enumValue=, unitName=, max=14, min=0, compuMethodType=, ComSystemTemplateSystemSignalRef=Cfg_P_Rx_BODY_LE1_CAN_ZONE_13C
        Cfg_P_Rx_BODY_LE1_CAN_ZONE_13C_OperatorState_SrvSts: ComNotification=Com_CbkRxAck_Cfg_P_Rx_BODY_LE1_CAN_ZONE_13C_OperatorState_SrvSts, ComTimeoutNotification=Com_CbkRxTOut_Cfg_P_Rx_BODY_LE1_CAN_ZONE_13C_OperatorState_SrvSts, ComBitPosition=12, ComBitSize=1, ComFirstTimeout=500, ComHandleId=4, DataTimeoutSupport=true, ComTimeout=500, ComSignalType=UINT8, Direction=Rx, InputName=OperatorState_SrvSts, offset=0, factor=1, enumValue=0%invalid&1%valid, unitName=, max=1, min=0, compuMethodType=, ComSystemTemplateSystemSignalRef=Cfg_P_Rx_BODY_LE1_CAN_ZONE_13C
        Cfg_P_Rx_BODY_LE1_CAN_ZONE_13C_DrvState_SrvSts: ComNotification=Com_CbkRxAck_Cfg_P_Rx_BODY_LE1_CAN_ZONE_13C_DrvState_SrvSts, ComTimeoutNotification=Com_CbkRxTOut_Cfg_P_Rx_BODY_LE1_CAN_ZONE_13C_DrvState_SrvSts, ComBitPosition=13, ComBitSize=1, ComFirstTimeout=500, ComHandleId=5, DataTimeoutSupport=true, ComTimeout=500, ComSignalType=UINT8, Direction=Rx, InputName=DrvState_SrvSts, offset=0, factor=1, enumValue=0%invalid&1%valid, unitName=, max=1, min=0, compuMethodType=, ComSystemTemplateSystemSignalRef=Cfg_P_Rx_BODY_LE1_CAN_ZONE_13C
        Cfg_P_Rx_BODY_LE1_CAN_ZONE_13C_VehStateDetailed_SrvSts: ComNotification=Com_CbkRxAck_Cfg_P_Rx_BODY_LE1_CAN_ZONE_13C_VehStateDetailed_SrvSts, ComTimeoutNotification=Com_CbkRxTOut_Cfg_P_Rx_BODY_LE1_CAN_ZONE_13C_VehStateDetailed_SrvSts, ComBitPosition=14, ComBitSize=1, ComFirstTimeout=500, ComHandleId=6, DataTimeoutSupport=true, ComTimeout=500, ComSignalType=UINT8, Direction=Rx, InputName=VehStateDetailed_SrvSts, offset=0, factor=1, enumValue=0%invalid&1%valid, unitName=, max=1, min=0, compuMethodType=, ComSystemTemplateSystemSignalRef=Cfg_P_Rx_BODY_LE1_CAN_ZONE_13C
        Cfg_P_Rx_BODY_LE1_CAN_ZONE_13C_DrvState: ComNotification=Com_CbkRxAck_Cfg_P_Rx_BODY_LE1_CAN_ZONE_13C_DrvState, ComTimeoutNotification=Com_CbkRxTOut_Cfg_P_Rx_BODY_LE1_CAN_ZONE_13C_DrvState, ComBitPosition=18, ComBitSize=3, ComFirstTimeout=500, ComHandleId=7, DataTimeoutSupport=true, ComTimeout=500, ComSignalType=UINT8, Direction=Rx, InputName=DrvState, offset=0, factor=1, enumValue=0%DRV_ST_NONE&1%DRV_ST_MD&2%DRV_ST_AD&7%DRV_ST_INVALID, unitName=, max=7, min=0, compuMethodType=, ComSystemTemplateSystemSignalRef=Cfg_P_Rx_BODY_LE1_CAN_ZONE_13C
        Cfg_P_Rx_BODY_LE1_CAN_ZONE_13C_OperatorState: ComNotification=Com_CbkRxAck_Cfg_P_Rx_BODY_LE1_CAN_ZONE_13C_OperatorState, ComTimeoutNotification=Com_CbkRxTOut_Cfg_P_Rx_BODY_LE1_CAN_ZONE_13C_OperatorState, ComBitPosition=21, ComBitSize=3, ComFirstTimeout=500, ComHandleId=8, DataTimeoutSupport=true, ComTimeout=500, ComSignalType=UINT8, Direction=Rx, InputName=OperatorState, offset=0, factor=1, enumValue=0%OPERATOR_ST_NONE&1%OPERATOR_ST_OUTSIDE&2%OPERATOR_ST_AVAILABLE&3%OPERATOR_ST_INSIDE&7%OPERATOR_ST_INVALID, unitName=, max=7, min=0, compuMethodType=, ComSystemTemplateSystemSignalRef=Cfg_P_Rx_BODY_LE1_CAN_ZONE_13C
        Cfg_P_Rx_BODY_LE1_CAN_ZONE_13C_VehStateDetailed: ComNotification=Com_CbkRxAck_Cfg_P_Rx_BODY_LE1_CAN_ZONE_13C_VehStateDetailed, ComTimeoutNotification=Com_CbkRxTOut_Cfg_P_Rx_BODY_LE1_CAN_ZONE_13C_VehStateDetailed, ComBitPosition=27, ComBitSize=4, ComFirstTimeout=500, ComHandleId=9, DataTimeoutSupport=true, ComTimeout=500, ComSignalType=UINT8, Direction=Rx, InputName=VehStateDetailed, offset=0, factor=1, enumValue=0%VEH_ST_PARKED&1%VEH_ST_DRVRDY&2%VEH_ST_DRIVING&3%VEH_ST_SWUPDATE&15%VEH_ST_INVALID&4%VEH_ST_CHARGING&5%VEH_ST_PWRSWAP, unitName=, max=15, min=0, compuMethodType=, ComSystemTemplateSystemSignalRef=Cfg_P_Rx_BODY_LE1_CAN_ZONE_13C
        Cfg_P_Rx_BODY_LE1_CAN_ZONE_13C_VehModeDef: ComNotification=Com_CbkRxAck_Cfg_P_Rx_BODY_LE1_CAN_ZONE_13C_VehModeDef, ComTimeoutNotification=Com_CbkRxTOut_Cfg_P_Rx_BODY_LE1_CAN_ZONE_13C_VehModeDef, ComBitPosition=31, ComBitSize=4, ComFirstTimeout=500, ComHandleId=10, DataTimeoutSupport=true, ComTimeout=500, ComSignalType=UINT8, Direction=Rx, InputName=VehModeDef, offset=0, factor=1, enumValue=0%VEHMODE_RESERVED&1%VEHMODE_PRODUCTION&2%VEHMODE_TRANSPORT&3%VEHMODE_SHOWROOM&15%VEHMODE_INVALID&4%VEHMODE_REGULAR&5%VEHMODE_DUT&6%VEHMODE_TESTDRIVE&7%VEHMODE_MAINTENANCE&8%VEHMODE_SVT&9%VEHMODE_ENDOFLIFE, unitName=, max=15, min=0, compuMethodType=, ComSystemTemplateSystemSignalRef=Cfg_P_Rx_BODY_LE1_CAN_ZONE_13C
        Cfg_P_Rx_BODY_LE1_CAN_ZONE_MCM_06_PassKneadingMassgSkillsCmd5: ComNotification=Com_CbkRxAck_Cfg_P_Rx_BODY_LE1_CAN_ZONE_MCM_06_PassKneadingMassgSkillsCmd5, ComTimeoutNotification=, ComBitPosition=3, ComBitSize=4, ComFirstTimeout=0, ComHandleId=11, DataTimeoutSupport=false, ComTimeout=0, ComSignalType=UINT8, Direction=Rx, InputName=PassKneadingMassgSkillsCmd5, offset=0, factor=1, enumValue=, unitName=, max=15, min=0, compuMethodType=, ComSystemTemplateSystemSignalRef=Cfg_P_Rx_BODY_LE1_CAN_ZONE_MCM_06
        Cfg_P_Rx_BODY_LE1_CAN_ZONE_MCM_06_PassKneadingMassgTimesCmd5: ComNotification=Com_CbkRxAck_Cfg_P_Rx_BODY_LE1_CAN_ZONE_MCM_06_PassKneadingMassgTimesCmd5, ComTimeoutNotification=, ComBitPosition=7, ComBitSize=4, ComFirstTimeout=0, ComHandleId=12, DataTimeoutSupport=false, ComTimeout=0, ComSignalType=UINT8, Direction=Rx, InputName=PassKneadingMassgTimesCmd5, offset=0, factor=1, enumValue=, unitName=, max=15, min=0, compuMethodType=, ComSystemTemplateSystemSignalRef=Cfg_P_Rx_BODY_LE1_CAN_ZONE_MCM_06
        Cfg_P_Rx_BODY_LE1_CAN_ZONE_MCM_06_PassKneadingMassgLvlCmd5: ComNotification=Com_CbkRxAck_Cfg_P_Rx_BODY_LE1_CAN_ZONE_MCM_06_PassKneadingMassgLvlCmd5, ComTimeoutNotification=, ComBitPosition=9, ComBitSize=2, ComFirstTimeout=0, ComHandleId=13, DataTimeoutSupport=false, ComTimeout=0, ComSignalType=UINT8, Direction=Rx, InputName=PassKneadingMassgLvlCmd5, offset=0, factor=1, enumValue=0%Idle&1%intensity 1&2%intensity 2, unitName=, max=3, min=0, compuMethodType=, ComSystemTemplateSystemSignalRef=Cfg_P_Rx_BODY_LE1_CAN_ZONE_MCM_06
        Cfg_P_Rx_BODY_LE1_CAN_ZONE_MCM_06_PassKneadingMassgLvlCmd6: ComNotification=Com_CbkRxAck_Cfg_P_Rx_BODY_LE1_CAN_ZONE_MCM_06_PassKneadingMassgLvlCmd6, ComTimeoutNotification=, ComBitPosition=11, ComBitSize=2, ComFirstTimeout=0, ComHandleId=14, DataTimeoutSupport=false, ComTimeout=0, ComSignalType=UINT8, Direction=Rx, InputName=PassKneadingMassgLvlCmd6, offset=0, factor=1, enumValue=0%Idle&1%intensity 1&2%intensity 2, unitName=, max=3, min=0, compuMethodType=, ComSystemTemplateSystemSignalRef=Cfg_P_Rx_BODY_LE1_CAN_ZONE_MCM_06
        Cfg_P_Rx_BODY_LE1_CAN_ZONE_MCM_06_PassKneadingMassgLvlCmd7: ComNotification=Com_CbkRxAck_Cfg_P_Rx_BODY_LE1_CAN_ZONE_MCM_06_PassKneadingMassgLvlCmd7, ComTimeoutNotification=, ComBitPosition=13, ComBitSize=2, ComFirstTimeout=0, ComHandleId=15, DataTimeoutSupport=false, ComTimeout=0, ComSignalType=UINT8, Direction=Rx, InputName=PassKneadingMassgLvlCmd7, offset=0, factor=1, enumValue=0%Idle&1%intensity 1&2%intensity 2, unitName=, max=3, min=0, compuMethodType=, ComSystemTemplateSystemSignalRef=Cfg_P_Rx_BODY_LE1_CAN_ZONE_MCM_06
        Cfg_P_Rx_BODY_LE1_CAN_ZONE_MCM_06_PassKneadingMassgLvlCmd8: ComNotification=Com_CbkRxAck_Cfg_P_Rx_BODY_LE1_CAN_ZONE_MCM_06_PassKneadingMassgLvlCmd8, ComTimeoutNotification=, ComBitPosition=15, ComBitSize=2, ComFirstTimeout=0, ComHandleId=16, DataTimeoutSupport=false, ComTimeout=0, ComSignalType=UINT8, Direction=Rx, InputName=PassKneadingMassgLvlCmd8, offset=0, factor=1, enumValue=0%Idle&1%intensity 1&2%intensity 2, unitName=, max=3, min=0, compuMethodType=, ComSystemTemplateSystemSignalRef=Cfg_P_Rx_BODY_LE1_CAN_ZONE_MCM_06
        Cfg_P_Rx_BODY_LE1_CAN_ZONE_MCM_06_PassKneadingMassgSkillsCmd6: ComNotification=Com_CbkRxAck_Cfg_P_Rx_BODY_LE1_CAN_ZONE_MCM_06_PassKneadingMassgSkillsCmd6, ComTimeoutNotification=, ComBitPosition=19, ComBitSize=4, ComFirstTimeout=0, ComHandleId=17, DataTimeoutSupport=false, ComTimeout=0, ComSignalType=UINT8, Direction=Rx, InputName=PassKneadingMassgSkillsCmd6, offset=0, factor=1, enumValue=, unitName=, max=15, min=0, compuMethodType=, ComSystemTemplateSystemSignalRef=Cfg_P_Rx_BODY_LE1_CAN_ZONE_MCM_06
        Cfg_P_Rx_BODY_LE1_CAN_ZONE_MCM_06_PassKneadingMassgTimesCmd6: ComNotification=Com_CbkRxAck_Cfg_P_Rx_BODY_LE1_CAN_ZONE_MCM_06_PassKneadingMassgTimesCmd6, ComTimeoutNotification=, ComBitPosition=23, ComBitSize=4, ComFirstTimeout=0, ComHandleId=18, DataTimeoutSupport=false, ComTimeout=0, ComSignalType=UINT8, Direction=Rx, InputName=PassKneadingMassgTimesCmd6, offset=0, factor=1, enumValue=, unitName=, max=15, min=0, compuMethodType=, ComSystemTemplateSystemSignalRef=Cfg_P_Rx_BODY_LE1_CAN_ZONE_MCM_06
        Cfg_P_Rx_BODY_LE1_CAN_ZONE_MCM_06_PassKneadingMassgSkillsCmd7: ComNotification=Com_CbkRxAck_Cfg_P_Rx_BODY_LE1_CAN_ZONE_MCM_06_PassKneadingMassgSkillsCmd7, ComTimeoutNotification=, ComBitPosition=27, ComBitSize=4, ComFirstTimeout=0, ComHandleId=19, DataTimeoutSupport=false, ComTimeout=0, ComSignalType=UINT8, Direction=Rx, InputName=PassKneadingMassgSkillsCmd7, offset=0, factor=1, enumValue=, unitName=, max=15, min=0, compuMethodType=, ComSystemTemplateSystemSignalRef=Cfg_P_Rx_BODY_LE1_CAN_ZONE_MCM_06
        Cfg_P_Rx_BODY_LE1_CAN_ZONE_MCM_06_PassKneadingMassgTimesCmd7: ComNotification=Com_CbkRxAck_Cfg_P_Rx_BODY_LE1_CAN_ZONE_MCM_06_PassKneadingMassgTimesCmd7, ComTimeoutNotification=, ComBitPosition=31, ComBitSize=4, ComFirstTimeout=0, ComHandleId=20, DataTimeoutSupport=false, ComTimeout=0, ComSignalType=UINT8, Direction=Rx, InputName=PassKneadingMassgTimesCmd7, offset=0, factor=1, enumValue=, unitName=, max=15, min=0, compuMethodType=, ComSystemTemplateSystemSignalRef=Cfg_P_Rx_BODY_LE1_CAN_ZONE_MCM_06
        Cfg_P_Rx_BODY_LE1_CAN_ZONE_MCM_06_PassKneadingMassgSkillsCmd8: ComNotification=Com_CbkRxAck_Cfg_P_Rx_BODY_LE1_CAN_ZONE_MCM_06_PassKneadingMassgSkillsCmd8, ComTimeoutNotification=, ComBitPosition=35, ComBitSize=4, ComFirstTimeout=0, ComHandleId=21, DataTimeoutSupport=false, ComTimeout=0, ComSignalType=UINT8, Direction=Rx, InputName=PassKneadingMassgSkillsCmd8, offset=0, factor=1, enumValue=, unitName=, max=15, min=0, compuMethodType=, ComSystemTemplateSystemSignalRef=Cfg_P_Rx_BODY_LE1_CAN_ZONE_MCM_06
        Cfg_P_Rx_BODY_LE1_CAN_ZONE_MCM_06_PassKneadingMassgTimesCmd8: ComNotification=Com_CbkRxAck_Cfg_P_Rx_BODY_LE1_CAN_ZONE_MCM_06_PassKneadingMassgTimesCmd8, ComTimeoutNotification=, ComBitPosition=39, ComBitSize=4, ComFirstTimeout=0, ComHandleId=22, DataTimeoutSupport=false, ComTimeout=0, ComSignalType=UINT8, Direction=Rx, InputName=PassKneadingMassgTimesCmd8, offset=0, factor=1, enumValue=, unitName=, max=15, min=0, compuMethodType=, ComSystemTemplateSystemSignalRef=Cfg_P_Rx_BODY_LE1_CAN_ZONE_MCM_06
        Cfg_P_Rx_BODY_LE1_CAN_ZONE_MCM_06_PassKneadingMassgSkillsCmd9: ComNotification=Com_CbkRxAck_Cfg_P_Rx_BODY_LE1_CAN_ZONE_MCM_06_PassKneadingMassgSkillsCmd9, ComTimeoutNotification=, ComBitPosition=43, ComBitSize=4, ComFirstTimeout=0, ComHandleId=23, DataTimeoutSupport=false, ComTimeout=0, ComSignalType=UINT8, Direction=Rx, InputName=PassKneadingMassgSkillsCmd9, offset=0, factor=1, enumValue=, unitName=, max=15, min=0, compuMethodType=, ComSystemTemplateSystemSignalRef=Cfg_P_Rx_BODY_LE1_CAN_ZONE_MCM_06
        Cfg_P_Rx_BODY_LE1_CAN_ZONE_MCM_06_PassKneadingMassgTimesCmd9: ComNotification=Com_CbkRxAck_Cfg_P_Rx_BODY_LE1_CAN_ZONE_MCM_06_PassKneadingMassgTimesCmd9, ComTimeoutNotification=, ComBitPosition=47, ComBitSize=4, ComFirstTimeout=0, ComHandleId=24, DataTimeoutSupport=false, ComTimeout=0, ComSignalType=UINT8, Direction=Rx, InputName=PassKneadingMassgTimesCmd9, offset=0, factor=1, enumValue=, unitName=, max=15, min=0, compuMethodType=, ComSystemTemplateSystemSignalRef=Cfg_P_Rx_BODY_LE1_CAN_ZONE_MCM_06
        Cfg_P_Rx_BODY_LE1_CAN_ZONE_MCM_06_PassKneadingMassgSkillsCmd10: ComNotification=Com_CbkRxAck_Cfg_P_Rx_BODY_LE1_CAN_ZONE_MCM_06_PassKneadingMassgSkillsCmd10, ComTimeoutNotification=, ComBitPosition=51, ComBitSize=4, ComFirstTimeout=0, ComHandleId=25, DataTimeoutSupport=false, ComTimeout=0, ComSignalType=UINT8, Direction=Rx, InputName=PassKneadingMassgSkillsCmd10, offset=0, factor=1, enumValue=, unitName=, max=15, min=0, compuMethodType=, ComSystemTemplateSystemSignalRef=Cfg_P_Rx_BODY_LE1_CAN_ZONE_MCM_06
        Cfg_P_Rx_BODY_LE1_CAN_ZONE_MCM_06_PassKneadingMassgTimesCmd10: ComNotification=Com_CbkRxAck_Cfg_P_Rx_BODY_LE1_CAN_ZONE_MCM_06_PassKneadingMassgTimesCmd10, ComTimeoutNotification=, ComBitPosition=55, ComBitSize=4, ComFirstTimeout=0, ComHandleId=26, DataTimeoutSupport=false, ComTimeout=0, ComSignalType=UINT8, Direction=Rx, InputName=PassKneadingMassgTimesCmd10, offset=0, factor=1, enumValue=, unitName=, max=15, min=0, compuMethodType=, ComSystemTemplateSystemSignalRef=Cfg_P_Rx_BODY_LE1_CAN_ZONE_MCM_06
        Cfg_P_Rx_BODY_LE1_CAN_ZONE_MCM_06_PassKneadingMassgLvlCmd9: ComNotification=Com_CbkRxAck_Cfg_P_Rx_BODY_LE1_CAN_ZONE_MCM_06_PassKneadingMassgLvlCmd9, ComTimeoutNotification=, ComBitPosition=57, ComBitSize=2, ComFirstTimeout=0, ComHandleId=27, DataTimeoutSupport=false, ComTimeout=0, ComSignalType=UINT8, Direction=Rx, InputName=PassKneadingMassgLvlCmd9, offset=0, factor=1, enumValue=0%Idle&1%intensity 1&2%intensity 2, unitName=, max=3, min=0, compuMethodType=, ComSystemTemplateSystemSignalRef=Cfg_P_Rx_BODY_LE1_CAN_ZONE_MCM_06
        Cfg_P_Rx_BODY_LE1_CAN_ZONE_MCM_06_PassKneadingMassgLvlCmd10: ComNotification=Com_CbkRxAck_Cfg_P_Rx_BODY_LE1_CAN_ZONE_MCM_06_PassKneadingMassgLvlCmd10, ComTimeoutNotification=, ComBitPosition=59, ComBitSize=2, ComFirstTimeout=0, ComHandleId=28, DataTimeoutSupport=false, ComTimeout=0, ComSignalType=UINT8, Direction=Rx, InputName=PassKneadingMassgLvlCmd10, offset=0, factor=1, enumValue=0%Idle&1%intensity 1&2%intensity 2, unitName=, max=3, min=0, compuMethodType=, ComSystemTemplateSystemSignalRef=Cfg_P_Rx_BODY_LE1_CAN_ZONE_MCM_06
        Cfg_P_Rx_BODY_LE1_CAN_ZONE_1CF_PassHeat1_pct: ComNotification=Com_CbkRxAck_Cfg_P_Rx_BODY_LE1_CAN_ZONE_1CF_PassHeat1_pct, ComTimeoutNotification=, ComBitPosition=22, ComBitSize=7, ComFirstTimeout=0, ComHandleId=29, DataTimeoutSupport=false, ComTimeout=0, ComSignalType=UINT8, Direction=Rx, InputName=PassHeat1_pct, offset=0, factor=1, enumValue=, unitName=, max=127, min=0, compuMethodType=, ComSystemTemplateSystemSignalRef=Cfg_P_Rx_BODY_LE1_CAN_ZONE_1CF
        Cfg_P_Rx_BODY_LE1_CAN_ZONE_1CF_PassHeat2_pct: ComNotification=Com_CbkRxAck_Cfg_P_Rx_BODY_LE1_CAN_ZONE_1CF_PassHeat2_pct, ComTimeoutNotification=, ComBitPosition=30, ComBitSize=7, ComFirstTimeout=0, ComHandleId=30, DataTimeoutSupport=false, ComTimeout=0, ComSignalType=UINT8, Direction=Rx, InputName=PassHeat2_pct, offset=0, factor=1, enumValue=, unitName=, max=127, min=0, compuMethodType=, ComSystemTemplateSystemSignalRef=Cfg_P_Rx_BODY_LE1_CAN_ZONE_1CF
        Cfg_P_Rx_BODY_LE1_CAN_ZONE_1CF_PassHeat3_pct: ComNotification=Com_CbkRxAck_Cfg_P_Rx_BODY_LE1_CAN_ZONE_1CF_PassHeat3_pct, ComTimeoutNotification=, ComBitPosition=38, ComBitSize=7, ComFirstTimeout=0, ComHandleId=31, DataTimeoutSupport=false, ComTimeout=0, ComSignalType=UINT8, Direction=Rx, InputName=PassHeat3_pct, offset=0, factor=1, enumValue=, unitName=, max=127, min=0, compuMethodType=, ComSystemTemplateSystemSignalRef=Cfg_P_Rx_BODY_LE1_CAN_ZONE_1CF
        Cfg_P_Rx_BODY_LE1_CAN_ZONE_1CF_PassHeat4_pct: ComNotification=Com_CbkRxAck_Cfg_P_Rx_BODY_LE1_CAN_ZONE_1CF_PassHeat4_pct, ComTimeoutNotification=, ComBitPosition=46, ComBitSize=7, ComFirstTimeout=0, ComHandleId=32, DataTimeoutSupport=false, ComTimeout=0, ComSignalType=UINT8, Direction=Rx, InputName=PassHeat4_pct, offset=0, factor=1, enumValue=, unitName=, max=127, min=0, compuMethodType=, ComSystemTemplateSystemSignalRef=Cfg_P_Rx_BODY_LE1_CAN_ZONE_1CF
        Cfg_P_Rx_BODY_LE1_CAN_ZONE_1CF_PassHeat5_pct: ComNotification=Com_CbkRxAck_Cfg_P_Rx_BODY_LE1_CAN_ZONE_1CF_PassHeat5_pct, ComTimeoutNotification=, ComBitPosition=54, ComBitSize=7, ComFirstTimeout=0, ComHandleId=33, DataTimeoutSupport=false, ComTimeout=0, ComSignalType=UINT8, Direction=Rx, InputName=PassHeat5_pct, offset=0, factor=1, enumValue=, unitName=, max=127, min=0, compuMethodType=, ComSystemTemplateSystemSignalRef=Cfg_P_Rx_BODY_LE1_CAN_ZONE_1CF
        Cfg_P_Rx_BODY_LE1_CAN_ZONE_1CF_PassHeat6_pct: ComNotification=Com_CbkRxAck_Cfg_P_Rx_BODY_LE1_CAN_ZONE_1CF_PassHeat6_pct, ComTimeoutNotification=, ComBitPosition=62, ComBitSize=7, ComFirstTimeout=0, ComHandleId=34, DataTimeoutSupport=false, ComTimeout=0, ComSignalType=UINT8, Direction=Rx, InputName=PassHeat6_pct, offset=0, factor=1, enumValue=, unitName=, max=127, min=0, compuMethodType=, ComSystemTemplateSystemSignalRef=Cfg_P_Rx_BODY_LE1_CAN_ZONE_1CF
        Cfg_P_Rx_BODY_LE1_CAN_Zone_FL_MCM_03_PassSeatmassgValve1Cmd: ComNotification=Com_CbkRxAck_Cfg_P_Rx_BODY_LE1_CAN_Zone_FL_MCM_03_PassSeatmassgValve1Cmd, ComTimeoutNotification=Com_CbkRxTOut_Cfg_P_Rx_BODY_LE1_CAN_Zone_FL_MCM_03_PassSeatmassgValve1Cmd, ComBitPosition=1, ComBitSize=2, ComFirstTimeout=500, ComHandleId=35, DataTimeoutSupport=true, ComTimeout=500, ComSignalType=UINT8, Direction=Rx, InputName=PassSeatmassgValve1Cmd, offset=0, factor=1, enumValue=0%No action&1%Inflation&2%Deflation&3%Reserved, unitName=, max=3, min=0, compuMethodType=, ComSystemTemplateSystemSignalRef=Cfg_P_Rx_BODY_LE1_CAN_Zone_FL_MCM_03
        Cfg_P_Rx_BODY_LE1_CAN_Zone_FL_MCM_03_PassSeatmassgValve2Cmd: ComNotification=Com_CbkRxAck_Cfg_P_Rx_BODY_LE1_CAN_Zone_FL_MCM_03_PassSeatmassgValve2Cmd, ComTimeoutNotification=Com_CbkRxTOut_Cfg_P_Rx_BODY_LE1_CAN_Zone_FL_MCM_03_PassSeatmassgValve2Cmd, ComBitPosition=3, ComBitSize=2, ComFirstTimeout=500, ComHandleId=36, DataTimeoutSupport=true, ComTimeout=500, ComSignalType=UINT8, Direction=Rx, InputName=PassSeatmassgValve2Cmd, offset=0, factor=1, enumValue=0%No action&1%Inflation&2%Deflation&3%Reserved, unitName=, max=3, min=0, compuMethodType=, ComSystemTemplateSystemSignalRef=Cfg_P_Rx_BODY_LE1_CAN_Zone_FL_MCM_03
        Cfg_P_Rx_BODY_LE1_CAN_Zone_FL_MCM_03_PassSeatmassgValve3Cmd: ComNotification=Com_CbkRxAck_Cfg_P_Rx_BODY_LE1_CAN_Zone_FL_MCM_03_PassSeatmassgValve3Cmd, ComTimeoutNotification=Com_CbkRxTOut_Cfg_P_Rx_BODY_LE1_CAN_Zone_FL_MCM_03_PassSeatmassgValve3Cmd, ComBitPosition=5, ComBitSize=2, ComFirstTimeout=500, ComHandleId=37, DataTimeoutSupport=true, ComTimeout=500, ComSignalType=UINT8, Direction=Rx, InputName=PassSeatmassgValve3Cmd, offset=0, factor=1, enumValue=0%No action&1%Inflation&2%Deflation&3%Reserved, unitName=, max=3, min=0, compuMethodType=, ComSystemTemplateSystemSignalRef=Cfg_P_Rx_BODY_LE1_CAN_Zone_FL_MCM_03
        Cfg_P_Rx_BODY_LE1_CAN_Zone_FL_MCM_03_PassSeatmassgValve4Cmd: ComNotification=Com_CbkRxAck_Cfg_P_Rx_BODY_LE1_CAN_Zone_FL_MCM_03_PassSeatmassgValve4Cmd, ComTimeoutNotification=Com_CbkRxTOut_Cfg_P_Rx_BODY_LE1_CAN_Zone_FL_MCM_03_PassSeatmassgValve4Cmd, ComBitPosition=7, ComBitSize=2, ComFirstTimeout=500, ComHandleId=38, DataTimeoutSupport=true, ComTimeout=500, ComSignalType=UINT8, Direction=Rx, InputName=PassSeatmassgValve4Cmd, offset=0, factor=1, enumValue=0%No action&1%Inflation&2%Deflation&3%Reserved, unitName=, max=3, min=0, compuMethodType=, ComSystemTemplateSystemSignalRef=Cfg_P_Rx_BODY_LE1_CAN_Zone_FL_MCM_03
        Cfg_P_Rx_BODY_LE1_CAN_Zone_FL_MCM_03_PassSeatmassgValve5Cmd: ComNotification=Com_CbkRxAck_Cfg_P_Rx_BODY_LE1_CAN_Zone_FL_MCM_03_PassSeatmassgValve5Cmd, ComTimeoutNotification=Com_CbkRxTOut_Cfg_P_Rx_BODY_LE1_CAN_Zone_FL_MCM_03_PassSeatmassgValve5Cmd, ComBitPosition=9, ComBitSize=2, ComFirstTimeout=500, ComHandleId=39, DataTimeoutSupport=true, ComTimeout=500, ComSignalType=UINT8, Direction=Rx, InputName=PassSeatmassgValve5Cmd, offset=0, factor=1, enumValue=0%No action&1%Inflation&2%Deflation&3%Reserved, unitName=, max=3, min=0, compuMethodType=, ComSystemTemplateSystemSignalRef=Cfg_P_Rx_BODY_LE1_CAN_Zone_FL_MCM_03
        Cfg_P_Rx_BODY_LE1_CAN_Zone_FL_MCM_03_PassSeatmassgValve6Cmd: ComNotification=Com_CbkRxAck_Cfg_P_Rx_BODY_LE1_CAN_Zone_FL_MCM_03_PassSeatmassgValve6Cmd, ComTimeoutNotification=Com_CbkRxTOut_Cfg_P_Rx_BODY_LE1_CAN_Zone_FL_MCM_03_PassSeatmassgValve6Cmd, ComBitPosition=11, ComBitSize=2, ComFirstTimeout=500, ComHandleId=40, DataTimeoutSupport=true, ComTimeout=500, ComSignalType=UINT8, Direction=Rx, InputName=PassSeatmassgValve6Cmd, offset=0, factor=1, enumValue=0%No action&1%Inflation&2%Deflation&3%Reserved, unitName=, max=3, min=0, compuMethodType=, ComSystemTemplateSystemSignalRef=Cfg_P_Rx_BODY_LE1_CAN_Zone_FL_MCM_03
        Cfg_P_Rx_BODY_LE1_CAN_Zone_FL_MCM_03_PassSeatmassgValve7Cmd: ComNotification=Com_CbkRxAck_Cfg_P_Rx_BODY_LE1_CAN_Zone_FL_MCM_03_PassSeatmassgValve7Cmd, ComTimeoutNotification=Com_CbkRxTOut_Cfg_P_Rx_BODY_LE1_CAN_Zone_FL_MCM_03_PassSeatmassgValve7Cmd, ComBitPosition=13, ComBitSize=2, ComFirstTimeout=500, ComHandleId=41, DataTimeoutSupport=true, ComTimeout=500, ComSignalType=UINT8, Direction=Rx, InputName=PassSeatmassgValve7Cmd, offset=0, factor=1, enumValue=0%No action&1%Inflation&2%Deflation&3%Reserved, unitName=, max=3, min=0, compuMethodType=, ComSystemTemplateSystemSignalRef=Cfg_P_Rx_BODY_LE1_CAN_Zone_FL_MCM_03
        Cfg_P_Rx_BODY_LE1_CAN_Zone_FL_MCM_03_PassSeatmassgValve8Cmd: ComNotification=Com_CbkRxAck_Cfg_P_Rx_BODY_LE1_CAN_Zone_FL_MCM_03_PassSeatmassgValve8Cmd, ComTimeoutNotification=Com_CbkRxTOut_Cfg_P_Rx_BODY_LE1_CAN_Zone_FL_MCM_03_PassSeatmassgValve8Cmd, ComBitPosition=15, ComBitSize=2, ComFirstTimeout=500, ComHandleId=42, DataTimeoutSupport=true, ComTimeout=500, ComSignalType=UINT8, Direction=Rx, InputName=PassSeatmassgValve8Cmd, offset=0, factor=1, enumValue=0%No action&1%Inflation&2%Deflation&3%Reserved, unitName=, max=3, min=0, compuMethodType=, ComSystemTemplateSystemSignalRef=Cfg_P_Rx_BODY_LE1_CAN_Zone_FL_MCM_03
        Cfg_P_Rx_BODY_LE1_CAN_Zone_FL_MCM_03_PassSeatmassgValve9Cmd: ComNotification=Com_CbkRxAck_Cfg_P_Rx_BODY_LE1_CAN_Zone_FL_MCM_03_PassSeatmassgValve9Cmd, ComTimeoutNotification=Com_CbkRxTOut_Cfg_P_Rx_BODY_LE1_CAN_Zone_FL_MCM_03_PassSeatmassgValve9Cmd, ComBitPosition=17, ComBitSize=2, ComFirstTimeout=500, ComHandleId=43, DataTimeoutSupport=true, ComTimeout=500, ComSignalType=UINT8, Direction=Rx, InputName=PassSeatmassgValve9Cmd, offset=0, factor=1, enumValue=0%No action&1%Inflation&2%Deflation&3%Reserved, unitName=, max=3, min=0, compuMethodType=, ComSystemTemplateSystemSignalRef=Cfg_P_Rx_BODY_LE1_CAN_Zone_FL_MCM_03
        Cfg_P_Rx_BODY_LE1_CAN_Zone_FL_MCM_03_PassSeatmassgValve10Cmd: ComNotification=Com_CbkRxAck_Cfg_P_Rx_BODY_LE1_CAN_Zone_FL_MCM_03_PassSeatmassgValve10Cmd, ComTimeoutNotification=Com_CbkRxTOut_Cfg_P_Rx_BODY_LE1_CAN_Zone_FL_MCM_03_PassSeatmassgValve10Cmd, ComBitPosition=19, ComBitSize=2, ComFirstTimeout=500, ComHandleId=44, DataTimeoutSupport=true, ComTimeout=500, ComSignalType=UINT8, Direction=Rx, InputName=PassSeatmassgValve10Cmd, offset=0, factor=1, enumValue=0%No action&1%Inflation&2%Deflation&3%Reserved, unitName=, max=3, min=0, compuMethodType=, ComSystemTemplateSystemSignalRef=Cfg_P_Rx_BODY_LE1_CAN_Zone_FL_MCM_03
        Cfg_P_Rx_BODY_LE1_CAN_Zone_FL_MCM_03_PassSeatmassgValve11Cmd: ComNotification=Com_CbkRxAck_Cfg_P_Rx_BODY_LE1_CAN_Zone_FL_MCM_03_PassSeatmassgValve11Cmd, ComTimeoutNotification=Com_CbkRxTOut_Cfg_P_Rx_BODY_LE1_CAN_Zone_FL_MCM_03_PassSeatmassgValve11Cmd, ComBitPosition=21, ComBitSize=2, ComFirstTimeout=500, ComHandleId=45, DataTimeoutSupport=true, ComTimeout=500, ComSignalType=UINT8, Direction=Rx, InputName=PassSeatmassgValve11Cmd, offset=0, factor=1, enumValue=0%No action&1%Inflation&2%Deflation&3%Reserved, unitName=, max=3, min=0, compuMethodType=, ComSystemTemplateSystemSignalRef=Cfg_P_Rx_BODY_LE1_CAN_Zone_FL_MCM_03
        Cfg_P_Rx_BODY_LE1_CAN_Zone_FL_MCM_03_PassSeatmassgValve12Cmd: ComNotification=Com_CbkRxAck_Cfg_P_Rx_BODY_LE1_CAN_Zone_FL_MCM_03_PassSeatmassgValve12Cmd, ComTimeoutNotification=Com_CbkRxTOut_Cfg_P_Rx_BODY_LE1_CAN_Zone_FL_MCM_03_PassSeatmassgValve12Cmd, ComBitPosition=23, ComBitSize=2, ComFirstTimeout=500, ComHandleId=46, DataTimeoutSupport=true, ComTimeout=500, ComSignalType=UINT8, Direction=Rx, InputName=PassSeatmassgValve12Cmd, offset=0, factor=1, enumValue=0%No action&1%Inflation&2%Deflation&3%Reserved, unitName=, max=3, min=0, compuMethodType=, ComSystemTemplateSystemSignalRef=Cfg_P_Rx_BODY_LE1_CAN_Zone_FL_MCM_03
        Cfg_P_Rx_BODY_LE1_CAN_Zone_FL_MCM_03_PassSeatmassgHeat1Cmd: ComNotification=Com_CbkRxAck_Cfg_P_Rx_BODY_LE1_CAN_Zone_FL_MCM_03_PassSeatmassgHeat1Cmd, ComTimeoutNotification=Com_CbkRxTOut_Cfg_P_Rx_BODY_LE1_CAN_Zone_FL_MCM_03_PassSeatmassgHeat1Cmd, ComBitPosition=25, ComBitSize=2, ComFirstTimeout=500, ComHandleId=47, DataTimeoutSupport=true, ComTimeout=500, ComSignalType=UINT8, Direction=Rx, InputName=PassSeatmassgHeat1Cmd, offset=0, factor=1, enumValue=0%No action&1%Heat open&2%Heat Close&3%Reserved, unitName=, max=3, min=0, compuMethodType=, ComSystemTemplateSystemSignalRef=Cfg_P_Rx_BODY_LE1_CAN_Zone_FL_MCM_03
        Cfg_P_Rx_BODY_LE1_CAN_Zone_FL_MCM_03_PassSeatmassgHeat2Cmd: ComNotification=Com_CbkRxAck_Cfg_P_Rx_BODY_LE1_CAN_Zone_FL_MCM_03_PassSeatmassgHeat2Cmd, ComTimeoutNotification=Com_CbkRxTOut_Cfg_P_Rx_BODY_LE1_CAN_Zone_FL_MCM_03_PassSeatmassgHeat2Cmd, ComBitPosition=27, ComBitSize=2, ComFirstTimeout=500, ComHandleId=48, DataTimeoutSupport=true, ComTimeout=500, ComSignalType=UINT8, Direction=Rx, InputName=PassSeatmassgHeat2Cmd, offset=0, factor=1, enumValue=0%No action&1%Heat open&2%Heat Close&3%Reserved, unitName=, max=3, min=0, compuMethodType=, ComSystemTemplateSystemSignalRef=Cfg_P_Rx_BODY_LE1_CAN_Zone_FL_MCM_03
        Cfg_P_Rx_BODY_LE1_CAN_Zone_FL_MCM_03_PassSeatmassgHeat3Cmd: ComNotification=Com_CbkRxAck_Cfg_P_Rx_BODY_LE1_CAN_Zone_FL_MCM_03_PassSeatmassgHeat3Cmd, ComTimeoutNotification=Com_CbkRxTOut_Cfg_P_Rx_BODY_LE1_CAN_Zone_FL_MCM_03_PassSeatmassgHeat3Cmd, ComBitPosition=29, ComBitSize=2, ComFirstTimeout=500, ComHandleId=49, DataTimeoutSupport=true, ComTimeout=500, ComSignalType=UINT8, Direction=Rx, InputName=PassSeatmassgHeat3Cmd, offset=0, factor=1, enumValue=0%No action&1%Heat open&2%Heat Close&3%Reserved, unitName=, max=3, min=0, compuMethodType=, ComSystemTemplateSystemSignalRef=Cfg_P_Rx_BODY_LE1_CAN_Zone_FL_MCM_03
        Cfg_P_Rx_BODY_LE1_CAN_Zone_FL_MCM_03_PassSeatmassgHeat4Cmd: ComNotification=Com_CbkRxAck_Cfg_P_Rx_BODY_LE1_CAN_Zone_FL_MCM_03_PassSeatmassgHeat4Cmd, ComTimeoutNotification=Com_CbkRxTOut_Cfg_P_Rx_BODY_LE1_CAN_Zone_FL_MCM_03_PassSeatmassgHeat4Cmd, ComBitPosition=31, ComBitSize=2, ComFirstTimeout=500, ComHandleId=50, DataTimeoutSupport=true, ComTimeout=500, ComSignalType=UINT8, Direction=Rx, InputName=PassSeatmassgHeat4Cmd, offset=0, factor=1, enumValue=0%No action&1%Heat open&2%Heat Close&3%Reserved, unitName=, max=3, min=0, compuMethodType=, ComSystemTemplateSystemSignalRef=Cfg_P_Rx_BODY_LE1_CAN_Zone_FL_MCM_03
        Cfg_P_Rx_BODY_LE1_CAN_Zone_FL_MCM_03_PassSeatmassgHeat5Cmd: ComNotification=Com_CbkRxAck_Cfg_P_Rx_BODY_LE1_CAN_Zone_FL_MCM_03_PassSeatmassgHeat5Cmd, ComTimeoutNotification=Com_CbkRxTOut_Cfg_P_Rx_BODY_LE1_CAN_Zone_FL_MCM_03_PassSeatmassgHeat5Cmd, ComBitPosition=33, ComBitSize=2, ComFirstTimeout=500, ComHandleId=51, DataTimeoutSupport=true, ComTimeout=500, ComSignalType=UINT8, Direction=Rx, InputName=PassSeatmassgHeat5Cmd, offset=0, factor=1, enumValue=0%No action&1%Heat open&2%Heat Close&3%Reserved, unitName=, max=3, min=0, compuMethodType=, ComSystemTemplateSystemSignalRef=Cfg_P_Rx_BODY_LE1_CAN_Zone_FL_MCM_03
        Cfg_P_Rx_BODY_LE1_CAN_Zone_FL_MCM_03_PassSeatmassgHeat6Cmd: ComNotification=Com_CbkRxAck_Cfg_P_Rx_BODY_LE1_CAN_Zone_FL_MCM_03_PassSeatmassgHeat6Cmd, ComTimeoutNotification=Com_CbkRxTOut_Cfg_P_Rx_BODY_LE1_CAN_Zone_FL_MCM_03_PassSeatmassgHeat6Cmd, ComBitPosition=35, ComBitSize=2, ComFirstTimeout=500, ComHandleId=52, DataTimeoutSupport=true, ComTimeout=500, ComSignalType=UINT8, Direction=Rx, InputName=PassSeatmassgHeat6Cmd, offset=0, factor=1, enumValue=0%No action&1%Heat open&2%Heat Close&3%Reserved, unitName=, max=3, min=0, compuMethodType=, ComSystemTemplateSystemSignalRef=Cfg_P_Rx_BODY_LE1_CAN_Zone_FL_MCM_03
        Cfg_P_Rx_BODY_LE1_CAN_Zone_FL_MCM_03_PassSeatmassgHeat7Cmd: ComNotification=Com_CbkRxAck_Cfg_P_Rx_BODY_LE1_CAN_Zone_FL_MCM_03_PassSeatmassgHeat7Cmd, ComTimeoutNotification=Com_CbkRxTOut_Cfg_P_Rx_BODY_LE1_CAN_Zone_FL_MCM_03_PassSeatmassgHeat7Cmd, ComBitPosition=37, ComBitSize=2, ComFirstTimeout=500, ComHandleId=53, DataTimeoutSupport=true, ComTimeout=500, ComSignalType=UINT8, Direction=Rx, InputName=PassSeatmassgHeat7Cmd, offset=0, factor=1, enumValue=0%No action&1%Heat open&2%Heat Close&3%Reserved, unitName=, max=3, min=0, compuMethodType=, ComSystemTemplateSystemSignalRef=Cfg_P_Rx_BODY_LE1_CAN_Zone_FL_MCM_03
        Cfg_P_Rx_BODY_LE1_CAN_Zone_FL_MCM_03_PassSeatmassgHeat8Cmd: ComNotification=Com_CbkRxAck_Cfg_P_Rx_BODY_LE1_CAN_Zone_FL_MCM_03_PassSeatmassgHeat8Cmd, ComTimeoutNotification=Com_CbkRxTOut_Cfg_P_Rx_BODY_LE1_CAN_Zone_FL_MCM_03_PassSeatmassgHeat8Cmd, ComBitPosition=39, ComBitSize=2, ComFirstTimeout=500, ComHandleId=54, DataTimeoutSupport=true, ComTimeout=500, ComSignalType=UINT8, Direction=Rx, InputName=PassSeatmassgHeat8Cmd, offset=0, factor=1, enumValue=0%No action&1%Heat open&2%Heat Close&3%Reserved, unitName=, max=3, min=0, compuMethodType=, ComSystemTemplateSystemSignalRef=Cfg_P_Rx_BODY_LE1_CAN_Zone_FL_MCM_03
        Cfg_P_Rx_BODY_LE1_CAN_Zone_FL_MCM_03_PassSeatmassgHeat9Cmd: ComNotification=Com_CbkRxAck_Cfg_P_Rx_BODY_LE1_CAN_Zone_FL_MCM_03_PassSeatmassgHeat9Cmd, ComTimeoutNotification=Com_CbkRxTOut_Cfg_P_Rx_BODY_LE1_CAN_Zone_FL_MCM_03_PassSeatmassgHeat9Cmd, ComBitPosition=41, ComBitSize=2, ComFirstTimeout=500, ComHandleId=55, DataTimeoutSupport=true, ComTimeout=500, ComSignalType=UINT8, Direction=Rx, InputName=PassSeatmassgHeat9Cmd, offset=0, factor=1, enumValue=0%No action&1%Heat open&2%Heat Close&3%Reserved, unitName=, max=3, min=0, compuMethodType=, ComSystemTemplateSystemSignalRef=Cfg_P_Rx_BODY_LE1_CAN_Zone_FL_MCM_03
        Cfg_P_Rx_BODY_LE1_CAN_Zone_FL_MCM_03_PassSeatmassgHeat10Cmd: ComNotification=Com_CbkRxAck_Cfg_P_Rx_BODY_LE1_CAN_Zone_FL_MCM_03_PassSeatmassgHeat10Cmd, ComTimeoutNotification=Com_CbkRxTOut_Cfg_P_Rx_BODY_LE1_CAN_Zone_FL_MCM_03_PassSeatmassgHeat10Cmd, ComBitPosition=43, ComBitSize=2, ComFirstTimeout=500, ComHandleId=56, DataTimeoutSupport=true, ComTimeout=500, ComSignalType=UINT8, Direction=Rx, InputName=PassSeatmassgHeat10Cmd, offset=0, factor=1, enumValue=0%No action&1%Heat open&2%Heat Close&3%Reserved, unitName=, max=3, min=0, compuMethodType=, ComSystemTemplateSystemSignalRef=Cfg_P_Rx_BODY_LE1_CAN_Zone_FL_MCM_03
        Cfg_P_Rx_BODY_LE1_CAN_Zone_FL_MCM_03_PassSeatmassgHeat11Cmd: ComNotification=Com_CbkRxAck_Cfg_P_Rx_BODY_LE1_CAN_Zone_FL_MCM_03_PassSeatmassgHeat11Cmd, ComTimeoutNotification=Com_CbkRxTOut_Cfg_P_Rx_BODY_LE1_CAN_Zone_FL_MCM_03_PassSeatmassgHeat11Cmd, ComBitPosition=45, ComBitSize=2, ComFirstTimeout=500, ComHandleId=57, DataTimeoutSupport=true, ComTimeout=500, ComSignalType=UINT8, Direction=Rx, InputName=PassSeatmassgHeat11Cmd, offset=0, factor=1, enumValue=0%No action&1%Heat open&2%Heat Close&3%Reserved, unitName=, max=3, min=0, compuMethodType=, ComSystemTemplateSystemSignalRef=Cfg_P_Rx_BODY_LE1_CAN_Zone_FL_MCM_03
        Cfg_P_Rx_BODY_LE1_CAN_Zone_FL_MCM_03_PassSeatmassgHeat12Cmd: ComNotification=Com_CbkRxAck_Cfg_P_Rx_BODY_LE1_CAN_Zone_FL_MCM_03_PassSeatmassgHeat12Cmd, ComTimeoutNotification=Com_CbkRxTOut_Cfg_P_Rx_BODY_LE1_CAN_Zone_FL_MCM_03_PassSeatmassgHeat12Cmd, ComBitPosition=47, ComBitSize=2, ComFirstTimeout=500, ComHandleId=58, DataTimeoutSupport=true, ComTimeout=500, ComSignalType=UINT8, Direction=Rx, InputName=PassSeatmassgHeat12Cmd, offset=0, factor=1, enumValue=0%No action&1%Heat open&2%Heat Close&3%Reserved, unitName=, max=3, min=0, compuMethodType=, ComSystemTemplateSystemSignalRef=Cfg_P_Rx_BODY_LE1_CAN_Zone_FL_MCM_03
        Cfg_P_Rx_BODY_LE1_CAN_Zone_FL_MCM_03_PassSeatLumbarTopValue1Cmd: ComNotification=Com_CbkRxAck_Cfg_P_Rx_BODY_LE1_CAN_Zone_FL_MCM_03_PassSeatLumbarTopValue1Cmd, ComTimeoutNotification=Com_CbkRxTOut_Cfg_P_Rx_BODY_LE1_CAN_Zone_FL_MCM_03_PassSeatLumbarTopValue1Cmd, ComBitPosition=49, ComBitSize=2, ComFirstTimeout=500, ComHandleId=59, DataTimeoutSupport=true, ComTimeout=500, ComSignalType=UINT8, Direction=Rx, InputName=PassSeatLumbarTopValue1Cmd, offset=0, factor=1, enumValue=0%No action&1%Inflation&2%Deflation&3%Reserved, unitName=, max=3, min=0, compuMethodType=, ComSystemTemplateSystemSignalRef=Cfg_P_Rx_BODY_LE1_CAN_Zone_FL_MCM_03
        Cfg_P_Rx_BODY_LE1_CAN_Zone_FL_MCM_03_PassSeatLumbarMidValue2Cmd: ComNotification=Com_CbkRxAck_Cfg_P_Rx_BODY_LE1_CAN_Zone_FL_MCM_03_PassSeatLumbarMidValue2Cmd, ComTimeoutNotification=Com_CbkRxTOut_Cfg_P_Rx_BODY_LE1_CAN_Zone_FL_MCM_03_PassSeatLumbarMidValue2Cmd, ComBitPosition=51, ComBitSize=2, ComFirstTimeout=500, ComHandleId=60, DataTimeoutSupport=true, ComTimeout=500, ComSignalType=UINT8, Direction=Rx, InputName=PassSeatLumbarMidValue2Cmd, offset=0, factor=1, enumValue=0%No action&1%Inflation&2%Deflation&3%Reserved, unitName=, max=3, min=0, compuMethodType=, ComSystemTemplateSystemSignalRef=Cfg_P_Rx_BODY_LE1_CAN_Zone_FL_MCM_03
        Cfg_P_Rx_BODY_LE1_CAN_Zone_FL_MCM_03_PassSeatLumbarBottomValue3Cmd: ComNotification=Com_CbkRxAck_Cfg_P_Rx_BODY_LE1_CAN_Zone_FL_MCM_03_PassSeatLumbarBottomValue3Cmd, ComTimeoutNotification=Com_CbkRxTOut_Cfg_P_Rx_BODY_LE1_CAN_Zone_FL_MCM_03_PassSeatLumbarBottomValue3Cmd, ComBitPosition=53, ComBitSize=2, ComFirstTimeout=500, ComHandleId=61, DataTimeoutSupport=true, ComTimeout=500, ComSignalType=UINT8, Direction=Rx, InputName=PassSeatLumbarBottomValue3Cmd, offset=0, factor=1, enumValue=0%No action&1%Inflation&2%Deflation&3%Reserved, unitName=, max=3, min=0, compuMethodType=, ComSystemTemplateSystemSignalRef=Cfg_P_Rx_BODY_LE1_CAN_Zone_FL_MCM_03
        Cfg_P_Rx_BODY_LE1_CAN_Zone_FL_MCM_03_PassSeatBolsterValueBLCmd: ComNotification=Com_CbkRxAck_Cfg_P_Rx_BODY_LE1_CAN_Zone_FL_MCM_03_PassSeatBolsterValueBLCmd, ComTimeoutNotification=Com_CbkRxTOut_Cfg_P_Rx_BODY_LE1_CAN_Zone_FL_MCM_03_PassSeatBolsterValueBLCmd, ComBitPosition=55, ComBitSize=2, ComFirstTimeout=500, ComHandleId=62, DataTimeoutSupport=true, ComTimeout=500, ComSignalType=UINT8, Direction=Rx, InputName=PassSeatBolsterValueBLCmd, offset=0, factor=1, enumValue=0%No action&1%Inflation&2%Deflation&3%Reserved, unitName=, max=3, min=0, compuMethodType=, ComSystemTemplateSystemSignalRef=Cfg_P_Rx_BODY_LE1_CAN_Zone_FL_MCM_03
        Cfg_P_Rx_BODY_LE1_CAN_Zone_FL_MCM_03_PassSeatBolsterValueBRCmd: ComNotification=Com_CbkRxAck_Cfg_P_Rx_BODY_LE1_CAN_Zone_FL_MCM_03_PassSeatBolsterValueBRCmd, ComTimeoutNotification=Com_CbkRxTOut_Cfg_P_Rx_BODY_LE1_CAN_Zone_FL_MCM_03_PassSeatBolsterValueBRCmd, ComBitPosition=57, ComBitSize=2, ComFirstTimeout=500, ComHandleId=63, DataTimeoutSupport=true, ComTimeout=500, ComSignalType=UINT8, Direction=Rx, InputName=PassSeatBolsterValueBRCmd, offset=0, factor=1, enumValue=0%No action&1%Inflation&2%Deflation&3%Reserved, unitName=, max=3, min=0, compuMethodType=, ComSystemTemplateSystemSignalRef=Cfg_P_Rx_BODY_LE1_CAN_Zone_FL_MCM_03
        Cfg_P_Rx_BODY_LE1_CAN_Zone_FL_MCM_03_PassSeatCushionValue6Cmd: ComNotification=Com_CbkRxAck_Cfg_P_Rx_BODY_LE1_CAN_Zone_FL_MCM_03_PassSeatCushionValue6Cmd, ComTimeoutNotification=Com_CbkRxTOut_Cfg_P_Rx_BODY_LE1_CAN_Zone_FL_MCM_03_PassSeatCushionValue6Cmd, ComBitPosition=59, ComBitSize=2, ComFirstTimeout=500, ComHandleId=64, DataTimeoutSupport=true, ComTimeout=500, ComSignalType=UINT8, Direction=Rx, InputName=PassSeatCushionValue6Cmd, offset=0, factor=1, enumValue=0%No action&1%Inflation&2%Deflation&3%Reserved, unitName=, max=3, min=0, compuMethodType=, ComSystemTemplateSystemSignalRef=Cfg_P_Rx_BODY_LE1_CAN_Zone_FL_MCM_03
        Cfg_P_Rx_BODY_LE1_CAN_Zone_FL_MCM_03_PassSeatCushionValue5Cmd: ComNotification=Com_CbkRxAck_Cfg_P_Rx_BODY_LE1_CAN_Zone_FL_MCM_03_PassSeatCushionValue5Cmd, ComTimeoutNotification=Com_CbkRxTOut_Cfg_P_Rx_BODY_LE1_CAN_Zone_FL_MCM_03_PassSeatCushionValue5Cmd, ComBitPosition=61, ComBitSize=2, ComFirstTimeout=500, ComHandleId=65, DataTimeoutSupport=true, ComTimeout=500, ComSignalType=UINT8, Direction=Rx, InputName=PassSeatCushionValue5Cmd, offset=0, factor=1, enumValue=0%No action&1%Inflation&2%Deflation&3%Reserved, unitName=, max=3, min=0, compuMethodType=, ComSystemTemplateSystemSignalRef=Cfg_P_Rx_BODY_LE1_CAN_Zone_FL_MCM_03
        Cfg_P_Rx_BODY_LE1_CAN_Zone_FL_MCM_03_PassSeatCushionValue4Cmd: ComNotification=Com_CbkRxAck_Cfg_P_Rx_BODY_LE1_CAN_Zone_FL_MCM_03_PassSeatCushionValue4Cmd, ComTimeoutNotification=Com_CbkRxTOut_Cfg_P_Rx_BODY_LE1_CAN_Zone_FL_MCM_03_PassSeatCushionValue4Cmd, ComBitPosition=63, ComBitSize=2, ComFirstTimeout=500, ComHandleId=66, DataTimeoutSupport=true, ComTimeout=500, ComSignalType=UINT8, Direction=Rx, InputName=PassSeatCushionValue4Cmd, offset=0, factor=1, enumValue=0%No action&1%Inflation&2%Deflation&3%Reserved, unitName=, max=3, min=0, compuMethodType=, ComSystemTemplateSystemSignalRef=Cfg_P_Rx_BODY_LE1_CAN_Zone_FL_MCM_03
        Cfg_P_Rx_BODY_LE1_CAN_Zone_FL_MCM_04_PassPumpCmd: ComNotification=Com_CbkRxAck_Cfg_P_Rx_BODY_LE1_CAN_Zone_FL_MCM_04_PassPumpCmd, ComTimeoutNotification=Com_CbkRxTOut_Cfg_P_Rx_BODY_LE1_CAN_Zone_FL_MCM_04_PassPumpCmd, ComBitPosition=23, ComBitSize=7, ComFirstTimeout=500, ComHandleId=67, DataTimeoutSupport=true, ComTimeout=500, ComSignalType=UINT8, Direction=Rx, InputName=PassPumpCmd, offset=0, factor=1, enumValue=, unitName=, max=127, min=0, compuMethodType=, ComSystemTemplateSystemSignalRef=Cfg_P_Rx_BODY_LE1_CAN_Zone_FL_MCM_04
        Cfg_P_Rx_BODY_LE1_CAN_Zone_FL_MCM_04_PassSeatUpperValueLCmd: ComNotification=Com_CbkRxAck_Cfg_P_Rx_BODY_LE1_CAN_Zone_FL_MCM_04_PassSeatUpperValueLCmd, ComTimeoutNotification=Com_CbkRxTOut_Cfg_P_Rx_BODY_LE1_CAN_Zone_FL_MCM_04_PassSeatUpperValueLCmd, ComBitPosition=25, ComBitSize=2, ComFirstTimeout=500, ComHandleId=68, DataTimeoutSupport=true, ComTimeout=500, ComSignalType=UINT8, Direction=Rx, InputName=PassSeatUpperValueLCmd, offset=0, factor=1, enumValue=0%No action&1%Inflation&2%Deflation&3%Reserved, unitName=, max=3, min=0, compuMethodType=, ComSystemTemplateSystemSignalRef=Cfg_P_Rx_BODY_LE1_CAN_Zone_FL_MCM_04
        Cfg_P_Rx_BODY_LE1_CAN_Zone_FL_MCM_04_PassSeatUpperValueMCmd: ComNotification=Com_CbkRxAck_Cfg_P_Rx_BODY_LE1_CAN_Zone_FL_MCM_04_PassSeatUpperValueMCmd, ComTimeoutNotification=Com_CbkRxTOut_Cfg_P_Rx_BODY_LE1_CAN_Zone_FL_MCM_04_PassSeatUpperValueMCmd, ComBitPosition=27, ComBitSize=2, ComFirstTimeout=500, ComHandleId=69, DataTimeoutSupport=true, ComTimeout=500, ComSignalType=UINT8, Direction=Rx, InputName=PassSeatUpperValueMCmd, offset=0, factor=1, enumValue=0%No action&1%Inflation&2%Deflation&3%Reserved, unitName=, max=3, min=0, compuMethodType=, ComSystemTemplateSystemSignalRef=Cfg_P_Rx_BODY_LE1_CAN_Zone_FL_MCM_04
        Cfg_P_Rx_BODY_LE1_CAN_Zone_FL_MCM_04_PassSeatUpperValueRCmd: ComNotification=Com_CbkRxAck_Cfg_P_Rx_BODY_LE1_CAN_Zone_FL_MCM_04_PassSeatUpperValueRCmd, ComTimeoutNotification=Com_CbkRxTOut_Cfg_P_Rx_BODY_LE1_CAN_Zone_FL_MCM_04_PassSeatUpperValueRCmd, ComBitPosition=29, ComBitSize=2, ComFirstTimeout=500, ComHandleId=70, DataTimeoutSupport=true, ComTimeout=500, ComSignalType=UINT8, Direction=Rx, InputName=PassSeatUpperValueRCmd, offset=0, factor=1, enumValue=0%No action&1%Inflation&2%Deflation&3%Reserved, unitName=, max=3, min=0, compuMethodType=, ComSystemTemplateSystemSignalRef=Cfg_P_Rx_BODY_LE1_CAN_Zone_FL_MCM_04
        Cfg_P_Rx_BODY_LE1_CAN_Zone_FL_MCM_04_PassSeatCushionValue2Cmd: ComNotification=Com_CbkRxAck_Cfg_P_Rx_BODY_LE1_CAN_Zone_FL_MCM_04_PassSeatCushionValue2Cmd, ComTimeoutNotification=Com_CbkRxTOut_Cfg_P_Rx_BODY_LE1_CAN_Zone_FL_MCM_04_PassSeatCushionValue2Cmd, ComBitPosition=31, ComBitSize=2, ComFirstTimeout=500, ComHandleId=71, DataTimeoutSupport=true, ComTimeout=500, ComSignalType=UINT8, Direction=Rx, InputName=PassSeatCushionValue2Cmd, offset=0, factor=1, enumValue=0%No action&1%Inflation&2%Deflation&3%Reserved, unitName=, max=3, min=0, compuMethodType=, ComSystemTemplateSystemSignalRef=Cfg_P_Rx_BODY_LE1_CAN_Zone_FL_MCM_04
        Cfg_P_Rx_BODY_LE1_CAN_Zone_FL_MCM_04_PassSeatCushionValue3Cmd: ComNotification=Com_CbkRxAck_Cfg_P_Rx_BODY_LE1_CAN_Zone_FL_MCM_04_PassSeatCushionValue3Cmd, ComTimeoutNotification=Com_CbkRxTOut_Cfg_P_Rx_BODY_LE1_CAN_Zone_FL_MCM_04_PassSeatCushionValue3Cmd, ComBitPosition=37, ComBitSize=2, ComFirstTimeout=500, ComHandleId=72, DataTimeoutSupport=true, ComTimeout=500, ComSignalType=UINT8, Direction=Rx, InputName=PassSeatCushionValue3Cmd, offset=0, factor=1, enumValue=0%No action&1%Inflation&2%Deflation&3%Reserved, unitName=, max=3, min=0, compuMethodType=, ComSystemTemplateSystemSignalRef=Cfg_P_Rx_BODY_LE1_CAN_Zone_FL_MCM_04
        Cfg_P_Rx_BODY_LE1_CAN_Zone_FL_MCM_04_PassSeatCushionValue1Cmd: ComNotification=Com_CbkRxAck_Cfg_P_Rx_BODY_LE1_CAN_Zone_FL_MCM_04_PassSeatCushionValue1Cmd, ComTimeoutNotification=Com_CbkRxTOut_Cfg_P_Rx_BODY_LE1_CAN_Zone_FL_MCM_04_PassSeatCushionValue1Cmd, ComBitPosition=39, ComBitSize=2, ComFirstTimeout=500, ComHandleId=73, DataTimeoutSupport=true, ComTimeout=500, ComSignalType=UINT8, Direction=Rx, InputName=PassSeatCushionValue1Cmd, offset=0, factor=1, enumValue=0%No action&1%Inflation&2%Deflation&3%Reserved, unitName=, max=3, min=0, compuMethodType=, ComSystemTemplateSystemSignalRef=Cfg_P_Rx_BODY_LE1_CAN_Zone_FL_MCM_04
        Cfg_P_Rx_BODY_LE1_CAN_ZONE_2EF_BattVolt_LBMR: ComNotification=Com_CbkRxAck_Cfg_P_Rx_BODY_LE1_CAN_ZONE_2EF_BattVolt_LBMR, ComTimeoutNotification=, ComBitPosition=23, ComBitSize=16, ComFirstTimeout=0, ComHandleId=74, DataTimeoutSupport=false, ComTimeout=0, ComSignalType=UINT16, Direction=Rx, InputName=BattVolt_LBMR, offset=0, factor=0.001, enumValue=, unitName=V, max=65.535, min=0, compuMethodType=INTERNALTOPHYS, ComSystemTemplateSystemSignalRef=Cfg_P_Rx_BODY_LE1_CAN_ZONE_2EF
        Cfg_P_Rx_BODY_LE1_CAN_ZONE_3A9_VehOdometer: ComNotification=Com_CbkRxAck_Cfg_P_Rx_BODY_LE1_CAN_ZONE_3A9_VehOdometer, ComTimeoutNotification=Com_CbkRxTOut_Cfg_P_Rx_BODY_LE1_CAN_ZONE_3A9_VehOdometer, ComBitPosition=7, ComBitSize=24, ComFirstTimeout=500, ComHandleId=75, DataTimeoutSupport=true, ComTimeout=500, ComSignalType=UINT32, Direction=Rx, InputName=VehOdometer, offset=0, factor=1, enumValue=, unitName=km, max=16777215, min=0, compuMethodType=, ComSystemTemplateSystemSignalRef=Cfg_P_Rx_BODY_LE1_CAN_ZONE_3A9
        Cfg_P_Rx_BODY_LE1_CAN_ZONE_3B2_Yr: ComNotification=Com_CbkRxAck_Cfg_P_Rx_BODY_LE1_CAN_ZONE_3B2_Yr, ComTimeoutNotification=Com_CbkRxTOut_Cfg_P_Rx_BODY_LE1_CAN_ZONE_3B2_Yr, ComBitPosition=7, ComBitSize=8, ComFirstTimeout=500, ComHandleId=76, DataTimeoutSupport=true, ComTimeout=6000, ComSignalType=UINT8, Direction=Rx, InputName=Yr, offset=2000, factor=1, enumValue=, unitName=Year, max=2254, min=2000, compuMethodType=INTERNALTOPHYS, ComSystemTemplateSystemSignalRef=Cfg_P_Rx_BODY_LE1_CAN_ZONE_3B2
        Cfg_P_Rx_BODY_LE1_CAN_ZONE_3B2_Mth: ComNotification=Com_CbkRxAck_Cfg_P_Rx_BODY_LE1_CAN_ZONE_3B2_Mth, ComTimeoutNotification=Com_CbkRxTOut_Cfg_P_Rx_BODY_LE1_CAN_ZONE_3B2_Mth, ComBitPosition=11, ComBitSize=4, ComFirstTimeout=500, ComHandleId=77, DataTimeoutSupport=true, ComTimeout=6000, ComSignalType=UINT8, Direction=Rx, InputName=Mth, offset=0, factor=1, enumValue=11%November&12%December&13%Reserved&14%Reserved&15%Invalid&0%Unknown&1%January&2%February&3%March&4%April&5%May&6%June&7%July&8%August&9%September&10%October, unitName=, max=15, min=0, compuMethodType=, ComSystemTemplateSystemSignalRef=Cfg_P_Rx_BODY_LE1_CAN_ZONE_3B2
        Cfg_P_Rx_BODY_LE1_CAN_ZONE_3B2_Day: ComNotification=Com_CbkRxAck_Cfg_P_Rx_BODY_LE1_CAN_ZONE_3B2_Day, ComTimeoutNotification=Com_CbkRxTOut_Cfg_P_Rx_BODY_LE1_CAN_ZONE_3B2_Day, ComBitPosition=20, ComBitSize=5, ComFirstTimeout=500, ComHandleId=78, DataTimeoutSupport=true, ComTimeout=6000, ComSignalType=UINT8, Direction=Rx, InputName=Day, offset=0, factor=1, enumValue=, unitName=Day, max=31, min=0, compuMethodType=, ComSystemTemplateSystemSignalRef=Cfg_P_Rx_BODY_LE1_CAN_ZONE_3B2
        Cfg_P_Rx_BODY_LE1_CAN_ZONE_3B2_Hr: ComNotification=Com_CbkRxAck_Cfg_P_Rx_BODY_LE1_CAN_ZONE_3B2_Hr, ComTimeoutNotification=Com_CbkRxTOut_Cfg_P_Rx_BODY_LE1_CAN_ZONE_3B2_Hr, ComBitPosition=28, ComBitSize=5, ComFirstTimeout=500, ComHandleId=79, DataTimeoutSupport=true, ComTimeout=6000, ComSignalType=UINT8, Direction=Rx, InputName=Hr, offset=0, factor=1, enumValue=, unitName=Hour, max=23, min=0, compuMethodType=, ComSystemTemplateSystemSignalRef=Cfg_P_Rx_BODY_LE1_CAN_ZONE_3B2
        Cfg_P_Rx_BODY_LE1_CAN_ZONE_3B2_Min: ComNotification=Com_CbkRxAck_Cfg_P_Rx_BODY_LE1_CAN_ZONE_3B2_Min, ComTimeoutNotification=Com_CbkRxTOut_Cfg_P_Rx_BODY_LE1_CAN_ZONE_3B2_Min, ComBitPosition=37, ComBitSize=6, ComFirstTimeout=500, ComHandleId=80, DataTimeoutSupport=true, ComTimeout=6000, ComSignalType=UINT8, Direction=Rx, InputName=Min, offset=0, factor=1, enumValue=, unitName=min, max=59, min=0, compuMethodType=, ComSystemTemplateSystemSignalRef=Cfg_P_Rx_BODY_LE1_CAN_ZONE_3B2
        Cfg_P_Rx_BODY_LE1_CAN_ZONE_3B2_Sec: ComNotification=Com_CbkRxAck_Cfg_P_Rx_BODY_LE1_CAN_ZONE_3B2_Sec, ComTimeoutNotification=Com_CbkRxTOut_Cfg_P_Rx_BODY_LE1_CAN_ZONE_3B2_Sec, ComBitPosition=45, ComBitSize=6, ComFirstTimeout=500, ComHandleId=81, DataTimeoutSupport=true, ComTimeout=6000, ComSignalType=UINT8, Direction=Rx, InputName=Sec, offset=0, factor=1, enumValue=, unitName=Sec, max=59, min=0, compuMethodType=, ComSystemTemplateSystemSignalRef=Cfg_P_Rx_BODY_LE1_CAN_ZONE_3B2
        Cfg_P_Rx_BODY_LE1_CAN_ZONE_3B2_MSec: ComNotification=Com_CbkRxAck_Cfg_P_Rx_BODY_LE1_CAN_ZONE_3B2_MSec, ComTimeoutNotification=Com_CbkRxTOut_Cfg_P_Rx_BODY_LE1_CAN_ZONE_3B2_MSec, ComBitPosition=49, ComBitSize=10, ComFirstTimeout=500, ComHandleId=82, DataTimeoutSupport=true, ComTimeout=6000, ComSignalType=UINT16, Direction=Rx, InputName=MSec, offset=0, factor=1, enumValue=, unitName=, max=1023, min=0, compuMethodType=, ComSystemTemplateSystemSignalRef=Cfg_P_Rx_BODY_LE1_CAN_ZONE_3B2
        Cfg_P_Rx_BODY_LE1_CAN_ZONE_PNC_PNC_DFT: ComNotification=Com_CbkRxAck_Cfg_P_Rx_BODY_LE1_CAN_ZONE_PNC_PNC_DFT, ComTimeoutNotification=, ComBitPosition=15, ComBitSize=1, ComFirstTimeout=0, ComHandleId=83, DataTimeoutSupport=false, ComTimeout=0, ComSignalType=UINT8, Direction=Rx, InputName=PNC_DFT, offset=0, factor=1, enumValue=0%Inactive&1%Active, unitName=, max=1, min=0, compuMethodType=, ComSystemTemplateSystemSignalRef=Cfg_P_Rx_BODY_LE1_CAN_ZONE_PNC
        Cfg_P_Rx_BODY_LE1_CAN_ZONE_PNC_PNC1_Sts: ComNotification=Com_CbkRxAck_Cfg_P_Rx_BODY_LE1_CAN_ZONE_PNC_PNC1_Sts, ComTimeoutNotification=, ComBitPosition=16, ComBitSize=1, ComFirstTimeout=0, ComHandleId=84, DataTimeoutSupport=false, ComTimeout=0, ComSignalType=UINT8, Direction=Rx, InputName=PNC1_Sts, offset=0, factor=1, enumValue=0%Inactive&1%Active, unitName=, max=1, min=0, compuMethodType=, ComSystemTemplateSystemSignalRef=Cfg_P_Rx_BODY_LE1_CAN_ZONE_PNC
        Cfg_P_Rx_BODY_LE1_CAN_ZONE_PNC_PNC2_Sts: ComNotification=Com_CbkRxAck_Cfg_P_Rx_BODY_LE1_CAN_ZONE_PNC_PNC2_Sts, ComTimeoutNotification=, ComBitPosition=17, ComBitSize=1, ComFirstTimeout=0, ComHandleId=85, DataTimeoutSupport=false, ComTimeout=0, ComSignalType=UINT8, Direction=Rx, InputName=PNC2_Sts, offset=0, factor=1, enumValue=0%Inactive&1%Active, unitName=, max=1, min=0, compuMethodType=, ComSystemTemplateSystemSignalRef=Cfg_P_Rx_BODY_LE1_CAN_ZONE_PNC
        Cfg_P_Rx_BODY_LE1_CAN_ZONE_PNC_PNC3_Sts: ComNotification=Com_CbkRxAck_Cfg_P_Rx_BODY_LE1_CAN_ZONE_PNC_PNC3_Sts, ComTimeoutNotification=, ComBitPosition=18, ComBitSize=1, ComFirstTimeout=0, ComHandleId=86, DataTimeoutSupport=false, ComTimeout=0, ComSignalType=UINT8, Direction=Rx, InputName=PNC3_Sts, offset=0, factor=1, enumValue=0%Inactive&1%Active, unitName=, max=1, min=0, compuMethodType=, ComSystemTemplateSystemSignalRef=Cfg_P_Rx_BODY_LE1_CAN_ZONE_PNC
        Cfg_P_Rx_BODY_LE1_CAN_ZONE_PNC_PNC4_Sts: ComNotification=Com_CbkRxAck_Cfg_P_Rx_BODY_LE1_CAN_ZONE_PNC_PNC4_Sts, ComTimeoutNotification=, ComBitPosition=19, ComBitSize=1, ComFirstTimeout=0, ComHandleId=87, DataTimeoutSupport=false, ComTimeout=0, ComSignalType=UINT8, Direction=Rx, InputName=PNC4_Sts, offset=0, factor=1, enumValue=0%Inactive&1%Active, unitName=, max=1, min=0, compuMethodType=, ComSystemTemplateSystemSignalRef=Cfg_P_Rx_BODY_LE1_CAN_ZONE_PNC
        Cfg_P_Rx_BODY_LE1_CAN_ZONE_PNC_PNC5_Sts: ComNotification=Com_CbkRxAck_Cfg_P_Rx_BODY_LE1_CAN_ZONE_PNC_PNC5_Sts, ComTimeoutNotification=, ComBitPosition=20, ComBitSize=1, ComFirstTimeout=0, ComHandleId=88, DataTimeoutSupport=false, ComTimeout=0, ComSignalType=UINT8, Direction=Rx, InputName=PNC5_Sts, offset=0, factor=1, enumValue=0%Inactive&1%Active, unitName=, max=1, min=0, compuMethodType=, ComSystemTemplateSystemSignalRef=Cfg_P_Rx_BODY_LE1_CAN_ZONE_PNC
        Cfg_P_Rx_BODY_LE1_CAN_ZONE_PNC_PNC6_Sts: ComNotification=Com_CbkRxAck_Cfg_P_Rx_BODY_LE1_CAN_ZONE_PNC_PNC6_Sts, ComTimeoutNotification=, ComBitPosition=21, ComBitSize=1, ComFirstTimeout=0, ComHandleId=89, DataTimeoutSupport=false, ComTimeout=0, ComSignalType=UINT8, Direction=Rx, InputName=PNC6_Sts, offset=0, factor=1, enumValue=0%Inactive&1%Active, unitName=, max=1, min=0, compuMethodType=, ComSystemTemplateSystemSignalRef=Cfg_P_Rx_BODY_LE1_CAN_ZONE_PNC
        Cfg_P_Rx_BODY_LE1_CAN_ZONE_PNC_PNC7_Sts: ComNotification=Com_CbkRxAck_Cfg_P_Rx_BODY_LE1_CAN_ZONE_PNC_PNC7_Sts, ComTimeoutNotification=, ComBitPosition=22, ComBitSize=1, ComFirstTimeout=0, ComHandleId=90, DataTimeoutSupport=false, ComTimeout=0, ComSignalType=UINT8, Direction=Rx, InputName=PNC7_Sts, offset=0, factor=1, enumValue=0%Inactive&1%Active, unitName=, max=1, min=0, compuMethodType=, ComSystemTemplateSystemSignalRef=Cfg_P_Rx_BODY_LE1_CAN_ZONE_PNC
        Cfg_P_Rx_BODY_LE1_CAN_ZONE_PNC_PNC8_Sts: ComNotification=Com_CbkRxAck_Cfg_P_Rx_BODY_LE1_CAN_ZONE_PNC_PNC8_Sts, ComTimeoutNotification=, ComBitPosition=23, ComBitSize=1, ComFirstTimeout=0, ComHandleId=91, DataTimeoutSupport=false, ComTimeout=0, ComSignalType=UINT8, Direction=Rx, InputName=PNC8_Sts, offset=0, factor=1, enumValue=0%Inactive&1%Active, unitName=, max=1, min=0, compuMethodType=, ComSystemTemplateSystemSignalRef=Cfg_P_Rx_BODY_LE1_CAN_ZONE_PNC
        Cfg_P_Rx_BODY_LE1_CAN_ZONE_PNC_PNC9_Sts: ComNotification=Com_CbkRxAck_Cfg_P_Rx_BODY_LE1_CAN_ZONE_PNC_PNC9_Sts, ComTimeoutNotification=, ComBitPosition=24, ComBitSize=1, ComFirstTimeout=0, ComHandleId=92, DataTimeoutSupport=false, ComTimeout=0, ComSignalType=UINT8, Direction=Rx, InputName=PNC9_Sts, offset=0, factor=1, enumValue=0%Inactive&1%Active, unitName=, max=1, min=0, compuMethodType=, ComSystemTemplateSystemSignalRef=Cfg_P_Rx_BODY_LE1_CAN_ZONE_PNC
        Cfg_P_Rx_BODY_LE1_CAN_ZONE_PNC_PNC10_Sts: ComNotification=Com_CbkRxAck_Cfg_P_Rx_BODY_LE1_CAN_ZONE_PNC_PNC10_Sts, ComTimeoutNotification=, ComBitPosition=25, ComBitSize=1, ComFirstTimeout=0, ComHandleId=93, DataTimeoutSupport=false, ComTimeout=0, ComSignalType=UINT8, Direction=Rx, InputName=PNC10_Sts, offset=0, factor=1, enumValue=0%Inactive&1%Active, unitName=, max=1, min=0, compuMethodType=, ComSystemTemplateSystemSignalRef=Cfg_P_Rx_BODY_LE1_CAN_ZONE_PNC
        Cfg_P_Rx_BODY_LE1_CAN_ZONE_PNC_PNC11_Sts: ComNotification=Com_CbkRxAck_Cfg_P_Rx_BODY_LE1_CAN_ZONE_PNC_PNC11_Sts, ComTimeoutNotification=, ComBitPosition=26, ComBitSize=1, ComFirstTimeout=0, ComHandleId=94, DataTimeoutSupport=false, ComTimeout=0, ComSignalType=UINT8, Direction=Rx, InputName=PNC11_Sts, offset=0, factor=1, enumValue=0%Inactive&1%Active, unitName=, max=1, min=0, compuMethodType=, ComSystemTemplateSystemSignalRef=Cfg_P_Rx_BODY_LE1_CAN_ZONE_PNC
        Cfg_P_Rx_BODY_LE1_CAN_ZONE_PNC_PNC12_Sts: ComNotification=Com_CbkRxAck_Cfg_P_Rx_BODY_LE1_CAN_ZONE_PNC_PNC12_Sts, ComTimeoutNotification=, ComBitPosition=27, ComBitSize=1, ComFirstTimeout=0, ComHandleId=95, DataTimeoutSupport=false, ComTimeout=0, ComSignalType=UINT8, Direction=Rx, InputName=PNC12_Sts, offset=0, factor=1, enumValue=0%Inactive&1%Active, unitName=, max=1, min=0, compuMethodType=, ComSystemTemplateSystemSignalRef=Cfg_P_Rx_BODY_LE1_CAN_ZONE_PNC
        Cfg_P_Rx_BODY_LE1_CAN_ZONE_PNC_PNC13_Sts: ComNotification=Com_CbkRxAck_Cfg_P_Rx_BODY_LE1_CAN_ZONE_PNC_PNC13_Sts, ComTimeoutNotification=, ComBitPosition=28, ComBitSize=1, ComFirstTimeout=0, ComHandleId=96, DataTimeoutSupport=false, ComTimeout=0, ComSignalType=UINT8, Direction=Rx, InputName=PNC13_Sts, offset=0, factor=1, enumValue=0%Inactive&1%Active, unitName=, max=1, min=0, compuMethodType=, ComSystemTemplateSystemSignalRef=Cfg_P_Rx_BODY_LE1_CAN_ZONE_PNC
        Cfg_P_Rx_BODY_LE1_CAN_ZONE_PNC_PNC14_Sts: ComNotification=Com_CbkRxAck_Cfg_P_Rx_BODY_LE1_CAN_ZONE_PNC_PNC14_Sts, ComTimeoutNotification=, ComBitPosition=29, ComBitSize=1, ComFirstTimeout=0, ComHandleId=97, DataTimeoutSupport=false, ComTimeout=0, ComSignalType=UINT8, Direction=Rx, InputName=PNC14_Sts, offset=0, factor=1, enumValue=0%Inactive&1%Active, unitName=, max=1, min=0, compuMethodType=, ComSystemTemplateSystemSignalRef=Cfg_P_Rx_BODY_LE1_CAN_ZONE_PNC
        Cfg_P_Rx_BODY_LE1_CAN_ZONE_PNC_PNC15_Sts: ComNotification=Com_CbkRxAck_Cfg_P_Rx_BODY_LE1_CAN_ZONE_PNC_PNC15_Sts, ComTimeoutNotification=, ComBitPosition=30, ComBitSize=1, ComFirstTimeout=0, ComHandleId=98, DataTimeoutSupport=false, ComTimeout=0, ComSignalType=UINT8, Direction=Rx, InputName=PNC15_Sts, offset=0, factor=1, enumValue=0%Inactive&1%Active, unitName=, max=1, min=0, compuMethodType=, ComSystemTemplateSystemSignalRef=Cfg_P_Rx_BODY_LE1_CAN_ZONE_PNC
        Cfg_P_Rx_BODY_LE1_CAN_ZONE_PNC_PNC16_Sts: ComNotification=Com_CbkRxAck_Cfg_P_Rx_BODY_LE1_CAN_ZONE_PNC_PNC16_Sts, ComTimeoutNotification=, ComBitPosition=31, ComBitSize=1, ComFirstTimeout=0, ComHandleId=99, DataTimeoutSupport=false, ComTimeout=0, ComSignalType=UINT8, Direction=Rx, InputName=PNC16_Sts, offset=0, factor=1, enumValue=0%Inactive&1%Active, unitName=, max=1, min=0, compuMethodType=, ComSystemTemplateSystemSignalRef=Cfg_P_Rx_BODY_LE1_CAN_ZONE_PNC
        Cfg_P_Rx_BODY_LE1_CAN_ZONE_PNC_PNC17_Sts: ComNotification=Com_CbkRxAck_Cfg_P_Rx_BODY_LE1_CAN_ZONE_PNC_PNC17_Sts, ComTimeoutNotification=, ComBitPosition=32, ComBitSize=1, ComFirstTimeout=0, ComHandleId=100, DataTimeoutSupport=false, ComTimeout=0, ComSignalType=UINT8, Direction=Rx, InputName=PNC17_Sts, offset=0, factor=1, enumValue=0%Inactive&1%Active, unitName=, max=1, min=0, compuMethodType=, ComSystemTemplateSystemSignalRef=Cfg_P_Rx_BODY_LE1_CAN_ZONE_PNC
        Cfg_P_Rx_BODY_LE1_CAN_ZONE_PNC_PNC18_Sts: ComNotification=Com_CbkRxAck_Cfg_P_Rx_BODY_LE1_CAN_ZONE_PNC_PNC18_Sts, ComTimeoutNotification=, ComBitPosition=33, ComBitSize=1, ComFirstTimeout=0, ComHandleId=101, DataTimeoutSupport=false, ComTimeout=0, ComSignalType=UINT8, Direction=Rx, InputName=PNC18_Sts, offset=0, factor=1, enumValue=0%Inactive&1%Active, unitName=, max=1, min=0, compuMethodType=, ComSystemTemplateSystemSignalRef=Cfg_P_Rx_BODY_LE1_CAN_ZONE_PNC
        Cfg_P_Rx_BODY_LE1_CAN_ZONE_PNC_PNC19_Sts: ComNotification=Com_CbkRxAck_Cfg_P_Rx_BODY_LE1_CAN_ZONE_PNC_PNC19_Sts, ComTimeoutNotification=, ComBitPosition=34, ComBitSize=1, ComFirstTimeout=0, ComHandleId=102, DataTimeoutSupport=false, ComTimeout=0, ComSignalType=UINT8, Direction=Rx, InputName=PNC19_Sts, offset=0, factor=1, enumValue=0%Inactive&1%Active, unitName=, max=1, min=0, compuMethodType=, ComSystemTemplateSystemSignalRef=Cfg_P_Rx_BODY_LE1_CAN_ZONE_PNC
        Cfg_P_Rx_BODY_LE1_CAN_ZONE_PNC_PNC20_Sts: ComNotification=Com_CbkRxAck_Cfg_P_Rx_BODY_LE1_CAN_ZONE_PNC_PNC20_Sts, ComTimeoutNotification=, ComBitPosition=35, ComBitSize=1, ComFirstTimeout=0, ComHandleId=103, DataTimeoutSupport=false, ComTimeout=0, ComSignalType=UINT8, Direction=Rx, InputName=PNC20_Sts, offset=0, factor=1, enumValue=0%Inactive&1%Active, unitName=, max=1, min=0, compuMethodType=, ComSystemTemplateSystemSignalRef=Cfg_P_Rx_BODY_LE1_CAN_ZONE_PNC
        Cfg_P_Rx_BODY_LE1_CAN_ZONE_PNC_PNC21_Sts: ComNotification=Com_CbkRxAck_Cfg_P_Rx_BODY_LE1_CAN_ZONE_PNC_PNC21_Sts, ComTimeoutNotification=, ComBitPosition=36, ComBitSize=1, ComFirstTimeout=0, ComHandleId=104, DataTimeoutSupport=false, ComTimeout=0, ComSignalType=UINT8, Direction=Rx, InputName=PNC21_Sts, offset=0, factor=1, enumValue=0%Inactive&1%Active, unitName=, max=1, min=0, compuMethodType=, ComSystemTemplateSystemSignalRef=Cfg_P_Rx_BODY_LE1_CAN_ZONE_PNC
        Cfg_P_Rx_BODY_LE1_CAN_ZONE_PNC_PNC22_Sts: ComNotification=Com_CbkRxAck_Cfg_P_Rx_BODY_LE1_CAN_ZONE_PNC_PNC22_Sts, ComTimeoutNotification=, ComBitPosition=37, ComBitSize=1, ComFirstTimeout=0, ComHandleId=105, DataTimeoutSupport=false, ComTimeout=0, ComSignalType=UINT8, Direction=Rx, InputName=PNC22_Sts, offset=0, factor=1, enumValue=0%Inactive&1%Active, unitName=, max=1, min=0, compuMethodType=, ComSystemTemplateSystemSignalRef=Cfg_P_Rx_BODY_LE1_CAN_ZONE_PNC
        Cfg_P_Rx_BODY_LE1_CAN_ZONE_PNC_PNC23_Sts: ComNotification=Com_CbkRxAck_Cfg_P_Rx_BODY_LE1_CAN_ZONE_PNC_PNC23_Sts, ComTimeoutNotification=, ComBitPosition=38, ComBitSize=1, ComFirstTimeout=0, ComHandleId=106, DataTimeoutSupport=false, ComTimeout=0, ComSignalType=UINT8, Direction=Rx, InputName=PNC23_Sts, offset=0, factor=1, enumValue=0%Inactive&1%Active, unitName=, max=1, min=0, compuMethodType=, ComSystemTemplateSystemSignalRef=Cfg_P_Rx_BODY_LE1_CAN_ZONE_PNC
        Cfg_P_Rx_BODY_LE1_CAN_ZONE_PNC_PNC24_Sts: ComNotification=Com_CbkRxAck_Cfg_P_Rx_BODY_LE1_CAN_ZONE_PNC_PNC24_Sts, ComTimeoutNotification=, ComBitPosition=39, ComBitSize=1, ComFirstTimeout=0, ComHandleId=107, DataTimeoutSupport=false, ComTimeout=0, ComSignalType=UINT8, Direction=Rx, InputName=PNC24_Sts, offset=0, factor=1, enumValue=0%Inactive&1%Active, unitName=, max=1, min=0, compuMethodType=, ComSystemTemplateSystemSignalRef=Cfg_P_Rx_BODY_LE1_CAN_ZONE_PNC
        Cfg_P_Rx_BODY_LE1_CAN_ZONE_PNC_PNC25_Sts: ComNotification=Com_CbkRxAck_Cfg_P_Rx_BODY_LE1_CAN_ZONE_PNC_PNC25_Sts, ComTimeoutNotification=, ComBitPosition=40, ComBitSize=1, ComFirstTimeout=0, ComHandleId=108, DataTimeoutSupport=false, ComTimeout=0, ComSignalType=UINT8, Direction=Rx, InputName=PNC25_Sts, offset=0, factor=1, enumValue=0%Inactive&1%Active, unitName=, max=1, min=0, compuMethodType=, ComSystemTemplateSystemSignalRef=Cfg_P_Rx_BODY_LE1_CAN_ZONE_PNC
        Cfg_P_Rx_BODY_LE1_CAN_ZONE_PNC_PNC26_Sts: ComNotification=Com_CbkRxAck_Cfg_P_Rx_BODY_LE1_CAN_ZONE_PNC_PNC26_Sts, ComTimeoutNotification=, ComBitPosition=41, ComBitSize=1, ComFirstTimeout=0, ComHandleId=109, DataTimeoutSupport=false, ComTimeout=0, ComSignalType=UINT8, Direction=Rx, InputName=PNC26_Sts, offset=0, factor=1, enumValue=0%Inactive&1%Active, unitName=, max=1, min=0, compuMethodType=, ComSystemTemplateSystemSignalRef=Cfg_P_Rx_BODY_LE1_CAN_ZONE_PNC
        Cfg_P_Rx_BODY_LE1_CAN_ZONE_PNC_PNC27_Sts: ComNotification=Com_CbkRxAck_Cfg_P_Rx_BODY_LE1_CAN_ZONE_PNC_PNC27_Sts, ComTimeoutNotification=, ComBitPosition=42, ComBitSize=1, ComFirstTimeout=0, ComHandleId=110, DataTimeoutSupport=false, ComTimeout=0, ComSignalType=UINT8, Direction=Rx, InputName=PNC27_Sts, offset=0, factor=1, enumValue=0%Inactive&1%Active, unitName=, max=1, min=0, compuMethodType=, ComSystemTemplateSystemSignalRef=Cfg_P_Rx_BODY_LE1_CAN_ZONE_PNC
        Cfg_P_Rx_BODY_LE1_CAN_ZONE_PNC_PNC28_Sts: ComNotification=Com_CbkRxAck_Cfg_P_Rx_BODY_LE1_CAN_ZONE_PNC_PNC28_Sts, ComTimeoutNotification=, ComBitPosition=43, ComBitSize=1, ComFirstTimeout=0, ComHandleId=111, DataTimeoutSupport=false, ComTimeout=0, ComSignalType=UINT8, Direction=Rx, InputName=PNC28_Sts, offset=0, factor=1, enumValue=0%Inactive&1%Active, unitName=, max=1, min=0, compuMethodType=, ComSystemTemplateSystemSignalRef=Cfg_P_Rx_BODY_LE1_CAN_ZONE_PNC
        Cfg_P_Rx_BODY_LE1_CAN_ZONE_PNC_PNC29_Sts: ComNotification=Com_CbkRxAck_Cfg_P_Rx_BODY_LE1_CAN_ZONE_PNC_PNC29_Sts, ComTimeoutNotification=, ComBitPosition=44, ComBitSize=1, ComFirstTimeout=0, ComHandleId=112, DataTimeoutSupport=false, ComTimeout=0, ComSignalType=UINT8, Direction=Rx, InputName=PNC29_Sts, offset=0, factor=1, enumValue=0%Inactive&1%Active, unitName=, max=1, min=0, compuMethodType=, ComSystemTemplateSystemSignalRef=Cfg_P_Rx_BODY_LE1_CAN_ZONE_PNC
        Cfg_P_Rx_BODY_LE1_CAN_ZONE_PNC_PNC30_Sts: ComNotification=Com_CbkRxAck_Cfg_P_Rx_BODY_LE1_CAN_ZONE_PNC_PNC30_Sts, ComTimeoutNotification=, ComBitPosition=45, ComBitSize=1, ComFirstTimeout=0, ComHandleId=113, DataTimeoutSupport=false, ComTimeout=0, ComSignalType=UINT8, Direction=Rx, InputName=PNC30_Sts, offset=0, factor=1, enumValue=0%Inactive&1%Active, unitName=, max=1, min=0, compuMethodType=, ComSystemTemplateSystemSignalRef=Cfg_P_Rx_BODY_LE1_CAN_ZONE_PNC
        Cfg_P_Rx_BODY_LE1_CAN_ZONE_PNC_PNC31_Sts: ComNotification=Com_CbkRxAck_Cfg_P_Rx_BODY_LE1_CAN_ZONE_PNC_PNC31_Sts, ComTimeoutNotification=, ComBitPosition=46, ComBitSize=1, ComFirstTimeout=0, ComHandleId=114, DataTimeoutSupport=false, ComTimeout=0, ComSignalType=UINT8, Direction=Rx, InputName=PNC31_Sts, offset=0, factor=1, enumValue=0%Inactive&1%Active, unitName=, max=1, min=0, compuMethodType=, ComSystemTemplateSystemSignalRef=Cfg_P_Rx_BODY_LE1_CAN_ZONE_PNC
        Cfg_P_Rx_BODY_LE1_CAN_ZONE_PNC_PNC32_Sts: ComNotification=Com_CbkRxAck_Cfg_P_Rx_BODY_LE1_CAN_ZONE_PNC_PNC32_Sts, ComTimeoutNotification=, ComBitPosition=47, ComBitSize=1, ComFirstTimeout=0, ComHandleId=115, DataTimeoutSupport=false, ComTimeout=0, ComSignalType=UINT8, Direction=Rx, InputName=PNC32_Sts, offset=0, factor=1, enumValue=0%Inactive&1%Active, unitName=, max=1, min=0, compuMethodType=, ComSystemTemplateSystemSignalRef=Cfg_P_Rx_BODY_LE1_CAN_ZONE_PNC
        Cfg_P_Rx_BODY_LE1_CAN_ZONE_PNC_PNC33_Sts: ComNotification=Com_CbkRxAck_Cfg_P_Rx_BODY_LE1_CAN_ZONE_PNC_PNC33_Sts, ComTimeoutNotification=, ComBitPosition=48, ComBitSize=1, ComFirstTimeout=0, ComHandleId=116, DataTimeoutSupport=false, ComTimeout=0, ComSignalType=UINT8, Direction=Rx, InputName=PNC33_Sts, offset=0, factor=1, enumValue=0%Inactive&1%Active, unitName=, max=1, min=0, compuMethodType=, ComSystemTemplateSystemSignalRef=Cfg_P_Rx_BODY_LE1_CAN_ZONE_PNC
        Cfg_P_Rx_BODY_LE1_CAN_ZONE_PNC_PNC34_Sts: ComNotification=Com_CbkRxAck_Cfg_P_Rx_BODY_LE1_CAN_ZONE_PNC_PNC34_Sts, ComTimeoutNotification=, ComBitPosition=49, ComBitSize=1, ComFirstTimeout=0, ComHandleId=117, DataTimeoutSupport=false, ComTimeout=0, ComSignalType=UINT8, Direction=Rx, InputName=PNC34_Sts, offset=0, factor=1, enumValue=0%Inactive&1%Active, unitName=, max=1, min=0, compuMethodType=, ComSystemTemplateSystemSignalRef=Cfg_P_Rx_BODY_LE1_CAN_ZONE_PNC
        Cfg_P_Rx_BODY_LE1_CAN_ZONE_PNC_PNC35_Sts: ComNotification=Com_CbkRxAck_Cfg_P_Rx_BODY_LE1_CAN_ZONE_PNC_PNC35_Sts, ComTimeoutNotification=, ComBitPosition=50, ComBitSize=1, ComFirstTimeout=0, ComHandleId=118, DataTimeoutSupport=false, ComTimeout=0, ComSignalType=UINT8, Direction=Rx, InputName=PNC35_Sts, offset=0, factor=1, enumValue=0%Inactive&1%Active, unitName=, max=1, min=0, compuMethodType=, ComSystemTemplateSystemSignalRef=Cfg_P_Rx_BODY_LE1_CAN_ZONE_PNC
        Cfg_P_Rx_BODY_LE1_CAN_ZONE_PNC_PNC36_Sts: ComNotification=Com_CbkRxAck_Cfg_P_Rx_BODY_LE1_CAN_ZONE_PNC_PNC36_Sts, ComTimeoutNotification=, ComBitPosition=51, ComBitSize=1, ComFirstTimeout=0, ComHandleId=119, DataTimeoutSupport=false, ComTimeout=0, ComSignalType=UINT8, Direction=Rx, InputName=PNC36_Sts, offset=0, factor=1, enumValue=0%Inactive&1%Active, unitName=, max=1, min=0, compuMethodType=, ComSystemTemplateSystemSignalRef=Cfg_P_Rx_BODY_LE1_CAN_ZONE_PNC
        Cfg_P_Rx_BODY_LE1_CAN_ZONE_PNC_PNC37_Sts: ComNotification=Com_CbkRxAck_Cfg_P_Rx_BODY_LE1_CAN_ZONE_PNC_PNC37_Sts, ComTimeoutNotification=, ComBitPosition=52, ComBitSize=1, ComFirstTimeout=0, ComHandleId=120, DataTimeoutSupport=false, ComTimeout=0, ComSignalType=UINT8, Direction=Rx, InputName=PNC37_Sts, offset=0, factor=1, enumValue=0%Inactive&1%Active, unitName=, max=1, min=0, compuMethodType=, ComSystemTemplateSystemSignalRef=Cfg_P_Rx_BODY_LE1_CAN_ZONE_PNC
        Cfg_P_Rx_BODY_LE1_CAN_ZONE_PNC_PNC38_Sts: ComNotification=Com_CbkRxAck_Cfg_P_Rx_BODY_LE1_CAN_ZONE_PNC_PNC38_Sts, ComTimeoutNotification=, ComBitPosition=53, ComBitSize=1, ComFirstTimeout=0, ComHandleId=121, DataTimeoutSupport=false, ComTimeout=0, ComSignalType=UINT8, Direction=Rx, InputName=PNC38_Sts, offset=0, factor=1, enumValue=0%Inactive&1%Active, unitName=, max=1, min=0, compuMethodType=, ComSystemTemplateSystemSignalRef=Cfg_P_Rx_BODY_LE1_CAN_ZONE_PNC
        Cfg_P_Rx_BODY_LE1_CAN_ZONE_PNC_PNC39_Sts: ComNotification=Com_CbkRxAck_Cfg_P_Rx_BODY_LE1_CAN_ZONE_PNC_PNC39_Sts, ComTimeoutNotification=, ComBitPosition=54, ComBitSize=1, ComFirstTimeout=0, ComHandleId=122, DataTimeoutSupport=false, ComTimeout=0, ComSignalType=UINT8, Direction=Rx, InputName=PNC39_Sts, offset=0, factor=1, enumValue=0%Inactive&1%Active, unitName=, max=1, min=0, compuMethodType=, ComSystemTemplateSystemSignalRef=Cfg_P_Rx_BODY_LE1_CAN_ZONE_PNC
        Cfg_P_Rx_BODY_LE1_CAN_ZONE_PNC_PNC40_Sts: ComNotification=Com_CbkRxAck_Cfg_P_Rx_BODY_LE1_CAN_ZONE_PNC_PNC40_Sts, ComTimeoutNotification=, ComBitPosition=55, ComBitSize=1, ComFirstTimeout=0, ComHandleId=123, DataTimeoutSupport=false, ComTimeout=0, ComSignalType=UINT8, Direction=Rx, InputName=PNC40_Sts, offset=0, factor=1, enumValue=0%Inactive&1%Active, unitName=, max=1, min=0, compuMethodType=, ComSystemTemplateSystemSignalRef=Cfg_P_Rx_BODY_LE1_CAN_ZONE_PNC
        Cfg_P_Rx_BODY_LE1_CAN_ZONE_PNC_PNC41_Sts: ComNotification=Com_CbkRxAck_Cfg_P_Rx_BODY_LE1_CAN_ZONE_PNC_PNC41_Sts, ComTimeoutNotification=, ComBitPosition=56, ComBitSize=1, ComFirstTimeout=0, ComHandleId=124, DataTimeoutSupport=false, ComTimeout=0, ComSignalType=UINT8, Direction=Rx, InputName=PNC41_Sts, offset=0, factor=1, enumValue=0%Inactive&1%Active, unitName=, max=1, min=0, compuMethodType=, ComSystemTemplateSystemSignalRef=Cfg_P_Rx_BODY_LE1_CAN_ZONE_PNC
        Cfg_P_Rx_BODY_LE1_CAN_ZONE_PNC_PNC43_Sts: ComNotification=Com_CbkRxAck_Cfg_P_Rx_BODY_LE1_CAN_ZONE_PNC_PNC43_Sts, ComTimeoutNotification=, ComBitPosition=57, ComBitSize=1, ComFirstTimeout=0, ComHandleId=125, DataTimeoutSupport=false, ComTimeout=0, ComSignalType=UINT8, Direction=Rx, InputName=PNC43_Sts, offset=0, factor=1, enumValue=0%Inactive&1%Active, unitName=, max=1, min=0, compuMethodType=, ComSystemTemplateSystemSignalRef=Cfg_P_Rx_BODY_LE1_CAN_ZONE_PNC
        Cfg_P_Rx_BODY_LE1_CAN_ZONE_PNC_PNC42_Sts: ComNotification=Com_CbkRxAck_Cfg_P_Rx_BODY_LE1_CAN_ZONE_PNC_PNC42_Sts, ComTimeoutNotification=, ComBitPosition=58, ComBitSize=1, ComFirstTimeout=0, ComHandleId=126, DataTimeoutSupport=false, ComTimeout=0, ComSignalType=UINT8, Direction=Rx, InputName=PNC42_Sts, offset=0, factor=1, enumValue=0%Inactive&1%Active, unitName=, max=1, min=0, compuMethodType=, ComSystemTemplateSystemSignalRef=Cfg_P_Rx_BODY_LE1_CAN_ZONE_PNC
        Cfg_P_Rx_BODY_LE1_CAN_ZONE_PNC_PNC44_Sts: ComNotification=Com_CbkRxAck_Cfg_P_Rx_BODY_LE1_CAN_ZONE_PNC_PNC44_Sts, ComTimeoutNotification=, ComBitPosition=59, ComBitSize=1, ComFirstTimeout=0, ComHandleId=127, DataTimeoutSupport=false, ComTimeout=0, ComSignalType=UINT8, Direction=Rx, InputName=PNC44_Sts, offset=0, factor=1, enumValue=0%Inactive&1%Active, unitName=, max=1, min=0, compuMethodType=, ComSystemTemplateSystemSignalRef=Cfg_P_Rx_BODY_LE1_CAN_ZONE_PNC
        Cfg_P_Rx_BODY_LE1_CAN_ZONE_PNC_PNC45_Sts: ComNotification=Com_CbkRxAck_Cfg_P_Rx_BODY_LE1_CAN_ZONE_PNC_PNC45_Sts, ComTimeoutNotification=, ComBitPosition=60, ComBitSize=1, ComFirstTimeout=0, ComHandleId=128, DataTimeoutSupport=false, ComTimeout=0, ComSignalType=UINT8, Direction=Rx, InputName=PNC45_Sts, offset=0, factor=1, enumValue=0%Inactive&1%Active, unitName=, max=1, min=0, compuMethodType=, ComSystemTemplateSystemSignalRef=Cfg_P_Rx_BODY_LE1_CAN_ZONE_PNC
        Cfg_P_Rx_BODY_LE1_CAN_ZONE_PNC_PNC46_Sts: ComNotification=Com_CbkRxAck_Cfg_P_Rx_BODY_LE1_CAN_ZONE_PNC_PNC46_Sts, ComTimeoutNotification=, ComBitPosition=61, ComBitSize=1, ComFirstTimeout=0, ComHandleId=129, DataTimeoutSupport=false, ComTimeout=0, ComSignalType=UINT8, Direction=Rx, InputName=PNC46_Sts, offset=0, factor=1, enumValue=0%Inactive&1%Active, unitName=, max=1, min=0, compuMethodType=, ComSystemTemplateSystemSignalRef=Cfg_P_Rx_BODY_LE1_CAN_ZONE_PNC
        Cfg_P_Rx_BODY_LE1_CAN_ZONE_PNC_PNC47_Sts: ComNotification=Com_CbkRxAck_Cfg_P_Rx_BODY_LE1_CAN_ZONE_PNC_PNC47_Sts, ComTimeoutNotification=, ComBitPosition=62, ComBitSize=1, ComFirstTimeout=0, ComHandleId=130, DataTimeoutSupport=false, ComTimeout=0, ComSignalType=UINT8, Direction=Rx, InputName=PNC47_Sts, offset=0, factor=1, enumValue=0%Inactive&1%Active, unitName=, max=1, min=0, compuMethodType=, ComSystemTemplateSystemSignalRef=Cfg_P_Rx_BODY_LE1_CAN_ZONE_PNC
        Cfg_P_Rx_BODY_LE1_CAN_ZONE_PNC_PNC48_Sts: ComNotification=Com_CbkRxAck_Cfg_P_Rx_BODY_LE1_CAN_ZONE_PNC_PNC48_Sts, ComTimeoutNotification=, ComBitPosition=63, ComBitSize=1, ComFirstTimeout=0, ComHandleId=131, DataTimeoutSupport=false, ComTimeout=0, ComSignalType=UINT8, Direction=Rx, InputName=PNC48_Sts, offset=0, factor=1, enumValue=0%Inactive&1%Active, unitName=, max=1, min=0, compuMethodType=, ComSystemTemplateSystemSignalRef=Cfg_P_Rx_BODY_LE1_CAN_ZONE_PNC
        Cfg_P_Rx_BODY_LE1_CAN_VC_Data_5E0_VC_Data_5E0_CRC: ComNotification=Com_CbkRxAck_Cfg_P_Rx_BODY_LE1_CAN_VC_Data_5E0_VC_Data_5E0_CRC, ComTimeoutNotification=, ComBitPosition=7, ComBitSize=8, ComFirstTimeout=0, ComHandleId=132, DataTimeoutSupport=false, ComTimeout=0, ComSignalType=UINT8, Direction=Rx, InputName=VC_Data_5E0_CRC, offset=0, factor=1, enumValue=, unitName=, max=255, min=0, compuMethodType=, ComSystemTemplateSystemSignalRef=Cfg_P_Rx_BODY_LE1_CAN_VC_Data_5E0
        Cfg_P_Rx_BODY_LE1_CAN_VC_Data_5E0_VC_Data_5E0_MsgCntr: ComNotification=Com_CbkRxAck_Cfg_P_Rx_BODY_LE1_CAN_VC_Data_5E0_VC_Data_5E0_MsgCntr, ComTimeoutNotification=, ComBitPosition=11, ComBitSize=4, ComFirstTimeout=0, ComHandleId=133, DataTimeoutSupport=false, ComTimeout=0, ComSignalType=UINT8, Direction=Rx, InputName=VC_Data_5E0_MsgCntr, offset=0, factor=1, enumValue=, unitName=, max=14, min=0, compuMethodType=, ComSystemTemplateSystemSignalRef=Cfg_P_Rx_BODY_LE1_CAN_VC_Data_5E0
        Cfg_P_Rx_BODY_LE1_CAN_VC_Data_5E0_VC_Data_5E0_Payload: ComNotification=Com_CbkRxAck_Cfg_P_Rx_BODY_LE1_CAN_VC_Data_5E0_VC_Data_5E0_Payload, ComTimeoutNotification=, ComBitPosition=23, ComBitSize=48, ComFirstTimeout=0, ComHandleId=134, DataTimeoutSupport=false, ComTimeout=0, ComSignalType=UINT64, Direction=Rx, InputName=VC_Data_5E0_Payload, offset=0, factor=1, enumValue=, unitName=, max=281474976710655, min=0, compuMethodType=, ComSystemTemplateSystemSignalRef=Cfg_P_Rx_BODY_LE1_CAN_VC_Data_5E0
      ComTimeBase: ComGwTimeBase=10, ComRxTimeBase=10, ComTxTimeBase=10
  module config ComM: implementation-config-variant=STD_CONFIG_VARIANTS_POSTBUILD, module_version_def=4.0.4, module_autosar_version=Ar470
    ComMGeneral:
      VersionCheck = true
      ComMDevErrorDetect = true
      ComMVersionInfoApi = true
      ComMDirectUserMapping = false
      ComMSynchronousWakeUp = false
      ComMTMinFullComModeDuration = 5000
      ComMEcuGroupClassification = 0x3
      ComMModeLimitationEnabled = false
      ComMPncGatewayEnabled = false
      ComMPncPrepareSleepTimer = 0
      ComMPncSupport = false
      ComMWakeupInhibitionEnabled = false
      ComMResetAfterForcingNoComm = false
      ComMMultiCoreSupport = false
      ComM0PncVectorAvoidance = false
      ComMDynamicPncToChannelMappingSupport = false
      ComMSynchronizedPncShutdownEnabled = false
    Cfg_D (ComMConfigSet): ComMPncEnabled=false
      ComM_BODY_LE1_CAN (ComMChannel):
        FilePath = BODY_LE1_CAN
        UserDefine = false
        sourceType = ImportDBC
        ComMBusType = COMM_BUS_TYPE_CAN
        ComMChannelId = 0
        ComMFullCommRequestNotificationEnabled = false
        ComMNoWakeUpInhibitionNvmStorage = false
        ComMMainFunctionPeriod = 5
        ComMNoCom = false
        ComMNoWakeup = false
        ComMPncGatewayType = COMM_GATEWAY_TYPE_NONE
        ComMCDDBusPrefix = 
        ComMDynamicPncToChannelMappingEnabled = false
        ComMWakeupSleepRequestEnabled = false
        ComMNetworkManagement: ComMNmVariant=LIGHT, ComMNmLightTimeout=1000, ComMPncNmRequest=false
        ComMUserPerChannel1 (ComMUserPerChannel): ComMUserChannel=User0
      User0 (ComMUser): ComMUserIdentifier=0
    Cfg_P (ComMConfigSet): ComMPncEnabled=false
      ComM_BODY_LE1_CAN (ComMChannel):
        FilePath = BODY_LE1_CAN
        UserDefine = false
        sourceType = ImportDBC
        ComMBusType = COMM_BUS_TYPE_CAN
        ComMChannelId = 0
        ComMFullCommRequestNotificationEnabled = false
        ComMNoWakeUpInhibitionNvmStorage = false
        ComMMainFunctionPeriod = 5
        ComMNoCom = false
        ComMNoWakeup = false
        ComMPncGatewayType = COMM_GATEWAY_TYPE_NONE
        ComMCDDBusPrefix = 
        ComMDynamicPncToChannelMappingEnabled = false
        ComMWakeupSleepRequestEnabled = false
        ComMNetworkManagement: ComMNmVariant=LIGHT, ComMNmLightTimeout=1000, ComMPncNmRequest=false
        ComMUserPerChannel1 (ComMUserPerChannel): ComMUserChannel=User0
      User0 (ComMUser): ComMUserIdentifier=0
