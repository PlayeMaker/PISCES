AUTOSAR XML (schema 00046)
package /EAS/NvM_ib_bswmd/BswModuleDescriptions
  bsw module description NvM: exclusive-areas=NVM_EXCLUSIVE_AREA_0
