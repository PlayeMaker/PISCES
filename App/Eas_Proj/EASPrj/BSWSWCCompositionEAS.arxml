AUTOSAR XML (schema 4.0)
package /BSWSWCCompositionEAS
  composition sw component type BSWSWCCompositionEAS
    15 x component:
      BswM: type=BswM
      Com: type=Com
      ComM: type=ComM
      Dcm: type=Dcm
      Dem: type=Dem
      Det: type=Det
      EcuM: type=EcuM
      NvM: type=NvM
      AppSWC_BswM: type=AppSWC_BswM
      AppSWC_ComM: type=AppSWC_ComM
      AppSWC_Dcm: type=AppSWC_Dcm
      AppSWC_Dem: type=AppSWC_Dem
      AppSWC_Det: type=AppSWC_Det
      AppSWC_EcuM: type=AppSWC_EcuM
      AppSWC_NvM: type=AppSWC_NvM
  system SystemEAS
    system mapping BSWSWCCompositionEASSystem
      data-mappings:
        data-element=Com.VehSpdSts_Rdnt1.VehSpdSts_Rdnt1, system-signal=VehSpdSts_Rdnt1
        data-element=Com.VehSpd_Rdnt1.VehSpd_Rdnt1, system-signal=VehSpd_Rdnt1
        data-element=Com.ZONE_13C_CRC.ZONE_13C_CRC, system-signal=ZONE_13C_CRC
        data-element=Com.ZONE_13C_MsgCntr.ZONE_13C_MsgCntr, system-signal=ZONE_13C_MsgCntr
        data-element=Com.OperatorState_SrvSts.OperatorState_SrvSts, system-signal=OperatorState_SrvSts
        data-element=Com.DrvState_SrvSts.DrvState_SrvSts, system-signal=DrvState_SrvSts
        data-element=Com.VehStateDetailed_SrvSts.VehStateDetailed_SrvSts, system-signal=VehStateDetailed_SrvSts
        data-element=Com.DrvState.DrvState, system-signal=DrvState
        data-element=Com.OperatorState.OperatorState, system-signal=OperatorState
        data-element=Com.VehStateDetailed.VehStateDetailed, system-signal=VehStateDetailed
        data-element=Com.VehModeDef.VehModeDef, system-signal=VehModeDef
        data-element=Com.DrvKneadingMassgSkillsCmd5.DrvKneadingMassgSkillsCmd5, system-signal=DrvKneadingMassgSkillsCmd5
        data-element=Com.DrvKneadingMassgTimesCmd5.DrvKneadingMassgTimesCmd5, system-signal=DrvKneadingMassgTimesCmd5
        data-element=Com.DrvKneadingMassgLvlCmd{5..8}.DrvKneadingMassgLvlCmd{5..8}, system-signal=DrvKneadingMassgLvlCmd{5..8}
        data-element=Com.DrvKneadingMassgSkillsCmd6.DrvKneadingMassgSkillsCmd6, system-signal=DrvKneadingMassgSkillsCmd6
        data-element=Com.DrvKneadingMassgTimesCmd6.DrvKneadingMassgTimesCmd6, system-signal=DrvKneadingMassgTimesCmd6
        data-element=Com.DrvKneadingMassgSkillsCmd7.DrvKneadingMassgSkillsCmd7, system-signal=DrvKneadingMassgSkillsCmd7
        data-element=Com.DrvKneadingMassgTimesCmd7.DrvKneadingMassgTimesCmd7, system-signal=DrvKneadingMassgTimesCmd7
        data-element=Com.DrvKneadingMassgSkillsCmd8.DrvKneadingMassgSkillsCmd8, system-signal=DrvKneadingMassgSkillsCmd8
        data-element=Com.DrvKneadingMassgTimesCmd8.DrvKneadingMassgTimesCmd8, system-signal=DrvKneadingMassgTimesCmd8
        data-element=Com.DrvKneadingMassgSkillsCmd9.DrvKneadingMassgSkillsCmd9, system-signal=DrvKneadingMassgSkillsCmd9
        data-element=Com.DrvKneadingMassgTimesCmd9.DrvKneadingMassgTimesCmd9, system-signal=DrvKneadingMassgTimesCmd9
        data-element=Com.DrvKneadingMassgLvlCmd9.DrvKneadingMassgLvlCmd9, system-signal=DrvKneadingMassgLvlCmd9
        data-element=Com.DrvKneadingMassgLvlCmd10.DrvKneadingMassgLvlCmd10, system-signal=DrvKneadingMassgLvlCmd10
        data-element=Com.DrvKneadingMassgTimesCmd10.DrvKneadingMassgTimesCmd10, system-signal=DrvKneadingMassgTimesCmd10
        data-element=Com.DrvKneadingMassgSkillsCmd10.DrvKneadingMassgSkillsCmd10, system-signal=DrvKneadingMassgSkillsCmd10
        data-element=Com.DrvHeat{1..6}_pct.DrvHeat{1..6}_pct, system-signal=DrvHeat{1..6}_pct
        data-element=Com.DrvSeatmassgValve{1..12}Cmd.DrvSeatmassgValve{1..12}Cmd, system-signal=DrvSeatmassgValve{1..12}Cmd
        data-element=Com.DrvSeatmassgHeat{1..12}Cmd.DrvSeatmassgHeat{1..12}Cmd, system-signal=DrvSeatmassgHeat{1..12}Cmd
        data-element=Com.DrvSeatLumbarTopValue1Cmd.DrvSeatLumbarTopValue1Cmd, system-signal=DrvSeatLumbarTopValue1Cmd
        data-element=Com.DrvSeatLumbarMidValue2Cmd.DrvSeatLumbarMidValue2Cmd, system-signal=DrvSeatLumbarMidValue2Cmd
        data-element=Com.DrvSeatLumbarBottomValue3Cmd.DrvSeatLumbarBottomValue3Cmd, system-signal=DrvSeatLumbarBottomValue3Cmd
        data-element=Com.DrvSeatBolsterValueBLCmd.DrvSeatBolsterValueBLCmd, system-signal=DrvSeatBolsterValueBLCmd
        data-element=Com.DrvSeatBolsterValueBRCmd.DrvSeatBolsterValueBRCmd, system-signal=DrvSeatBolsterValueBRCmd
        data-element=Com.DrvSeatCushionValue6Cmd.DrvSeatCushionValue6Cmd, system-signal=DrvSeatCushionValue6Cmd
        data-element=Com.DrvSeatCushionValue5Cmd.DrvSeatCushionValue5Cmd, system-signal=DrvSeatCushionValue5Cmd
        data-element=Com.DrvSeatCushionValue4Cmd.DrvSeatCushionValue4Cmd, system-signal=DrvSeatCushionValue4Cmd
        data-element=Com.DrvPumpCmd.DrvPumpCmd, system-signal=DrvPumpCmd
        data-element=Com.DrvSeatUpperValueLCmd.DrvSeatUpperValueLCmd, system-signal=DrvSeatUpperValueLCmd
        data-element=Com.DrvSeatUpperValueMCmd.DrvSeatUpperValueMCmd, system-signal=DrvSeatUpperValueMCmd
        data-element=Com.DrvSeatCushionValue2Cmd.DrvSeatCushionValue2Cmd, system-signal=DrvSeatCushionValue2Cmd
        data-element=Com.DrvSeatUpperValueRCmd.DrvSeatUpperValueRCmd, system-signal=DrvSeatUpperValueRCmd
        data-element=Com.DrvSeatCushionValue3Cmd.DrvSeatCushionValue3Cmd, system-signal=DrvSeatCushionValue3Cmd
        data-element=Com.DrvSeatCushionValue1Cmd.DrvSeatCushionValue1Cmd, system-signal=DrvSeatCushionValue1Cmd
        data-element=Com.BattVolt_LBMR.BattVolt_LBMR, system-signal=BattVolt_LBMR
        data-element=Com.VehOdometer.VehOdometer, system-signal=VehOdometer
        data-element=Com.Yr.Yr, system-signal=Yr
        data-element=Com.Mth.Mth, system-signal=Mth
        data-element=Com.Day.Day, system-signal=Day
        data-element=Com.Hr.Hr, system-signal=Hr
        data-element=Com.Min.Min, system-signal=Min
        data-element=Com.Sec.Sec, system-signal=Sec
        data-element=Com.MSec.MSec, system-signal=MSec
        data-element=Com.PNC_DFT.PNC_DFT, system-signal=PNC_DFT
        data-element=Com.PNC{1..41}_Sts.PNC{1..41}_Sts, system-signal=PNC{1..41}_Sts
        data-element=Com.PNC43_Sts.PNC43_Sts, system-signal=PNC43_Sts
        data-element=Com.PNC42_Sts.PNC42_Sts, system-signal=PNC42_Sts
        data-element=Com.PNC{44..48}_Sts.PNC{44..48}_Sts, system-signal=PNC{44..48}_Sts
        data-element=Com.VC_Data_5E0_CRC.VC_Data_5E0_CRC, system-signal=VC_Data_5E0_CRC
        data-element=Com.VC_Data_5E0_MsgCntr.VC_Data_5E0_MsgCntr, system-signal=VC_Data_5E0_MsgCntr
        data-element=Com.VC_Data_5E0_Payload.VC_Data_5E0_Payload, system-signal=VC_Data_5E0_Payload
        data-element=Com.DrvKneadingMassgSkillsSts5.DrvKneadingMassgSkillsSts5, system-signal=DrvKneadingMassgSkillsSts5
        data-element=Com.DrvKneadingMassgSkillsSts6.DrvKneadingMassgSkillsSts6, system-signal=DrvKneadingMassgSkillsSts6
        data-element=Com.DrvKneadingMassglvlSts{5..8}.DrvKneadingMassglvlSts{5..8}, system-signal=DrvKneadingMassglvlSts{5..8}
        data-element=Com.DrvKneadingMassgSkillsSts7.DrvKneadingMassgSkillsSts7, system-signal=DrvKneadingMassgSkillsSts7
        data-element=Com.DrvKneadingMassgSkillsSts8.DrvKneadingMassgSkillsSts8, system-signal=DrvKneadingMassgSkillsSts8
        data-element=Com.DrvKneadingMassgTime8.DrvKneadingMassgTime8, system-signal=DrvKneadingMassgTime8
        data-element=Com.DrvKneadingMassgTime{5..7}.DrvKneadingMassgTime{5..7}, system-signal=DrvKneadingMassgTime{5..7}
        data-element=Com.DrvMassSwitchSts.DrvMassSwitchSts, system-signal=DrvMassSwitchSts
        data-element=Com.DrvSeatmassgHeatCSts.DrvSeatmassgHeatCSts, system-signal=DrvSeatmassgHeatCSts
        data-element=Com.DrvSeatLumbarValueSts.DrvSeatLumbarValueSts, system-signal=DrvSeatLumbarValueSts
        data-element=Com.DrvSeatmassgValveSts.DrvSeatmassgValveSts, system-signal=DrvSeatmassgValveSts
        data-element=Com.DrvSeatUpperValueSts.DrvSeatUpperValueSts, system-signal=DrvSeatUpperValueSts
        data-element=Com.DrvSeatCushionValueSts.DrvSeatCushionValueSts, system-signal=DrvSeatCushionValueSts
        data-element=Com.DrvSeatBlosterValueSts.DrvSeatBlosterValueSts, system-signal=DrvSeatBlosterValueSts
        data-element=Com.DrvSeatLumbarTopPos.DrvSeatLumbarTopPos, system-signal=DrvSeatLumbarTopPos
        data-element=Com.DrvSeatLumbarMidPos.DrvSeatLumbarMidPos, system-signal=DrvSeatLumbarMidPos
        data-element=Com.DrvSeatLumbarBottomPos.DrvSeatLumbarBottomPos, system-signal=DrvSeatLumbarBottomPos
        data-element=Com.DrvSeatBolsterValueBLPos.DrvSeatBolsterValueBLPos, system-signal=DrvSeatBolsterValueBLPos
        data-element=Com.DrvSeatBolsterValueBRPos.DrvSeatBolsterValueBRPos, system-signal=DrvSeatBolsterValueBRPos
        data-element=Com.DrvSeatCushionValue6Pos.DrvSeatCushionValue6Pos, system-signal=DrvSeatCushionValue6Pos
        data-element=Com.DrvSeatCushionValue5Pos.DrvSeatCushionValue5Pos, system-signal=DrvSeatCushionValue5Pos
        data-element=Com.DrvSeatCushionValue4Pos.DrvSeatCushionValue4Pos, system-signal=DrvSeatCushionValue4Pos
        data-element=Com.DrvSeatCushionValue2Pos.DrvSeatCushionValue2Pos, system-signal=DrvSeatCushionValue2Pos
        data-element=Com.DrvSeatCushionValue1Pos.DrvSeatCushionValue1Pos, system-signal=DrvSeatCushionValue1Pos
        data-element=Com.DrvSeatUpperValueLPos.DrvSeatUpperValueLPos, system-signal=DrvSeatUpperValueLPos
        data-element=Com.DrvSeatUpperValueMPos.DrvSeatUpperValueMPos, system-signal=DrvSeatUpperValueMPos
        data-element=Com.DrvSeatUpperValueRPos.DrvSeatUpperValueRPos, system-signal=DrvSeatUpperValueRPos
        data-element=Com.DrvPumpSts.DrvPumpSts, system-signal=DrvPumpSts
        data-element=Com.DrvKneadingMassgSkillsSts9.DrvKneadingMassgSkillsSts9, system-signal=DrvKneadingMassgSkillsSts9
        data-element=Com.DrvLumControlSts.DrvLumControlSts, system-signal=DrvLumControlSts
        data-element=Com.DrvLumSwitchSts.DrvLumSwitchSts, system-signal=DrvLumSwitchSts
        data-element=Com.DrvSystemFailr.DrvSystemFailr, system-signal=DrvSystemFailr
        data-element=Com.DrvSeatMassFailr.DrvSeatMassFailr, system-signal=DrvSeatMassFailr
        data-element=Com.DrvSeatCushionValue3Pos.DrvSeatCushionValue3Pos, system-signal=DrvSeatCushionValue3Pos
        data-element=Com.DrvLumbarTopWorkSts.DrvLumbarTopWorkSts, system-signal=DrvLumbarTopWorkSts
        data-element=Com.DrvLumbarMidWorkSts.DrvLumbarMidWorkSts, system-signal=DrvLumbarMidWorkSts
        data-element=Com.DrvLumbarBottomWorkSts.DrvLumbarBottomWorkSts, system-signal=DrvLumbarBottomWorkSts
        data-element=Com.DrvHeat{1..6}Sts.DrvHeat{1..6}Sts, system-signal=DrvHeat{1..6}Sts
        data-element=Com.DrvHeat5ErrSts.DrvHeat5ErrSts, system-signal=DrvHeat5ErrSts
        data-element=Com.DrvKneadingMassglvlSts9.DrvKneadingMassglvlSts9, system-signal=DrvKneadingMassglvlSts9
        data-element=Com.DrvKneadingMassgTime9.DrvKneadingMassgTime9, system-signal=DrvKneadingMassgTime9
        data-element=Com.DrvKneadingMassgTime10.DrvKneadingMassgTime10, system-signal=DrvKneadingMassgTime10
        data-element=Com.DrvKneadingMassgSkillsSts10.DrvKneadingMassgSkillsSts10, system-signal=DrvKneadingMassgSkillsSts10
        data-element=Com.DrvKneadingMassglvlSts10.DrvKneadingMassglvlSts10, system-signal=DrvKneadingMassglvlSts10
        data-element=Com.DrvMassageHeatNTC{1..12}.DrvMassageHeatNTC{1..12}, system-signal=DrvMassageHeatNTC{1..12}
        data-element=Com.PassKneadingMassgSkillsCmd5.PassKneadingMassgSkillsCmd5, system-signal=PassKneadingMassgSkillsCmd5
        data-element=Com.PassKneadingMassgTimesCmd5.PassKneadingMassgTimesCmd5, system-signal=PassKneadingMassgTimesCmd5
        data-element=Com.PassKneadingMassgLvlCmd{5..8}.PassKneadingMassgLvlCmd{5..8}, system-signal=PassKneadingMassgLvlCmd{5..8}
        data-element=Com.PassKneadingMassgSkillsCmd6.PassKneadingMassgSkillsCmd6, system-signal=PassKneadingMassgSkillsCmd6
        data-element=Com.PassKneadingMassgTimesCmd6.PassKneadingMassgTimesCmd6, system-signal=PassKneadingMassgTimesCmd6
        data-element=Com.PassKneadingMassgSkillsCmd7.PassKneadingMassgSkillsCmd7, system-signal=PassKneadingMassgSkillsCmd7
        data-element=Com.PassKneadingMassgTimesCmd7.PassKneadingMassgTimesCmd7, system-signal=PassKneadingMassgTimesCmd7
        data-element=Com.PassKneadingMassgSkillsCmd8.PassKneadingMassgSkillsCmd8, system-signal=PassKneadingMassgSkillsCmd8
        data-element=Com.PassKneadingMassgTimesCmd8.PassKneadingMassgTimesCmd8, system-signal=PassKneadingMassgTimesCmd8
        data-element=Com.PassKneadingMassgSkillsCmd9.PassKneadingMassgSkillsCmd9, system-signal=PassKneadingMassgSkillsCmd9
        data-element=Com.PassKneadingMassgTimesCmd9.PassKneadingMassgTimesCmd9, system-signal=PassKneadingMassgTimesCmd9
        data-element=Com.PassKneadingMassgSkillsCmd10.PassKneadingMassgSkillsCmd10, system-signal=PassKneadingMassgSkillsCmd10
        data-element=Com.PassKneadingMassgTimesCmd10.PassKneadingMassgTimesCmd10, system-signal=PassKneadingMassgTimesCmd10
        data-element=Com.PassKneadingMassgLvlCmd9.PassKneadingMassgLvlCmd9, system-signal=PassKneadingMassgLvlCmd9
        data-element=Com.PassKneadingMassgLvlCmd10.PassKneadingMassgLvlCmd10, system-signal=PassKneadingMassgLvlCmd10
        data-element=Com.PassHeat{1..6}_pct.PassHeat{1..6}_pct, system-signal=PassHeat{1..6}_pct
        data-element=Com.PassSeatmassgValve{1..12}Cmd.PassSeatmassgValve{1..12}Cmd, system-signal=PassSeatmassgValve{1..12}Cmd
        data-element=Com.PassSeatmassgHeat{1..12}Cmd.PassSeatmassgHeat{1..12}Cmd, system-signal=PassSeatmassgHeat{1..12}Cmd
        data-element=Com.PassSeatLumbarTopValue1Cmd.PassSeatLumbarTopValue1Cmd, system-signal=PassSeatLumbarTopValue1Cmd
        data-element=Com.PassSeatLumbarMidValue2Cmd.PassSeatLumbarMidValue2Cmd, system-signal=PassSeatLumbarMidValue2Cmd
        data-element=Com.PassSeatLumbarBottomValue3Cmd.PassSeatLumbarBottomValue3Cmd, system-signal=PassSeatLumbarBottomValue3Cmd
        data-element=Com.PassSeatBolsterValueBLCmd.PassSeatBolsterValueBLCmd, system-signal=PassSeatBolsterValueBLCmd
        data-element=Com.PassSeatBolsterValueBRCmd.PassSeatBolsterValueBRCmd, system-signal=PassSeatBolsterValueBRCmd
        data-element=Com.PassSeatCushionValue6Cmd.PassSeatCushionValue6Cmd, system-signal=PassSeatCushionValue6Cmd
        data-element=Com.PassSeatCushionValue5Cmd.PassSeatCushionValue5Cmd, system-signal=PassSeatCushionValue5Cmd
        data-element=Com.PassSeatCushionValue4Cmd.PassSeatCushionValue4Cmd, system-signal=PassSeatCushionValue4Cmd
        data-element=Com.PassPumpCmd.PassPumpCmd, system-signal=PassPumpCmd
        data-element=Com.PassSeatUpperValueLCmd.PassSeatUpperValueLCmd, system-signal=PassSeatUpperValueLCmd
        data-element=Com.PassSeatUpperValueMCmd.PassSeatUpperValueMCmd, system-signal=PassSeatUpperValueMCmd
        data-element=Com.PassSeatUpperValueRCmd.PassSeatUpperValueRCmd, system-signal=PassSeatUpperValueRCmd
        data-element=Com.PassSeatCushionValue2Cmd.PassSeatCushionValue2Cmd, system-signal=PassSeatCushionValue2Cmd
        data-element=Com.PassSeatCushionValue3Cmd.PassSeatCushionValue3Cmd, system-signal=PassSeatCushionValue3Cmd
        data-element=Com.PassSeatCushionValue1Cmd.PassSeatCushionValue1Cmd, system-signal=PassSeatCushionValue1Cmd
        data-element=Com.PassKneadingMassgSkillsSts5.PassKneadingMassgSkillsSts5, system-signal=PassKneadingMassgSkillsSts5
        data-element=Com.PassKneadingMassgLvlSts5.PassKneadingMassgLvlSts5, system-signal=PassKneadingMassgLvlSts5
        data-element=Com.PassKneadingMassgLvlSts6.PassKneadingMassgLvlSts6, system-signal=PassKneadingMassgLvlSts6
        data-element=Com.PassKneadingMassgTime5.PassKneadingMassgTime5, system-signal=PassKneadingMassgTime5
        data-element=Com.PassKneadingMassgSkillsSts6.PassKneadingMassgSkillsSts6, system-signal=PassKneadingMassgSkillsSts6
        data-element=Com.PassKneadingMassgSkillsSts7.PassKneadingMassgSkillsSts7, system-signal=PassKneadingMassgSkillsSts7
        data-element=Com.PassKneadingMassgTime6.PassKneadingMassgTime6, system-signal=PassKneadingMassgTime6
        data-element=Com.PassKneadingMassgTime7.PassKneadingMassgTime7, system-signal=PassKneadingMassgTime7
        data-element=Com.PassKneadingMassgSkillsSts8.PassKneadingMassgSkillsSts8, system-signal=PassKneadingMassgSkillsSts8
        data-element=Com.PassKneadingMassgLvlSts7.PassKneadingMassgLvlSts7, system-signal=PassKneadingMassgLvlSts7
        data-element=Com.PassKneadingMassgLvlSts8.PassKneadingMassgLvlSts8, system-signal=PassKneadingMassgLvlSts8
        data-element=Com.PassKneadingMassgTime8.PassKneadingMassgTime8, system-signal=PassKneadingMassgTime8
        data-element=Com.PassSeatmassgValveSts.PassSeatmassgValveSts, system-signal=PassSeatmassgValveSts
        data-element=Com.PassSeatmassgHeatCSts.PassSeatmassgHeatCSts, system-signal=PassSeatmassgHeatCSts
        data-element=Com.PassSeatLumbarValueSts.PassSeatLumbarValueSts, system-signal=PassSeatLumbarValueSts
        data-element=Com.PassSeatUpperValueSts.PassSeatUpperValueSts, system-signal=PassSeatUpperValueSts
        data-element=Com.PassSeatCushionValueSts.PassSeatCushionValueSts, system-signal=PassSeatCushionValueSts
        data-element=Com.PassSeatBlosterValueSts.PassSeatBlosterValueSts, system-signal=PassSeatBlosterValueSts
        data-element=Com.PassMassSwitchSts.PassMassSwitchSts, system-signal=PassMassSwitchSts
        data-element=Com.PassSeatLumbarTopPos.PassSeatLumbarTopPos, system-signal=PassSeatLumbarTopPos
        data-element=Com.PassSeatLumbarMidPos.PassSeatLumbarMidPos, system-signal=PassSeatLumbarMidPos
        data-element=Com.PassSeatLumbarBottomPos.PassSeatLumbarBottomPos, system-signal=PassSeatLumbarBottomPos
        data-element=Com.PassSeatBolsterValueBLPos.PassSeatBolsterValueBLPos, system-signal=PassSeatBolsterValueBLPos
        data-element=Com.PassSeatBolsterValueBRPos.PassSeatBolsterValueBRPos, system-signal=PassSeatBolsterValueBRPos
        data-element=Com.PassSeatCushionValue6Pos.PassSeatCushionValue6Pos, system-signal=PassSeatCushionValue6Pos
        data-element=Com.PassSeatCushionValue5Pos.PassSeatCushionValue5Pos, system-signal=PassSeatCushionValue5Pos
        data-element=Com.PassSeatCushionValue4Pos.PassSeatCushionValue4Pos, system-signal=PassSeatCushionValue4Pos
        data-element=Com.PassSeatCushionValue2Pos.PassSeatCushionValue2Pos, system-signal=PassSeatCushionValue2Pos
        data-element=Com.PassSeatCushionValue1Pos.PassSeatCushionValue1Pos, system-signal=PassSeatCushionValue1Pos
        data-element=Com.PassSeatUpperValueLPos.PassSeatUpperValueLPos, system-signal=PassSeatUpperValueLPos
        data-element=Com.PassSeatUpperValueMPos.PassSeatUpperValueMPos, system-signal=PassSeatUpperValueMPos
        data-element=Com.PassSeatUpperValueRPos.PassSeatUpperValueRPos, system-signal=PassSeatUpperValueRPos
        data-element=Com.PassPumpSts.PassPumpSts, system-signal=PassPumpSts
        data-element=Com.PassKneadingMassgSkillsSts9.PassKneadingMassgSkillsSts9, system-signal=PassKneadingMassgSkillsSts9
        data-element=Com.PassLumControlSts.PassLumControlSts, system-signal=PassLumControlSts
        data-element=Com.PassLumSwitchSts.PassLumSwitchSts, system-signal=PassLumSwitchSts
        data-element=Com.PassSystemFailr.PassSystemFailr, system-signal=PassSystemFailr
        data-element=Com.PassSeatMassFailr.PassSeatMassFailr, system-signal=PassSeatMassFailr
        data-element=Com.PassSeatCushionValue3Pos.PassSeatCushionValue3Pos, system-signal=PassSeatCushionValue3Pos
        data-element=Com.PassLumbarTopWorkSts.PassLumbarTopWorkSts, system-signal=PassLumbarTopWorkSts
        data-element=Com.PassLumbarMidWorkSts.PassLumbarMidWorkSts, system-signal=PassLumbarMidWorkSts
        data-element=Com.PassLumbarBottomWorkSts.PassLumbarBottomWorkSts, system-signal=PassLumbarBottomWorkSts
        data-element=Com.PassHeat{1..6}Sts.PassHeat{1..6}Sts, system-signal=PassHeat{1..6}Sts
        data-element=Com.PassHeat5ErrSts.PassHeat5ErrSts, system-signal=PassHeat5ErrSts
        data-element=Com.PassKneadingMassgLvlSts9.PassKneadingMassgLvlSts9, system-signal=PassKneadingMassgLvlSts9
        data-element=Com.PassKneadingMassgTime9.PassKneadingMassgTime9, system-signal=PassKneadingMassgTime9
        data-element=Com.PassKneadingMassgTime10.PassKneadingMassgTime10, system-signal=PassKneadingMassgTime10
        data-element=Com.PassKneadingMassgSkillsSts10.PassKneadingMassgSkillsSts10, system-signal=PassKneadingMassgSkillsSts10
        data-element=Com.PassKneadingMassgLvlSts10.PassKneadingMassgLvlSts10, system-signal=PassKneadingMassgLvlSts10
        data-element=Com.PassMassageHeatNTC{1..12}.PassMassageHeatNTC{1..12}, system-signal=PassMassageHeatNTC{1..12}
    system mapping BSWSWCCompositionEASLdComSystem
  330 x system signal:
    VehSpdSts_Rdnt1
    VehSpd_Rdnt1
    ZONE_13C_CRC
    ZONE_13C_MsgCntr
    OperatorState_SrvSts
    DrvState_SrvSts
    VehStateDetailed_SrvSts
    DrvState
    OperatorState
    VehStateDetailed
    VehModeDef
    DrvKneadingMassgSkillsCmd5
    DrvKneadingMassgTimesCmd5
    DrvKneadingMassgLvlCmd{5..8}
    DrvKneadingMassgSkillsCmd6
    DrvKneadingMassgTimesCmd6
    DrvKneadingMassgSkillsCmd7
    DrvKneadingMassgTimesCmd7
    DrvKneadingMassgSkillsCmd8
    DrvKneadingMassgTimesCmd8
    DrvKneadingMassgSkillsCmd9
    DrvKneadingMassgTimesCmd9
    DrvKneadingMassgLvlCmd9
    DrvKneadingMassgLvlCmd10
    DrvKneadingMassgTimesCmd10
    DrvKneadingMassgSkillsCmd10
    DrvHeat{1..6}_pct
    DrvSeatmassgValve{1..12}Cmd
    DrvSeatmassgHeat{1..12}Cmd
    DrvSeatLumbarTopValue1Cmd
    DrvSeatLumbarMidValue2Cmd
    DrvSeatLumbarBottomValue3Cmd
    DrvSeatBolsterValueBLCmd
    DrvSeatBolsterValueBRCmd
    DrvSeatCushionValue6Cmd
    DrvSeatCushionValue5Cmd
    DrvSeatCushionValue4Cmd
    DrvPumpCmd
    DrvSeatUpperValueLCmd
    DrvSeatUpperValueMCmd
    DrvSeatCushionValue2Cmd
    DrvSeatUpperValueRCmd
    DrvSeatCushionValue3Cmd
    DrvSeatCushionValue1Cmd
    BattVolt_LBMR
    VehOdometer
    Yr
    Mth
    Day
    Hr
    Min
    Sec
    MSec
    PNC_DFT
    PNC{1..41}_Sts
    PNC43_Sts
    PNC42_Sts
    PNC{44..48}_Sts
    VC_Data_5E0_CRC
    VC_Data_5E0_MsgCntr
    VC_Data_5E0_Payload
    DrvKneadingMassgSkillsSts5
    DrvKneadingMassgSkillsSts6
    DrvKneadingMassglvlSts{5..8}
    DrvKneadingMassgSkillsSts7
    DrvKneadingMassgSkillsSts8
    DrvKneadingMassgTime8
    DrvKneadingMassgTime{5..7}
    DrvMassSwitchSts
    DrvSeatmassgHeatCSts
    DrvSeatLumbarValueSts
    DrvSeatmassgValveSts
    DrvSeatUpperValueSts
    DrvSeatCushionValueSts
    DrvSeatBlosterValueSts
    DrvSeatLumbarTopPos
    DrvSeatLumbarMidPos
    DrvSeatLumbarBottomPos
    DrvSeatBolsterValueBLPos
    DrvSeatBolsterValueBRPos
    DrvSeatCushionValue6Pos
    DrvSeatCushionValue5Pos
    DrvSeatCushionValue4Pos
    DrvSeatCushionValue2Pos
    DrvSeatCushionValue1Pos
    DrvSeatUpperValueLPos
    DrvSeatUpperValueMPos
    DrvSeatUpperValueRPos
    DrvPumpSts
    DrvKneadingMassgSkillsSts9
    DrvLumControlSts
    DrvLumSwitchSts
    DrvSystemFailr
    DrvSeatMassFailr
    DrvSeatCushionValue3Pos
    DrvLumbarTopWorkSts
    DrvLumbarMidWorkSts
    DrvLumbarBottomWorkSts
    DrvHeat{1..6}Sts
    DrvHeat5ErrSts
    DrvKneadingMassglvlSts9
    DrvKneadingMassgTime9
    DrvKneadingMassgTime10
    DrvKneadingMassgSkillsSts10
    DrvKneadingMassglvlSts10
    DrvMassageHeatNTC{1..12}
    PassKneadingMassgSkillsCmd5
    PassKneadingMassgTimesCmd5
    PassKneadingMassgLvlCmd{5..8}
    PassKneadingMassgSkillsCmd6
    PassKneadingMassgTimesCmd6
    PassKneadingMassgSkillsCmd7
    PassKneadingMassgTimesCmd7
    PassKneadingMassgSkillsCmd8
    PassKneadingMassgTimesCmd8
    PassKneadingMassgSkillsCmd9
    PassKneadingMassgTimesCmd9
    PassKneadingMassgSkillsCmd10
    PassKneadingMassgTimesCmd10
    PassKneadingMassgLvlCmd9
    PassKneadingMassgLvlCmd10
    PassHeat{1..6}_pct
    PassSeatmassgValve{1..12}Cmd
    PassSeatmassgHeat{1..12}Cmd
    PassSeatLumbarTopValue1Cmd
    PassSeatLumbarMidValue2Cmd
    PassSeatLumbarBottomValue3Cmd
    PassSeatBolsterValueBLCmd
    PassSeatBolsterValueBRCmd
    PassSeatCushionValue6Cmd
    PassSeatCushionValue5Cmd
    PassSeatCushionValue4Cmd
    PassPumpCmd
    PassSeatUpperValueLCmd
    PassSeatUpperValueMCmd
    PassSeatUpperValueRCmd
    PassSeatCushionValue2Cmd
    PassSeatCushionValue3Cmd
    PassSeatCushionValue1Cmd
    PassKneadingMassgSkillsSts5
    PassKneadingMassgLvlSts5
    PassKneadingMassgLvlSts6
    PassKneadingMassgTime5
    PassKneadingMassgSkillsSts6
    PassKneadingMassgSkillsSts7
    PassKneadingMassgTime6
    PassKneadingMassgTime7
    PassKneadingMassgSkillsSts8
    PassKneadingMassgLvlSts7
    PassKneadingMassgLvlSts8
    PassKneadingMassgTime8
    PassSeatmassgValveSts
    PassSeatmassgHeatCSts
    PassSeatLumbarValueSts
    PassSeatUpperValueSts
    PassSeatCushionValueSts
    PassSeatBlosterValueSts
    PassMassSwitchSts
    PassSeatLumbarTopPos
    PassSeatLumbarMidPos
    PassSeatLumbarBottomPos
    PassSeatBolsterValueBLPos
    PassSeatBolsterValueBRPos
    PassSeatCushionValue6Pos
    PassSeatCushionValue5Pos
    PassSeatCushionValue4Pos
    PassSeatCushionValue2Pos
    PassSeatCushionValue1Pos
    PassSeatUpperValueLPos
    PassSeatUpperValueMPos
    PassSeatUpperValueRPos
    PassPumpSts
    PassKneadingMassgSkillsSts9
    PassLumControlSts
    PassLumSwitchSts
    PassSystemFailr
    PassSeatMassFailr
    PassSeatCushionValue3Pos
    PassLumbarTopWorkSts
    PassLumbarMidWorkSts
    PassLumbarBottomWorkSts
    PassHeat{1..6}Sts
    PassHeat5ErrSts
    PassKneadingMassgLvlSts9
    PassKneadingMassgTime9
    PassKneadingMassgTime10
    PassKneadingMassgSkillsSts10
    PassKneadingMassgLvlSts10
    PassMassageHeatNTC{1..12}
