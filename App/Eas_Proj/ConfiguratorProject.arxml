[part 1 of 4: package /EcucDefs]
AUTOSAR XML (schema 00046)
package /EcucDefs
  ecuc definition collection AUTOSARParameterDefinition: module=[Base, BswM, CanIf, CanSM, CanTp, Com, ComM, Dcm, Dem, Det, EcuC, EcuM, MemIf, MemMap, NvM, PduR, Rte]
  eas_extmodule_def eas_extmodule_type=Can, eas_extmodule_name=/YTM32MX_0_9_1_Can/Can:
    CAN0 (CanController): CanWakeUpSourceFilter=, CanControllerId=0
    CanConfigSet
      20 x CanHardwareObject, all with CanIdType=STANDARD, CanControllerRef=CAN0:
        HOH0_BCU_11E: CanObjectType=RECEIVE, CanObjectId=0
        HOH2_DIAG_REQ_AllECU: CanObjectType=RECEIVE, CanObjectId=1
        HOH3_DIAG_REQ_MCMD_623_MCMP_624: CanObjectType=RECEIVE, CanObjectId=2
        HOH4_VC_Data_5E0: CanObjectType=RECEIVE, CanObjectId=3
        HOH5_ZONE_13C: CanObjectType=RECEIVE, CanObjectId=4
        HOH6_ZONE_MCMD_1C9_MCMP_1CF: CanObjectType=RECEIVE, CanObjectId=5
        HOH7_ZONE_2EF: CanObjectType=RECEIVE, CanObjectId=6
        HOH8_ZONE_3A9: CanObjectType=RECEIVE, CanObjectId=7
        HOH9_ZONE_3B2: CanObjectType=RECEIVE, CanObjectId=8
        HOH10_MCMD_Zone_FL_MCM_01_1D1_MCMP_Zone_FL_MCM_03_1D3: CanObjectType=RECEIVE, CanObjectId=9
        HOH11_MCMD_Zone_FL_MCM_02_1D2_MCMP_Zone_FL_MCM_04_1D4: CanObjectType=RECEIVE, CanObjectId=10
        HOH12_MCMD_ZONE_MCM_05_1B4_MCMP_ZONE_MCM_06_1B5: CanObjectType=RECEIVE, CanObjectId=11
        HOH13_ZONE_PNC: CanObjectType=RECEIVE, CanObjectId=12
        HOH15_DIAG_RESP_MCM_D_6A3_MCMP_6A4: CanObjectType=TRANSMIT, CanObjectId=13
        HOH16_MCM_D_1B6_MCM_P_1B7: CanObjectType=TRANSMIT, CanObjectId=14
        HOH17_MCM_D_1DF_MCM_P_1E2: CanObjectType=TRANSMIT, CanObjectId=15
        HOH18_MCM_D_1E0_MCM_P_1E3: CanObjectType=TRANSMIT, CanObjectId=16
        HOH19_MCM_D_1E1_MCM_P_1E4: CanObjectType=TRANSMIT, CanObjectId=17
        HOH20_MCM_D_1E8_MCM_P_1EB: CanObjectType=TRANSMIT, CanObjectId=18
        HOH21_MCM_D_1EC_MCM_P_1ED: CanObjectType=TRANSMIT, CanObjectId=19
  module config BswM: implementation-config-variant=STD_CONFIG_VARIANTS_POSTBUILD, module_version_def=4.1.0, module_autosar_version=Ar470
    BswMGeneral:
      VersionCheck = true
      BswMCanSMEnabled = true
      BswMComMEnabled = true
      BswMDcmEnabled = true
      BswMDevErrorDetect = true
      BswMEcuMEnabled = true
      BswMEthSMEnabled = false
      BswMEthIfEnabled = false
      BswMFrSMEnabled = false
      BswMGenericRequestEnabled = true
      BswMLinSMEnabled = false
      BswMLinTpEnabled = false
      BswMNvMEnabled = true
      BswMSchMEnabled = false
      BswMSoAdEnabled = false
      BswMVersionInfoApi = true
      BswMJ1939DcmEnabled = false
      BswMJ1939NmEnabled = false
      BswMSdEnabled = false
      BswMNmEnabled = false
      BswMMainFunctionPeriod = 5
      BswMUserIncludeFile = 
      BswMDefaultModeCfg = true
      SleepWithNormalWakeup = false
      AutoRestoreNvM = true
      AutoSaveNvM = true
      SupportBootloader = false
      PNCAutoConfigWithCommunicationControl = false
      CommunicationControl = true
      PncAutoConfig = false
      BswMChangeEnabled = false
      VoltageCheckEnable = false
      BswMLinScheduleReport = false
      SleepWithResetWakeup = true
      BswMMultiCoreSupport = false
      BODY_LE1_CANTx (IpduGroup): Direction=Tx, ComMChannel=ComM_BODY_LE1_CAN
      BODY_LE1_CANRx (IpduGroup): Direction=Rx, ComMChannel=ComM_BODY_LE1_CAN
    Cfg_D (BswMConfig): UserDefine=false
      BswMArbitration
        29 x BswMLogicalExpression, all with UserDefine=false:
          ExpInitBlockII_Core0: BswMLogicalOperator=BSWM_OR, direction=, BswMArgumentRef=SysStateInit_Core0
          ExpWkupToReadNvM_Core0: BswMLogicalOperator=BSWM_AND, direction=, BswMArgumentRef=SysStateWakeup_Core0, BswMArgumentRef=ExpReqToRun
          ExpReadNvMToRun_Core0: BswMLogicalOperator=BSWM_AND, direction=, BswMArgumentRef=SysStateReadNvM_Core0, BswMArgumentRef=ExpNvMReadAllFinished
          ExpReqToRun: BswMLogicalOperator=BSWM_OR, direction=, BswMArgumentRef=EcuMRequestRun, BswMArgumentRef=ComM0FullCom
          ExpPrepToRun_Core0: BswMLogicalOperator=BSWM_AND, direction=, BswMArgumentRef=ExpReqToRun, BswMArgumentRef=SysStatePrepareShutdown_Core0
          ExpWriteNvMToRun_Core0: BswMLogicalOperator=BSWM_AND, direction=, BswMArgumentRef=ExpReqToRun, BswMArgumentRef=SysStateWriteNvM_Core0
          ExpPostRunToRun_Core0: BswMLogicalOperator=BSWM_AND, direction=, BswMArgumentRef=EcuMRequestRun, BswMArgumentRef=SysStateAppPostRun_Core0
          ExpRunToPostRun_Core0: BswMLogicalOperator=BSWM_AND, direction=, BswMArgumentRef=EcuMRequestPostRun, BswMArgumentRef=ComM0NoCom, BswMArgumentRef=SysStateAppRun_Core0, BswMArgumentRef=TimerExpired0
          ExpPostRunToPrep_Core0: BswMLogicalOperator=BSWM_AND, direction=, BswMArgumentRef=EcuMRequestShutdown, BswMArgumentRef=ComM0NoCom, BswMArgumentRef=SysStateAppPostRun_Core0
          ExpRunToPrep_Core0: BswMLogicalOperator=BSWM_AND, direction=, BswMArgumentRef=EcuMRequestShutdown, BswMArgumentRef=ComM0NoCom, BswMArgumentRef=SysStateAppRun_Core0, BswMArgumentRef=TimerExpired0
          ExpPrepToWriteNvM_Core0: BswMLogicalOperator=BSWM_AND, direction=, BswMArgumentRef=EcuMRequestShutdown, BswMArgumentRef=ComM0NoCom, BswMArgumentRef=SysStatePrepareShutdown_Core0
          ExpWriteNvMToSleep_Core0: BswMLogicalOperator=BSWM_AND, direction=, BswMArgumentRef=EcuMRequestShutdown, BswMArgumentRef=ComM0NoCom, BswMArgumentRef=SysStateWriteNvM_Core0, BswMArgumentRef=ExpNvMWriteAllFinished
          ExpWkupToSleep_Core0: BswMLogicalOperator=BSWM_AND, direction=, BswMArgumentRef=EcuMRequestShutdown, BswMArgumentRef=ComM0NoCom, BswMArgumentRef=SysStateWakeup_Core0, BswMArgumentRef=TimerExpired0
          ExpCanSM0AllowRx: BswMLogicalOperator=BSWM_NOT, direction=, BswMArgumentRef=CanSM0NoCom
          ExpCanSM0StopTx: BswMLogicalOperator=BSWM_NOT, direction=, BswMArgumentRef=CanSM0FullCom
          ExpDcmReqComNoRxTx0: BswMLogicalOperator=BSWM_OR, direction=, BswMArgumentRef=DcmReqComNoRxTx0, BswMArgumentRef=DcmReqComNmNoRxTx0
          ExpDcmReqComNoRx0: BswMLogicalOperator=BSWM_OR, direction=, BswMArgumentRef=DcmReqComNoRxTx0, BswMArgumentRef=DcmReqComTxNoRx0, BswMArgumentRef=DcmReqComNmNoRxTx0, BswMArgumentRef=DcmReqComNmTxNoRx0
          ExpDcmReqComNoTx0: BswMLogicalOperator=BSWM_OR, direction=, BswMArgumentRef=DcmReqComNoRxTx0, BswMArgumentRef=DcmReqComRxNoTx0, BswMArgumentRef=DcmReqComNmNoRxTx0, BswMArgumentRef=DcmReqComNmRxNoTx0
          ExpDcmReqComRxTx0: BswMLogicalOperator=BSWM_OR, direction=, BswMArgumentRef=DcmReqComRxTx0, BswMArgumentRef=DcmReqComNmRxTx0
          ExpDcmReqComRx0: BswMLogicalOperator=BSWM_OR, direction=, BswMArgumentRef=DcmReqComRxTx0, BswMArgumentRef=DcmReqComRxNoTx0, BswMArgumentRef=DcmReqComNmRxTx0, BswMArgumentRef=DcmReqComNmRxNoTx0
          ExpDcmReqComTx0: BswMLogicalOperator=BSWM_OR, direction=, BswMArgumentRef=DcmReqComRxTx0, BswMArgumentRef=DcmReqComTxNoRx0, BswMArgumentRef=DcmReqComNmRxTx0, BswMArgumentRef=DcmReqComNmTxNoRx0
          ExpDcmReqComTxNoRx0: BswMLogicalOperator=BSWM_OR, direction=, BswMArgumentRef=DcmReqComTxNoRx0, BswMArgumentRef=DcmReqComNmTxNoRx0
          ExpDcmReqComRxNoTx0: BswMLogicalOperator=BSWM_OR, direction=, BswMArgumentRef=DcmReqComRxNoTx0, BswMArgumentRef=DcmReqComNmRxNoTx0
          ExpBODY_LE1_CANTxOn: BswMLogicalOperator=BSWM_AND, direction=Tx, BswMArgumentRef=ComM0FullCom, BswMArgumentRef=CanSM0FullCom, BswMArgumentRef=ExpDcmReqComTx0
          ExpBODY_LE1_CANTxOff: BswMLogicalOperator=BSWM_OR, direction=Tx, BswMArgumentRef=ComM0NoCom, BswMArgumentRef=ExpCanSM0StopTx, BswMArgumentRef=ExpDcmReqComNoTx0
          ExpBODY_LE1_CANRxOn: BswMLogicalOperator=BSWM_AND, direction=Rx, BswMArgumentRef=ComM0FullCom, BswMArgumentRef=ExpCanSM0AllowRx, BswMArgumentRef=ExpDcmReqComRx0
          ExpBODY_LE1_CANRxOff: BswMLogicalOperator=BSWM_OR, direction=Rx, BswMArgumentRef=ComM0NoCom, BswMArgumentRef=CanSM0NoCom, BswMArgumentRef=ExpDcmReqComNoRx0
          ExpNvMReadAllFinished: BswMLogicalOperator=BSWM_OR, direction=, BswMArgumentRef=NvMReadAllOK, BswMArgumentRef=NvMReadAllNotOK
          ExpNvMWriteAllFinished: BswMLogicalOperator=BSWM_OR, direction=, BswMArgumentRef=NvMWriteAllOK, BswMArgumentRef=NvMWriteAllNotOK
        28 x BswMModeCondition, all with BswMConditionType=BSWM_EQUALS, UserDefine=false:
          SysStateInit_Core0: BswMConditionMode=SysState_Core0
            BswMConditionValue
              BswMBswMode: RequestedModeSelect=, BswMBswRequestedMode=BSWM_GENERIC_MODE_INIT
          SysStateWakeup_Core0: BswMConditionMode=SysState_Core0
            BswMConditionValue
              BswMBswMode: RequestedModeSelect=, BswMBswRequestedMode=BSWM_GENERIC_MODE_WAKEUP
          SysStateReadNvM_Core0: BswMConditionMode=SysState_Core0
            BswMConditionValue
              BswMBswMode: RequestedModeSelect=, BswMBswRequestedMode=BSWM_GENERIC_MODE_READ_NVM
          SysStateAppRun_Core0: BswMConditionMode=SysState_Core0
            BswMConditionValue
              BswMBswMode: RequestedModeSelect=, BswMBswRequestedMode=BSWM_GENERIC_MODE_APP_RUN
          EcuMRequestRun: BswMConditionMode=EcuMRunRequest
            BswMConditionValue
              BswMBswMode: RequestedModeSelect=ECUM_STATE_APP_RUN, BswMBswRequestedMode=
          EcuMRequestPostRun: BswMConditionMode=EcuMRunRequest
            BswMConditionValue
              BswMBswMode: RequestedModeSelect=ECUM_STATE_APP_POST_RUN, BswMBswRequestedMode=
          EcuMRequestShutdown: BswMConditionMode=EcuMRunRequest
            BswMConditionValue
              BswMBswMode: RequestedModeSelect=ECUM_STATE_SHUTDOWN, BswMBswRequestedMode=
          CanSM0NoCom: BswMConditionMode=CanSM0Mode
            BswMConditionValue
              BswMBswMode: RequestedModeSelect=CANSM_BSWM_NO_COMMUNICATION, BswMBswRequestedMode=
          CanSM0FullCom: BswMConditionMode=CanSM0Mode
            BswMConditionValue
              BswMBswMode: RequestedModeSelect=CANSM_BSWM_FULL_COMMUNICATION, BswMBswRequestedMode=
          ComM0NoCom: BswMConditionMode=ComM0Mode
            BswMConditionValue
              BswMBswMode: RequestedModeSelect=COMM_NO_COMMUNICATION, BswMBswRequestedMode=
          ComM0FullCom: BswMConditionMode=ComM0Mode
            BswMConditionValue
              BswMBswMode: RequestedModeSelect=COMM_FULL_COMMUNICATION, BswMBswRequestedMode=
          SysStateAppPostRun_Core0: BswMConditionMode=SysState_Core0
            BswMConditionValue
              BswMBswMode: RequestedModeSelect=, BswMBswRequestedMode=BSWM_GENERIC_MODE_POST_RUN
          SysStatePrepareShutdown_Core0: BswMConditionMode=SysState_Core0
            BswMConditionValue
              BswMBswMode: RequestedModeSelect=, BswMBswRequestedMode=BSWM_GENERIC_MODE_PREP_SHUTDOWN
          SysStateWriteNvM_Core0: BswMConditionMode=SysState_Core0
            BswMConditionValue
              BswMBswMode: RequestedModeSelect=, BswMBswRequestedMode=BSWM_GENERIC_MODE_WRITE_NVM
          SysStateSleep_Core0: BswMConditionMode=SysState_Core0
            BswMConditionValue
              BswMBswMode: RequestedModeSelect=, BswMBswRequestedMode=BSWM_GENERIC_MODE_SLEEP
          TimerExpired0: BswMConditionMode=BswMTimer0
            BswMConditionValue
              BswMBswMode: RequestedModeSelect=BSWM_TIMER_EXPIRED, BswMBswRequestedMode=
          DcmReqComNoRxTx0: BswMConditionMode=DcmRequestCommunicationMode0
            BswMConditionValue
              BswMBswMode: RequestedModeSelect=DCM_DISABLE_RX_TX_NORMAL, BswMBswRequestedMode=
          DcmReqComRxTx0: BswMConditionMode=DcmRequestCommunicationMode0
            BswMConditionValue
              BswMBswMode: RequestedModeSelect=DCM_ENABLE_RX_TX_NORM, BswMBswRequestedMode=
          DcmReqComTxNoRx0: BswMConditionMode=DcmRequestCommunicationMode0
            BswMConditionValue
              BswMBswMode: RequestedModeSelect=DCM_DISABLE_RX_ENABLE_TX_NORM, BswMBswRequestedMode=
          DcmReqComRxNoTx0: BswMConditionMode=DcmRequestCommunicationMode0
            BswMConditionValue
              BswMBswMode: RequestedModeSelect=DCM_ENABLE_RX_DISABLE_TX_NORM, BswMBswRequestedMode=
          DcmReqComNmNoRxTx0: BswMConditionMode=DcmRequestCommunicationMode0
            BswMConditionValue
              BswMBswMode: RequestedModeSelect=DCM_DISABLE_RX_TX_NORM_NM, BswMBswRequestedMode=
          DcmReqComNmRxTx0: BswMConditionMode=DcmRequestCommunicationMode0
            BswMConditionValue
              BswMBswMode: RequestedModeSelect=DCM_ENABLE_RX_TX_NORM_NM, BswMBswRequestedMode=
          DcmReqComNmTxNoRx0: BswMConditionMode=DcmRequestCommunicationMode0
            BswMConditionValue
              BswMBswMode: RequestedModeSelect=DCM_DISABLE_RX_ENABLE_TX_NORM_NM, BswMBswRequestedMode=
          DcmReqComNmRxNoTx0: BswMConditionMode=DcmRequestCommunicationMode0
            BswMConditionValue
              BswMBswMode: RequestedModeSelect=DCM_ENABLE_RX_DISABLE_TX_NORM_NM, BswMBswRequestedMode=
          NvMReadAllOK: BswMConditionMode=NvMReadAllMode
            BswMConditionValue
              BswMBswMode: RequestedModeSelect=NVM_REQ_OK, BswMBswRequestedMode=
          NvMReadAllNotOK: BswMConditionMode=NvMReadAllMode
            BswMConditionValue
              BswMBswMode: RequestedModeSelect=NVM_REQ_NOT_OK, BswMBswRequestedMode=
          NvMWriteAllOK: BswMConditionMode=NvMWriteAllMode
            BswMConditionValue
              BswMBswMode: RequestedModeSelect=NVM_REQ_OK, BswMBswRequestedMode=
          NvMWriteAllNotOK: BswMConditionMode=NvMWriteAllMode
            BswMConditionValue
              BswMBswMode: RequestedModeSelect=NVM_REQ_NOT_OK, BswMBswRequestedMode=
        8 x BswMModeRequestPort, all with UserDefine=false:
          SysState_Core0: BswMRequestProcessing=BSWM_IMMEDIATE
            BswMModeRequestSource
              SysState_Core0 (BswMGenericRequest): BswMModeRequesterId=0, BswMModeRequesterLocatedInCoreID=0
            BswMModeInitValue
              BswMSwcModeInitValue: BswMSwcModeInitValueRef=BSWM_GENERIC_MODE_INIT
          EcuMRunRequest: BswMRequestProcessing=BSWM_DEFERRED
            BswMModeRequestSource
              EcuMRunRequest (BswMEcuMRUNRequestIndication): BswMEcuMRUNRequestProtocolPort=POST_RUN
            BswMModeInitValue
              BswMBswModeInitValue: InitValueSelect=ECUM_STATE_SHUTDOWN, BswMBswModeInitValueMode=
          CanSM0Mode: BswMRequestProcessing=BSWM_DEFERRED
            BswMModeRequestSource
              CanSM0Mode (BswMCanSMIndication): BswMCanSMChannelRef=CanSM_BODY_LE1_CAN
            BswMModeInitValue
              BswMBswModeInitValue: InitValueSelect=CANSM_BSWM_NO_COMMUNICATION, BswMBswModeInitValueMode=
          ComM0Mode: BswMRequestProcessing=BSWM_DEFERRED
            BswMModeRequestSource
              ComM0Mode (BswMComMIndication): BswMComMChannelRef=ComM_BODY_LE1_CAN
            BswMModeInitValue
              BswMBswModeInitValue: InitValueSelect=COMM_NO_COMMUNICATION, BswMBswModeInitValueMode=
          BswMTimer0: BswMRequestProcessing=BSWM_DEFERRED
            BswMModeRequestSource
              BswMTimer0 (BswMTimer): BswMTimerLocatedInCoreID=0
            BswMModeInitValue
              BswMBswModeInitValue: InitValueSelect=BSWM_TIMER_STOPPED, BswMBswModeInitValueMode=
          DcmRequestCommunicationMode0: BswMRequestProcessing=BSWM_DEFERRED
            BswMModeRequestSource
              DcmRequestCommunicationMode0 (BswMDcmComModeRequest): BswMDcmComMChannelRef=ComM_BODY_LE1_CAN
            BswMModeInitValue
              BswMBswModeInitValue: InitValueSelect=DCM_ENABLE_RX_TX_NORM_NM, BswMBswModeInitValueMode=
          NvMReadAllMode: BswMRequestProcessing=BSWM_IMMEDIATE
            BswMModeRequestSource
              NvMReadAllMode (BswMNvMJobModeIndication): BswMNvmService=NvmReadAll
            BswMModeInitValue
              BswMBswModeInitValue: InitValueSelect=NVM_REQ_PENDING, BswMBswModeInitValueMode=
          NvMWriteAllMode: BswMRequestProcessing=BSWM_IMMEDIATE
            BswMModeRequestSource
              NvMWriteAllMode (BswMNvMJobModeIndication): BswMNvmService=NvmWriteAll
            BswMModeInitValue
              BswMBswModeInitValue: InitValueSelect=NVM_REQ_PENDING, BswMBswModeInitValueMode=
        16 x BswMRule, all with BswMNestedExecutionOnly=false, BswMRuleInitState=BSWM_FALSE, BswMRuleLocatedInCoreID=BSWM_CORE_0, UserDefine=false:
          BswM_RuleInitBlockII_Core0: BswMRuleExpressionRef=ExpInitBlockII_Core0, BswMRuleTrueActionList=BswM_ALInitBlockII_Core0
          BswM_RuleWkupToReadNvM_Core0: BswMRuleExpressionRef=ExpWkupToReadNvM_Core0, BswMRuleTrueActionList=BswM_ALWkupToReadNvM_Core0
          BswM_RuleReadNvMToRun_Core0: BswMRuleExpressionRef=ExpReadNvMToRun_Core0, BswMRuleTrueActionList=BswM_ALReadNvMToRun_Core0
          BswM_RuleRunToPostRun_Core0: BswMRuleExpressionRef=ExpRunToPostRun_Core0, BswMRuleTrueActionList=BswM_ALRunToPostRun_Core0
          BswM_RulePostRunToRun_Core0: BswMRuleExpressionRef=ExpPostRunToRun_Core0, BswMRuleTrueActionList=BswM_ALPostRunToRun_Core0
          BswM_RulePostRunToPrep_Core0: BswMRuleExpressionRef=ExpPostRunToPrep_Core0, BswMRuleTrueActionList=BswM_ALPostRunToPrep_Core0
          BswM_RuleRunToPrep_Core0: BswMRuleExpressionRef=ExpRunToPrep_Core0, BswMRuleTrueActionList=BswM_ALRunToPrep_Core0
          BswM_RulePrepToRun_Core0: BswMRuleExpressionRef=ExpPrepToRun_Core0, BswMRuleTrueActionList=BswM_ALPrepToRun_Core0
          BswM_RulePrepToWriteNvM_Core0: BswMRuleExpressionRef=ExpPrepToWriteNvM_Core0, BswMRuleTrueActionList=BswM_ALPrepToWriteNvM_Core0
          BswM_RuleWriteNvMToRun_Core0: BswMRuleExpressionRef=ExpWriteNvMToRun_Core0, BswMRuleTrueActionList=BswM_ALPrepToRun_Core0
          BswM_RuleWriteNvMToSleep_Core0: BswMRuleExpressionRef=ExpWriteNvMToSleep_Core0, BswMRuleTrueActionList=BswM_ALWriteNvMToSleep_Core0
          BswM_RuleWkupToSleep_Core0: BswMRuleExpressionRef=ExpWkupToSleep_Core0, BswMRuleTrueActionList=BswM_ALWkupToSleep_Core0
          BswM_RuleBODY_LE1_CANTxOn: BswMRuleExpressionRef=ExpBODY_LE1_CANTxOn, BswMRuleTrueActionList=BswM_ALBODY_LE1_CANTxOn
          BswM_RuleBODY_LE1_CANTxOff: BswMRuleExpressionRef=ExpBODY_LE1_CANTxOff, BswMRuleTrueActionList=BswM_ALBODY_LE1_CANTxOff
          BswM_RuleBODY_LE1_CANRxOn: BswMRuleExpressionRef=ExpBODY_LE1_CANRxOn, BswMRuleTrueActionList=BswM_ALBODY_LE1_CANRxOn
          BswM_RuleBODY_LE1_CANRxOff: BswMRuleExpressionRef=ExpBODY_LE1_CANRxOff, BswMRuleTrueActionList=BswM_ALBODY_LE1_CANRxOff
      BswMModeControl
        30 x BswMAction, all with UserDefine=false:
          ActionInitBlockII_Core0
            BswMAvailableActions
              ActionInitBlockII_Core0 (BswMUserCallout): BswMUserCalloutFunction=BswM_InitBlockIICallout_Core0()
          ActionStartBswTask_Core0
            BswMAvailableActions
              ActionStartBswTask_Core0 (BswMUserCallout): BswMUserCalloutFunction=BswM_StartBswTaskCallout_Core0()
          ActionPostReadAll_Core0
            BswMAvailableActions
              ActionPostReadAll_Core0 (BswMUserCallout): BswMUserCalloutFunction=BswM_PostReadAllCallout_Core0()
          ActionCom0Allow
            BswMAvailableActions
              ActionCom0Allow (BswMComMAllowCom): BswMComAllowed=true, BswMComMAllowChannelRef=ComM_BODY_LE1_CAN
          ActionRteStart_Core0
            BswMAvailableActions
              ActionRteStart_Core0 (BswMRteStart)
          ActionRequestWakeup_Core0
            BswMAvailableActions
              ActionRequestWakeup_Core0 (BswMGenericRequest): BswMRequestedMode=BSWM_GENERIC_MODE_WAKEUP, BswMModeRequestPort=SysState_Core0
          ActionRequestReadNvM_Core0
            BswMAvailableActions
              ActionRequestReadNvM_Core0 (BswMGenericRequest): BswMRequestedMode=BSWM_GENERIC_MODE_READ_NVM, BswMModeRequestPort=SysState_Core0
          ActionRequestAppRun_Core0
            BswMAvailableActions
              ActionRequestAppRun_Core0 (BswMGenericRequest): BswMRequestedMode=BSWM_GENERIC_MODE_APP_RUN, BswMModeRequestPort=SysState_Core0
          ActionSetEcuMRun
            BswMAvailableActions
              ActionSetEcuMRun (BswMEcuMStateSwitch): BswMEcuMState=RUN
          ActionSetEcuMAppRun
            BswMAvailableActions
              ActionSetEcuMAppRun (BswMEcuMStateSwitch): BswMEcuMState=APP_RUN
          ActionPreShutdown_Core0
            BswMAvailableActions
              ActionPreShutdown_Core0 (BswMUserCallout): BswMUserCalloutFunction=BswM_PreShutdownCallout_Core0()
          ActionWakeupToSleep_Core0
            BswMAvailableActions
              ActionWakeupToSleep_Core0 (BswMUserCallout): BswMUserCalloutFunction=BswM_WakeupToSleepCallout_Core0()
          ActionWriteNvMToSleep_Core0
            BswMAvailableActions
              ActionWriteNvMToSleep_Core0 (BswMUserCallout): BswMUserCalloutFunction=BswM_WriteNvMToSleepCallout_Core0()
          ActionClearWakeupEvent_Core0
            BswMAvailableActions
              ActionClearWakeupEvent_Core0 (BswMUserCallout): BswMUserCalloutFunction=BswM_ClearWakeupEventCallout_Core0()
          ActionRteStop_Core0
            BswMAvailableActions
              ActionRteStop_Core0 (BswMRteStop)
          ActionRequestAppPostRun_Core0
            BswMAvailableActions
              ActionRequestAppPostRun_Core0 (BswMGenericRequest): BswMRequestedMode=BSWM_GENERIC_MODE_POST_RUN, BswMModeRequestPort=SysState_Core0
          ActionRequestPrepareShutdown_Core0
            BswMAvailableActions
              ActionRequestPrepareShutdown_Core0 (BswMGenericRequest): BswMRequestedMode=BSWM_GENERIC_MODE_PREP_SHUTDOWN, BswMModeRequestPort=SysState_Core0
          ActionRequestWriteNvM_Core0
            BswMAvailableActions
              ActionRequestWriteNvM_Core0 (BswMGenericRequest): BswMRequestedMode=BSWM_GENERIC_MODE_WRITE_NVM, BswMModeRequestPort=SysState_Core0
          ActionRequestSleep_Core0
            BswMAvailableActions
              ActionRequestSleep_Core0 (BswMGenericRequest): BswMRequestedMode=BSWM_GENERIC_MODE_SLEEP, BswMModeRequestPort=SysState_Core0
          ActionSetTimerAppRunDelay_Core0
            BswMAvailableActions
              ActionSetTimerAppRunDelay_Core0 (BswMSetTimer): BswMTimerAction=BSWM_TIMER_START, BswMTimerValue=10, BswMTimerRef=BswMTimer0
          ActionSetTimerWakeUpDelay_Core0
            BswMAvailableActions
              ActionSetTimerWakeUpDelay_Core0 (BswMSetTimer): BswMTimerAction=BSWM_TIMER_START, BswMTimerValue=0, BswMTimerRef=BswMTimer0
          ActionStopTimer_Core0
            BswMAvailableActions
              ActionStopTimer_Core0 (BswMSetTimer): BswMTimerAction=BSWM_TIMER_STOP, BswMTimerValue=0, BswMTimerRef=BswMTimer0
          ActionSetEcuMAppPostRun
            BswMAvailableActions
              ActionSetEcuMAppPostRun (BswMEcuMStateSwitch): BswMEcuMState=APP_POST_RUN
          ActionSetEcuMSleep
            BswMAvailableActions
              ActionSetEcuMSleep (BswMEcuMStateSwitch): BswMEcuMState=SLEEP
          ActionBODY_LE1_CANTxOn
            BswMAvailableActions
              ActionBODY_LE1_CANTxOn (BswMPduGroupSwitch): BswMPduGroupSwitchReinit=false, BswMEnabledPduGroupRef=BODY_LE1_CANTx
          ActionBODY_LE1_CANTxOff
            BswMAvailableActions
              ActionBODY_LE1_CANTxOff (BswMPduGroupSwitch): BswMPduGroupSwitchReinit=false, BswMDisabledPduGroupRef=BODY_LE1_CANTx
          ActionBODY_LE1_CANRxOn
            BswMAvailableActions
              ActionBODY_LE1_CANRxOn (BswMPduGroupSwitch): BswMPduGroupSwitchReinit=false, BswMEnabledPduGroupRef=BODY_LE1_CANRx
          ActionBODY_LE1_CANRxOff
            BswMAvailableActions
              ActionBODY_LE1_CANRxOff (BswMPduGroupSwitch): BswMPduGroupSwitchReinit=false, BswMDisabledPduGroupRef=BODY_LE1_CANRx
          ActionReadAll_Core0
            BswMAvailableActions
              ActionReadAll_Core0 (BswMUserCallout): BswMUserCalloutFunction=BswM_NvMReadAllCallout_Core0()
          ActionWriteAll_Core0
            BswMAvailableActions
              ActionWriteAll_Core0 (BswMUserCallout): BswMUserCalloutFunction=BswM_NvMWriteAllCallout_Core0()
        15 x BswMActionList, all with BswMActionListPriority=0, UserDefine=false:
          BswM_ALInitBlockII_Core0: BswMActionListExecution=BSWM_CONDITION
            6 x BswMActionListItem, all with BswMAbortOnFail=false, BswMErrorIdEnable=false, UserDefine=false:
              ActionInitBlockII_Core0: BswMActionListItemIndex=0, BswMActionListItemRef=ActionInitBlockII_Core0
              ActionSetTimerWakeUpDelay_Core0: BswMActionListItemIndex=1, BswMActionListItemRef=ActionSetTimerWakeUpDelay_Core0
              ActionRequestWakeup_Core0: BswMActionListItemIndex=2, BswMActionListItemRef=ActionRequestWakeup_Core0
              ActionSetEcuMRun: BswMActionListItemIndex=3, BswMActionListItemRef=ActionSetEcuMRun
              ActionCom0Allow: BswMActionListItemIndex=4, BswMActionListItemRef=ActionCom0Allow
              ActionStartBswTask_Core0: BswMActionListItemIndex=5, BswMActionListItemRef=ActionStartBswTask_Core0
          BswM_ALWkupToReadNvM_Core0: BswMActionListExecution=BSWM_TRIGGER
            3 x BswMActionListItem, all with BswMAbortOnFail=false, BswMErrorIdEnable=false, UserDefine=false:
              ActionStopTimer_Core0: BswMActionListItemIndex=0, BswMActionListItemRef=ActionStopTimer_Core0
              ActionRequestReadNvM_Core0: BswMActionListItemIndex=1, BswMActionListItemRef=ActionRequestReadNvM_Core0
              ActionReadAll_Core0: BswMActionListItemIndex=2, BswMActionListItemRef=ActionReadAll_Core0
          BswM_ALReadNvMToRun_Core0: BswMActionListExecution=BSWM_TRIGGER
            5 x BswMActionListItem, all with BswMAbortOnFail=false, BswMErrorIdEnable=false, UserDefine=false:
              ActionPostReadAll_Core0: BswMActionListItemIndex=0, BswMActionListItemRef=ActionPostReadAll_Core0
              ActionSetTimerAppRunDelay_Core0: BswMActionListItemIndex=1, BswMActionListItemRef=ActionSetTimerAppRunDelay_Core0
              ActionRequestAppRun_Core0: BswMActionListItemIndex=2, BswMActionListItemRef=ActionRequestAppRun_Core0
              ActionSetEcuMAppRun: BswMActionListItemIndex=3, BswMActionListItemRef=ActionSetEcuMAppRun
              ActionRteStart_Core0: BswMActionListItemIndex=4, BswMActionListItemRef=ActionRteStart_Core0
          BswM_ALRunToPostRun_Core0: BswMActionListExecution=BSWM_TRIGGER
            ActionRequestAppPostRun_Core0 (BswMActionListItem): BswMAbortOnFail=false, BswMActionListItemIndex=0, BswMErrorIdEnable=false, UserDefine=false, BswMActionListItemRef=ActionRequestAppPostRun_Core0
            ActionSetEcuMAppPostRun (BswMActionListItem): BswMAbortOnFail=false, BswMActionListItemIndex=1, BswMErrorIdEnable=false, UserDefine=false, BswMActionListItemRef=ActionSetEcuMAppPostRun
          BswM_ALPostRunToRun_Core0: BswMActionListExecution=BSWM_TRIGGER
            3 x BswMActionListItem, all with BswMAbortOnFail=false, BswMErrorIdEnable=false, UserDefine=false:
              ActionSetTimerAppRunDelay_Core0: BswMActionListItemIndex=0, BswMActionListItemRef=ActionSetTimerAppRunDelay_Core0
              ActionSetEcuMAppRun: BswMActionListItemIndex=1, BswMActionListItemRef=ActionSetEcuMAppRun
              ActionRequestAppRun_Core0: BswMActionListItemIndex=2, BswMActionListItemRef=ActionRequestAppRun_Core0
          BswM_ALPrepToRun_Core0: BswMActionListExecution=BSWM_TRIGGER
            4 x BswMActionListItem, all with BswMAbortOnFail=false, BswMErrorIdEnable=false, UserDefine=false:
              ActionSetTimerAppRunDelay_Core0: BswMActionListItemIndex=0, BswMActionListItemRef=ActionSetTimerAppRunDelay_Core0
              ActionSetEcuMAppRun: BswMActionListItemIndex=1, BswMActionListItemRef=ActionSetEcuMAppRun
              ActionRequestAppRun_Core0: BswMActionListItemIndex=2, BswMActionListItemRef=ActionRequestAppRun_Core0
              ActionRteStart_Core0: BswMActionListItemIndex=3, BswMActionListItemRef=ActionRteStart_Core0
          BswM_ALPostRunToPrep_Core0: BswMActionListExecution=BSWM_TRIGGER
            3 x BswMActionListItem, all with BswMAbortOnFail=false, BswMErrorIdEnable=false, UserDefine=false:
              ActionRequestPrepareShutdown_Core0: BswMActionListItemIndex=0, BswMActionListItemRef=ActionRequestPrepareShutdown_Core0
              ActionPreShutdown_Core0: BswMActionListItemIndex=1, BswMActionListItemRef=ActionPreShutdown_Core0
              ActionRteStop_Core0: BswMActionListItemIndex=2, BswMActionListItemRef=ActionRteStop_Core0
          BswM_ALRunToPrep_Core0: BswMActionListExecution=BSWM_TRIGGER
            3 x BswMActionListItem, all with BswMAbortOnFail=false, BswMErrorIdEnable=false, UserDefine=false:
              ActionRequestPrepareShutdown_Core0: BswMActionListItemIndex=0, BswMActionListItemRef=ActionRequestPrepareShutdown_Core0
              ActionPreShutdown_Core0: BswMActionListItemIndex=1, BswMActionListItemRef=ActionPreShutdown_Core0
              ActionRteStop_Core0: BswMActionListItemIndex=2, BswMActionListItemRef=ActionRteStop_Core0
          BswM_ALPrepToWriteNvM_Core0: BswMActionListExecution=BSWM_TRIGGER
            ActionRequestWriteNvM_Core0 (BswMActionListItem): BswMAbortOnFail=false, BswMActionListItemIndex=0, BswMErrorIdEnable=false, UserDefine=false, BswMActionListItemRef=ActionRequestWriteNvM_Core0
            ActionWriteAll_Core0 (BswMActionListItem): BswMAbortOnFail=false, BswMActionListItemIndex=1, BswMErrorIdEnable=false, UserDefine=false, BswMActionListItemRef=ActionWriteAll_Core0
          BswM_ALWriteNvMToSleep_Core0: BswMActionListExecution=BSWM_TRIGGER
            4 x BswMActionListItem, all with BswMAbortOnFail=false, BswMErrorIdEnable=false, UserDefine=false:
              ActionSetEcuMSleep: BswMActionListItemIndex=0, BswMActionListItemRef=ActionSetEcuMSleep
              ActionRequestSleep_Core0: BswMActionListItemIndex=1, BswMActionListItemRef=ActionRequestSleep_Core0
              ActionClearWakeupEvent_Core0: BswMActionListItemIndex=2, BswMActionListItemRef=ActionClearWakeupEvent_Core0
              ActionWriteNvMToSleep_Core0: BswMActionListItemIndex=3, BswMActionListItemRef=ActionWriteNvMToSleep_Core0
          BswM_ALWkupToSleep_Core0: BswMActionListExecution=BSWM_TRIGGER
            4 x BswMActionListItem, all with BswMAbortOnFail=false, BswMErrorIdEnable=false, UserDefine=false:
              ActionSetEcuMSleep: BswMActionListItemIndex=0, BswMActionListItemRef=ActionSetEcuMSleep
              ActionRequestSleep_Core0: BswMActionListItemIndex=1, BswMActionListItemRef=ActionRequestSleep_Core0
              ActionClearWakeupEvent_Core0: BswMActionListItemIndex=2, BswMActionListItemRef=ActionClearWakeupEvent_Core0
              ActionWakeupToSleep_Core0: BswMActionListItemIndex=3, BswMActionListItemRef=ActionWakeupToSleep_Core0
          BswM_ALBODY_LE1_CANTxOff: BswMActionListExecution=BSWM_TRIGGER
            ActionBODY_LE1_CANTxOff (BswMActionListItem): BswMAbortOnFail=false, BswMActionListItemIndex=0, BswMErrorIdEnable=false, UserDefine=false, BswMActionListItemRef=ActionBODY_LE1_CANTxOff
          BswM_ALBODY_LE1_CANTxOn: BswMActionListExecution=BSWM_TRIGGER
            ActionBODY_LE1_CANTxOn (BswMActionListItem): BswMAbortOnFail=false, BswMActionListItemIndex=0, BswMErrorIdEnable=false, UserDefine=false, BswMActionListItemRef=ActionBODY_LE1_CANTxOn
          BswM_ALBODY_LE1_CANRxOff: BswMActionListExecution=BSWM_TRIGGER
            ActionBODY_LE1_CANRxOff (BswMActionListItem): BswMAbortOnFail=false, BswMActionListItemIndex=0, BswMErrorIdEnable=false, UserDefine=false, BswMActionListItemRef=ActionBODY_LE1_CANRxOff
          BswM_ALBODY_LE1_CANRxOn: BswMActionListExecution=BSWM_TRIGGER
            ActionBODY_LE1_CANRxOn (BswMActionListItem): BswMAbortOnFail=false, BswMActionListItemIndex=0, BswMErrorIdEnable=false, UserDefine=false, BswMActionListItemRef=ActionBODY_LE1_CANRxOn
    Cfg_P (BswMConfig): UserDefine=false
      BswMArbitration
        29 x BswMLogicalExpression, all with UserDefine=false:
          ExpInitBlockII_Core0: BswMLogicalOperator=BSWM_OR, direction=, BswMArgumentRef=SysStateInit_Core0
          ExpWkupToReadNvM_Core0: BswMLogicalOperator=BSWM_AND, direction=, BswMArgumentRef=SysStateWakeup_Core0, BswMArgumentRef=ExpReqToRun
          ExpReadNvMToRun_Core0: BswMLogicalOperator=BSWM_AND, direction=, BswMArgumentRef=SysStateReadNvM_Core0, BswMArgumentRef=ExpNvMReadAllFinished
          ExpReqToRun: BswMLogicalOperator=BSWM_OR, direction=, BswMArgumentRef=EcuMRequestRun, BswMArgumentRef=ComM0FullCom
          ExpPrepToRun_Core0: BswMLogicalOperator=BSWM_AND, direction=, BswMArgumentRef=ExpReqToRun, BswMArgumentRef=SysStatePrepareShutdown_Core0
          ExpWriteNvMToRun_Core0: BswMLogicalOperator=BSWM_AND, direction=, BswMArgumentRef=ExpReqToRun, BswMArgumentRef=SysStateWriteNvM_Core0
          ExpPostRunToRun_Core0: BswMLogicalOperator=BSWM_AND, direction=, BswMArgumentRef=EcuMRequestRun, BswMArgumentRef=SysStateAppPostRun_Core0
          ExpRunToPostRun_Core0: BswMLogicalOperator=BSWM_AND, direction=, BswMArgumentRef=EcuMRequestPostRun, BswMArgumentRef=ComM0NoCom, BswMArgumentRef=SysStateAppRun_Core0, BswMArgumentRef=TimerExpired0
          ExpPostRunToPrep_Core0: BswMLogicalOperator=BSWM_AND, direction=, BswMArgumentRef=EcuMRequestShutdown, BswMArgumentRef=ComM0NoCom, BswMArgumentRef=SysStateAppPostRun_Core0
          ExpRunToPrep_Core0: BswMLogicalOperator=BSWM_AND, direction=, BswMArgumentRef=EcuMRequestShutdown, BswMArgumentRef=ComM0NoCom, BswMArgumentRef=SysStateAppRun_Core0, BswMArgumentRef=TimerExpired0
          ExpPrepToWriteNvM_Core0: BswMLogicalOperator=BSWM_AND, direction=, BswMArgumentRef=EcuMRequestShutdown, BswMArgumentRef=ComM0NoCom, BswMArgumentRef=SysStatePrepareShutdown_Core0
          ExpWriteNvMToSleep_Core0: BswMLogicalOperator=BSWM_AND, direction=, BswMArgumentRef=EcuMRequestShutdown, BswMArgumentRef=ComM0NoCom, BswMArgumentRef=SysStateWriteNvM_Core0, BswMArgumentRef=ExpNvMWriteAllFinished
          ExpWkupToSleep_Core0: BswMLogicalOperator=BSWM_AND, direction=, BswMArgumentRef=EcuMRequestShutdown, BswMArgumentRef=ComM0NoCom, BswMArgumentRef=SysStateWakeup_Core0, BswMArgumentRef=TimerExpired0
          ExpCanSM0AllowRx: BswMLogicalOperator=BSWM_NOT, direction=, BswMArgumentRef=CanSM0NoCom
          ExpCanSM0StopTx: BswMLogicalOperator=BSWM_NOT, direction=, BswMArgumentRef=CanSM0FullCom
          ExpDcmReqComNoRxTx0: BswMLogicalOperator=BSWM_OR, direction=, BswMArgumentRef=DcmReqComNoRxTx0, BswMArgumentRef=DcmReqComNmNoRxTx0
          ExpDcmReqComNoRx0: BswMLogicalOperator=BSWM_OR, direction=, BswMArgumentRef=DcmReqComNoRxTx0, BswMArgumentRef=DcmReqComTxNoRx0, BswMArgumentRef=DcmReqComNmNoRxTx0, BswMArgumentRef=DcmReqComNmTxNoRx0
          ExpDcmReqComNoTx0: BswMLogicalOperator=BSWM_OR, direction=, BswMArgumentRef=DcmReqComNoRxTx0, BswMArgumentRef=DcmReqComRxNoTx0, BswMArgumentRef=DcmReqComNmNoRxTx0, BswMArgumentRef=DcmReqComNmRxNoTx0
          ExpDcmReqComRxTx0: BswMLogicalOperator=BSWM_OR, direction=, BswMArgumentRef=DcmReqComRxTx0, BswMArgumentRef=DcmReqComNmRxTx0
          ExpDcmReqComRx0: BswMLogicalOperator=BSWM_OR, direction=, BswMArgumentRef=DcmReqComRxTx0, BswMArgumentRef=DcmReqComRxNoTx0, BswMArgumentRef=DcmReqComNmRxTx0, BswMArgumentRef=DcmReqComNmRxNoTx0
          ExpDcmReqComTx0: BswMLogicalOperator=BSWM_OR, direction=, BswMArgumentRef=DcmReqComRxTx0, BswMArgumentRef=DcmReqComTxNoRx0, BswMArgumentRef=DcmReqComNmRxTx0, BswMArgumentRef=DcmReqComNmTxNoRx0
          ExpDcmReqComTxNoRx0: BswMLogicalOperator=BSWM_OR, direction=, BswMArgumentRef=DcmReqComTxNoRx0, BswMArgumentRef=DcmReqComNmTxNoRx0
          ExpDcmReqComRxNoTx0: BswMLogicalOperator=BSWM_OR, direction=, BswMArgumentRef=DcmReqComRxNoTx0, BswMArgumentRef=DcmReqComNmRxNoTx0
          ExpBODY_LE1_CANTxOn: BswMLogicalOperator=BSWM_AND, direction=Tx, BswMArgumentRef=ComM0FullCom, BswMArgumentRef=CanSM0FullCom, BswMArgumentRef=ExpDcmReqComTx0
          ExpBODY_LE1_CANTxOff: BswMLogicalOperator=BSWM_OR, direction=Tx, BswMArgumentRef=ComM0NoCom, BswMArgumentRef=ExpCanSM0StopTx, BswMArgumentRef=ExpDcmReqComNoTx0
          ExpBODY_LE1_CANRxOn: BswMLogicalOperator=BSWM_AND, direction=Rx, BswMArgumentRef=ComM0FullCom, BswMArgumentRef=ExpCanSM0AllowRx, BswMArgumentRef=ExpDcmReqComRx0
          ExpBODY_LE1_CANRxOff: BswMLogicalOperator=BSWM_OR, direction=Rx, BswMArgumentRef=ComM0NoCom, BswMArgumentRef=CanSM0NoCom, BswMArgumentRef=ExpDcmReqComNoRx0
          ExpNvMReadAllFinished: BswMLogicalOperator=BSWM_OR, direction=, BswMArgumentRef=NvMReadAllOK, BswMArgumentRef=NvMReadAllNotOK
          ExpNvMWriteAllFinished: BswMLogicalOperator=BSWM_OR, direction=, BswMArgumentRef=NvMWriteAllOK, BswMArgumentRef=NvMWriteAllNotOK
        28 x BswMModeCondition, all with BswMConditionType=BSWM_EQUALS, UserDefine=false:
          SysStateInit_Core0: BswMConditionMode=SysState_Core0
            BswMConditionValue
              BswMBswMode: RequestedModeSelect=, BswMBswRequestedMode=BSWM_GENERIC_MODE_INIT
          SysStateWakeup_Core0: BswMConditionMode=SysState_Core0
            BswMConditionValue
              BswMBswMode: RequestedModeSelect=, BswMBswRequestedMode=BSWM_GENERIC_MODE_WAKEUP
          SysStateReadNvM_Core0: BswMConditionMode=SysState_Core0
            BswMConditionValue
              BswMBswMode: RequestedModeSelect=, BswMBswRequestedMode=BSWM_GENERIC_MODE_READ_NVM
          SysStateAppRun_Core0: BswMConditionMode=SysState_Core0
            BswMConditionValue
              BswMBswMode: RequestedModeSelect=, BswMBswRequestedMode=BSWM_GENERIC_MODE_APP_RUN
          EcuMRequestRun: BswMConditionMode=EcuMRunRequest
            BswMConditionValue
              BswMBswMode: RequestedModeSelect=ECUM_STATE_APP_RUN, BswMBswRequestedMode=
          EcuMRequestPostRun: BswMConditionMode=EcuMRunRequest
            BswMConditionValue
              BswMBswMode: RequestedModeSelect=ECUM_STATE_APP_POST_RUN, BswMBswRequestedMode=
          EcuMRequestShutdown: BswMConditionMode=EcuMRunRequest
            BswMConditionValue
              BswMBswMode: RequestedModeSelect=ECUM_STATE_SHUTDOWN, BswMBswRequestedMode=
          CanSM0NoCom: BswMConditionMode=CanSM0Mode
            BswMConditionValue
              BswMBswMode: RequestedModeSelect=CANSM_BSWM_NO_COMMUNICATION, BswMBswRequestedMode=
          CanSM0FullCom: BswMConditionMode=CanSM0Mode
            BswMConditionValue
              BswMBswMode: RequestedModeSelect=CANSM_BSWM_FULL_COMMUNICATION, BswMBswRequestedMode=
          ComM0NoCom: BswMConditionMode=ComM0Mode
            BswMConditionValue
              BswMBswMode: RequestedModeSelect=COMM_NO_COMMUNICATION, BswMBswRequestedMode=
          ComM0FullCom: BswMConditionMode=ComM0Mode
            BswMConditionValue
              BswMBswMode: RequestedModeSelect=COMM_FULL_COMMUNICATION, BswMBswRequestedMode=
          SysStateAppPostRun_Core0: BswMConditionMode=SysState_Core0
            BswMConditionValue
              BswMBswMode: RequestedModeSelect=, BswMBswRequestedMode=BSWM_GENERIC_MODE_POST_RUN
          SysStatePrepareShutdown_Core0: BswMConditionMode=SysState_Core0
            BswMConditionValue
              BswMBswMode: RequestedModeSelect=, BswMBswRequestedMode=BSWM_GENERIC_MODE_PREP_SHUTDOWN
          SysStateWriteNvM_Core0: BswMConditionMode=SysState_Core0
            BswMConditionValue
              BswMBswMode: RequestedModeSelect=, BswMBswRequestedMode=BSWM_GENERIC_MODE_WRITE_NVM
          SysStateSleep_Core0: BswMConditionMode=SysState_Core0
            BswMConditionValue
              BswMBswMode: RequestedModeSelect=, BswMBswRequestedMode=BSWM_GENERIC_MODE_SLEEP
          TimerExpired0: BswMConditionMode=BswMTimer0
            BswMConditionValue
              BswMBswMode: RequestedModeSelect=BSWM_TIMER_EXPIRED, BswMBswRequestedMode=
          DcmReqComNoRxTx0: BswMConditionMode=DcmRequestCommunicationMode0
            BswMConditionValue
              BswMBswMode: RequestedModeSelect=DCM_DISABLE_RX_TX_NORMAL, BswMBswRequestedMode=
          DcmReqComRxTx0: BswMConditionMode=DcmRequestCommunicationMode0
            BswMConditionValue
              BswMBswMode: RequestedModeSelect=DCM_ENABLE_RX_TX_NORM, BswMBswRequestedMode=
          DcmReqComTxNoRx0: BswMConditionMode=DcmRequestCommunicationMode0
            BswMConditionValue
              BswMBswMode: RequestedModeSelect=DCM_DISABLE_RX_ENABLE_TX_NORM, BswMBswRequestedMode=
          DcmReqComRxNoTx0: BswMConditionMode=DcmRequestCommunicationMode0
            BswMConditionValue
              BswMBswMode: RequestedModeSelect=DCM_ENABLE_RX_DISABLE_TX_NORM, BswMBswRequestedMode=
          DcmReqComNmNoRxTx0: BswMConditionMode=DcmRequestCommunicationMode0
            BswMConditionValue
              BswMBswMode: RequestedModeSelect=DCM_DISABLE_RX_TX_NORM_NM, BswMBswRequestedMode=
          DcmReqComNmRxTx0: BswMConditionMode=DcmRequestCommunicationMode0
            BswMConditionValue
              BswMBswMode: RequestedModeSelect=DCM_ENABLE_RX_TX_NORM_NM, BswMBswRequestedMode=
          DcmReqComNmTxNoRx0: BswMConditionMode=DcmRequestCommunicationMode0
            BswMConditionValue
              BswMBswMode: RequestedModeSelect=DCM_DISABLE_RX_ENABLE_TX_NORM_NM, BswMBswRequestedMode=
          DcmReqComNmRxNoTx0: BswMConditionMode=DcmRequestCommunicationMode0
            BswMConditionValue
              BswMBswMode: RequestedModeSelect=DCM_ENABLE_RX_DISABLE_TX_NORM_NM, BswMBswRequestedMode=
          NvMReadAllOK: BswMConditionMode=NvMReadAllMode
            BswMConditionValue
              BswMBswMode: RequestedModeSelect=NVM_REQ_OK, BswMBswRequestedMode=
          NvMReadAllNotOK: BswMConditionMode=NvMReadAllMode
            BswMConditionValue
              BswMBswMode: RequestedModeSelect=NVM_REQ_NOT_OK, BswMBswRequestedMode=
          NvMWriteAllOK: BswMConditionMode=NvMWriteAllMode
            BswMConditionValue
              BswMBswMode: RequestedModeSelect=NVM_REQ_OK, BswMBswRequestedMode=
          NvMWriteAllNotOK: BswMConditionMode=NvMWriteAllMode
            BswMConditionValue
              BswMBswMode: RequestedModeSelect=NVM_REQ_NOT_OK, BswMBswRequestedMode=
        8 x BswMModeRequestPort, all with UserDefine=false:
          SysState_Core0: BswMRequestProcessing=BSWM_IMMEDIATE
            BswMModeRequestSource
              SysState_Core0 (BswMGenericRequest): BswMModeRequesterId=0, BswMModeRequesterLocatedInCoreID=0
            BswMModeInitValue
              BswMSwcModeInitValue: BswMSwcModeInitValueRef=BSWM_GENERIC_MODE_INIT
          EcuMRunRequest: BswMRequestProcessing=BSWM_DEFERRED
            BswMModeRequestSource
              EcuMRunRequest (BswMEcuMRUNRequestIndication): BswMEcuMRUNRequestProtocolPort=POST_RUN
            BswMModeInitValue
              BswMBswModeInitValue: InitValueSelect=ECUM_STATE_SHUTDOWN, BswMBswModeInitValueMode=
          CanSM0Mode: BswMRequestProcessing=BSWM_DEFERRED
            BswMModeRequestSource
              CanSM0Mode (BswMCanSMIndication): BswMCanSMChannelRef=CanSM_BODY_LE1_CAN
            BswMModeInitValue
              BswMBswModeInitValue: InitValueSelect=CANSM_BSWM_NO_COMMUNICATION, BswMBswModeInitValueMode=
          ComM0Mode: BswMRequestProcessing=BSWM_DEFERRED
            BswMModeRequestSource
              ComM0Mode (BswMComMIndication): BswMComMChannelRef=ComM_BODY_LE1_CAN
            BswMModeInitValue
              BswMBswModeInitValue: InitValueSelect=COMM_NO_COMMUNICATION, BswMBswModeInitValueMode=
          BswMTimer0: BswMRequestProcessing=BSWM_DEFERRED
            BswMModeRequestSource
              BswMTimer0 (BswMTimer): BswMTimerLocatedInCoreID=0
            BswMModeInitValue
              BswMBswModeInitValue: InitValueSelect=BSWM_TIMER_STOPPED, BswMBswModeInitValueMode=
          DcmRequestCommunicationMode0: BswMRequestProcessing=BSWM_DEFERRED
            BswMModeRequestSource
              DcmRequestCommunicationMode0 (BswMDcmComModeRequest): BswMDcmComMChannelRef=ComM_BODY_LE1_CAN
            BswMModeInitValue
              BswMBswModeInitValue: InitValueSelect=DCM_ENABLE_RX_TX_NORM_NM, BswMBswModeInitValueMode=
          NvMReadAllMode: BswMRequestProcessing=BSWM_IMMEDIATE
            BswMModeRequestSource
              NvMReadAllMode (BswMNvMJobModeIndication): BswMNvmService=NvmReadAll
            BswMModeInitValue
              BswMBswModeInitValue: InitValueSelect=NVM_REQ_PENDING, BswMBswModeInitValueMode=
          NvMWriteAllMode: BswMRequestProcessing=BSWM_IMMEDIATE
            BswMModeRequestSource
              NvMWriteAllMode (BswMNvMJobModeIndication): BswMNvmService=NvmWriteAll
            BswMModeInitValue
              BswMBswModeInitValue: InitValueSelect=NVM_REQ_PENDING, BswMBswModeInitValueMode=
        16 x BswMRule, all with BswMNestedExecutionOnly=false, BswMRuleInitState=BSWM_FALSE, BswMRuleLocatedInCoreID=BSWM_CORE_0, UserDefine=false:
          BswM_RuleInitBlockII_Core0: BswMRuleExpressionRef=ExpInitBlockII_Core0, BswMRuleTrueActionList=BswM_ALInitBlockII_Core0
          BswM_RuleWkupToReadNvM_Core0: BswMRuleExpressionRef=ExpWkupToReadNvM_Core0, BswMRuleTrueActionList=BswM_ALWkupToReadNvM_Core0
          BswM_RuleReadNvMToRun_Core0: BswMRuleExpressionRef=ExpReadNvMToRun_Core0, BswMRuleTrueActionList=BswM_ALReadNvMToRun_Core0
          BswM_RuleRunToPostRun_Core0: BswMRuleExpressionRef=ExpRunToPostRun_Core0, BswMRuleTrueActionList=BswM_ALRunToPostRun_Core0
          BswM_RulePostRunToRun_Core0: BswMRuleExpressionRef=ExpPostRunToRun_Core0, BswMRuleTrueActionList=BswM_ALPostRunToRun_Core0
          BswM_RulePostRunToPrep_Core0: BswMRuleExpressionRef=ExpPostRunToPrep_Core0, BswMRuleTrueActionList=BswM_ALPostRunToPrep_Core0
          BswM_RuleRunToPrep_Core0: BswMRuleExpressionRef=ExpRunToPrep_Core0, BswMRuleTrueActionList=BswM_ALRunToPrep_Core0
          BswM_RulePrepToRun_Core0: BswMRuleExpressionRef=ExpPrepToRun_Core0, BswMRuleTrueActionList=BswM_ALPrepToRun_Core0
          BswM_RulePrepToWriteNvM_Core0: BswMRuleExpressionRef=ExpPrepToWriteNvM_Core0, BswMRuleTrueActionList=BswM_ALPrepToWriteNvM_Core0
          BswM_RuleWriteNvMToRun_Core0: BswMRuleExpressionRef=ExpWriteNvMToRun_Core0, BswMRuleTrueActionList=BswM_ALPrepToRun_Core0
          BswM_RuleWriteNvMToSleep_Core0: BswMRuleExpressionRef=ExpWriteNvMToSleep_Core0, BswMRuleTrueActionList=BswM_ALWriteNvMToSleep_Core0
          BswM_RuleWkupToSleep_Core0: BswMRuleExpressionRef=ExpWkupToSleep_Core0, BswMRuleTrueActionList=BswM_ALWkupToSleep_Core0
          BswM_RuleBODY_LE1_CANTxOn: BswMRuleExpressionRef=ExpBODY_LE1_CANTxOn, BswMRuleTrueActionList=BswM_ALBODY_LE1_CANTxOn
          BswM_RuleBODY_LE1_CANTxOff: BswMRuleExpressionRef=ExpBODY_LE1_CANTxOff, BswMRuleTrueActionList=BswM_ALBODY_LE1_CANTxOff
          BswM_RuleBODY_LE1_CANRxOn: BswMRuleExpressionRef=ExpBODY_LE1_CANRxOn, BswMRuleTrueActionList=BswM_ALBODY_LE1_CANRxOn
          BswM_RuleBODY_LE1_CANRxOff: BswMRuleExpressionRef=ExpBODY_LE1_CANRxOff, BswMRuleTrueActionList=BswM_ALBODY_LE1_CANRxOff
      BswMModeControl
        30 x BswMAction, all with UserDefine=false:
          ActionInitBlockII_Core0
            BswMAvailableActions
              ActionInitBlockII_Core0 (BswMUserCallout): BswMUserCalloutFunction=BswM_InitBlockIICallout_Core0()
          ActionStartBswTask_Core0
            BswMAvailableActions
              ActionStartBswTask_Core0 (BswMUserCallout): BswMUserCalloutFunction=BswM_StartBswTaskCallout_Core0()
          ActionPostReadAll_Core0
            BswMAvailableActions
              ActionPostReadAll_Core0 (BswMUserCallout): BswMUserCalloutFunction=BswM_PostReadAllCallout_Core0()
          ActionCom0Allow
            BswMAvailableActions
              ActionCom0Allow (BswMComMAllowCom): BswMComAllowed=true, BswMComMAllowChannelRef=ComM_BODY_LE1_CAN
          ActionRteStart_Core0
            BswMAvailableActions
              ActionRteStart_Core0 (BswMRteStart)
          ActionRequestWakeup_Core0
            BswMAvailableActions
              ActionRequestWakeup_Core0 (BswMGenericRequest): BswMRequestedMode=BSWM_GENERIC_MODE_WAKEUP, BswMModeRequestPort=SysState_Core0
          ActionRequestReadNvM_Core0
            BswMAvailableActions
              ActionRequestReadNvM_Core0 (BswMGenericRequest): BswMRequestedMode=BSWM_GENERIC_MODE_READ_NVM, BswMModeRequestPort=SysState_Core0
          ActionRequestAppRun_Core0
            BswMAvailableActions
              ActionRequestAppRun_Core0 (BswMGenericRequest): BswMRequestedMode=BSWM_GENERIC_MODE_APP_RUN, BswMModeRequestPort=SysState_Core0
          ActionSetEcuMRun
            BswMAvailableActions
              ActionSetEcuMRun (BswMEcuMStateSwitch): BswMEcuMState=RUN
          ActionSetEcuMAppRun
            BswMAvailableActions
              ActionSetEcuMAppRun (BswMEcuMStateSwitch): BswMEcuMState=APP_RUN
          ActionPreShutdown_Core0
            BswMAvailableActions
              ActionPreShutdown_Core0 (BswMUserCallout): BswMUserCalloutFunction=BswM_PreShutdownCallout_Core0()
          ActionWakeupToSleep_Core0
            BswMAvailableActions
              ActionWakeupToSleep_Core0 (BswMUserCallout): BswMUserCalloutFunction=BswM_WakeupToSleepCallout_Core0()
          ActionWriteNvMToSleep_Core0
            BswMAvailableActions
              ActionWriteNvMToSleep_Core0 (BswMUserCallout): BswMUserCalloutFunction=BswM_WriteNvMToSleepCallout_Core0()
          ActionClearWakeupEvent_Core0
            BswMAvailableActions
              ActionClearWakeupEvent_Core0 (BswMUserCallout): BswMUserCalloutFunction=BswM_ClearWakeupEventCallout_Core0()
          ActionRteStop_Core0
            BswMAvailableActions
              ActionRteStop_Core0 (BswMRteStop)
          ActionRequestAppPostRun_Core0
            BswMAvailableActions
              ActionRequestAppPostRun_Core0 (BswMGenericRequest): BswMRequestedMode=BSWM_GENERIC_MODE_POST_RUN, BswMModeRequestPort=SysState_Core0
          ActionRequestPrepareShutdown_Core0
            BswMAvailableActions
              ActionRequestPrepareShutdown_Core0 (BswMGenericRequest): BswMRequestedMode=BSWM_GENERIC_MODE_PREP_SHUTDOWN, BswMModeRequestPort=SysState_Core0
          ActionRequestWriteNvM_Core0
            BswMAvailableActions
              ActionRequestWriteNvM_Core0 (BswMGenericRequest): BswMRequestedMode=BSWM_GENERIC_MODE_WRITE_NVM, BswMModeRequestPort=SysState_Core0
          ActionRequestSleep_Core0
            BswMAvailableActions
              ActionRequestSleep_Core0 (BswMGenericRequest): BswMRequestedMode=BSWM_GENERIC_MODE_SLEEP, BswMModeRequestPort=SysState_Core0
          ActionSetTimerAppRunDelay_Core0
            BswMAvailableActions
              ActionSetTimerAppRunDelay_Core0 (BswMSetTimer): BswMTimerAction=BSWM_TIMER_START, BswMTimerValue=10, BswMTimerRef=BswMTimer0
          ActionSetTimerWakeUpDelay_Core0
            BswMAvailableActions
              ActionSetTimerWakeUpDelay_Core0 (BswMSetTimer): BswMTimerAction=BSWM_TIMER_START, BswMTimerValue=0, BswMTimerRef=BswMTimer0
          ActionStopTimer_Core0
            BswMAvailableActions
              ActionStopTimer_Core0 (BswMSetTimer): BswMTimerAction=BSWM_TIMER_STOP, BswMTimerValue=0, BswMTimerRef=BswMTimer0
          ActionSetEcuMAppPostRun
            BswMAvailableActions
              ActionSetEcuMAppPostRun (BswMEcuMStateSwitch): BswMEcuMState=APP_POST_RUN
          ActionSetEcuMSleep
            BswMAvailableActions
              ActionSetEcuMSleep (BswMEcuMStateSwitch): BswMEcuMState=SLEEP
          ActionBODY_LE1_CANTxOn
            BswMAvailableActions
              ActionBODY_LE1_CANTxOn (BswMPduGroupSwitch): BswMPduGroupSwitchReinit=false, BswMEnabledPduGroupRef=BODY_LE1_CANTx
          ActionBODY_LE1_CANTxOff
            BswMAvailableActions
              ActionBODY_LE1_CANTxOff (BswMPduGroupSwitch): BswMPduGroupSwitchReinit=false, BswMDisabledPduGroupRef=BODY_LE1_CANTx
          ActionBODY_LE1_CANRxOn
            BswMAvailableActions
              ActionBODY_LE1_CANRxOn (BswMPduGroupSwitch): BswMPduGroupSwitchReinit=false, BswMEnabledPduGroupRef=BODY_LE1_CANRx
          ActionBODY_LE1_CANRxOff
            BswMAvailableActions
              ActionBODY_LE1_CANRxOff (BswMPduGroupSwitch): BswMPduGroupSwitchReinit=false, BswMDisabledPduGroupRef=BODY_LE1_CANRx
          ActionReadAll_Core0
            BswMAvailableActions
              ActionReadAll_Core0 (BswMUserCallout): BswMUserCalloutFunction=BswM_NvMReadAllCallout_Core0()
          ActionWriteAll_Core0
            BswMAvailableActions
              ActionWriteAll_Core0 (BswMUserCallout): BswMUserCalloutFunction=BswM_NvMWriteAllCallout_Core0()
        15 x BswMActionList, all with BswMActionListPriority=0, UserDefine=false:
          BswM_ALInitBlockII_Core0: BswMActionListExecution=BSWM_CONDITION
            6 x BswMActionListItem, all with BswMAbortOnFail=false, BswMErrorIdEnable=false, UserDefine=false:
              ActionInitBlockII_Core0: BswMActionListItemIndex=0, BswMActionListItemRef=ActionInitBlockII_Core0
              ActionSetTimerWakeUpDelay_Core0: BswMActionListItemIndex=1, BswMActionListItemRef=ActionSetTimerWakeUpDelay_Core0
              ActionRequestWakeup_Core0: BswMActionListItemIndex=2, BswMActionListItemRef=ActionRequestWakeup_Core0
              ActionSetEcuMRun: BswMActionListItemIndex=3, BswMActionListItemRef=ActionSetEcuMRun
              ActionCom0Allow: BswMActionListItemIndex=4, BswMActionListItemRef=ActionCom0Allow
              ActionStartBswTask_Core0: BswMActionListItemIndex=5, BswMActionListItemRef=ActionStartBswTask_Core0
          BswM_ALWkupToReadNvM_Core0: BswMActionListExecution=BSWM_TRIGGER
            3 x BswMActionListItem, all with BswMAbortOnFail=false, BswMErrorIdEnable=false, UserDefine=false:
              ActionStopTimer_Core0: BswMActionListItemIndex=0, BswMActionListItemRef=ActionStopTimer_Core0
              ActionRequestReadNvM_Core0: BswMActionListItemIndex=1, BswMActionListItemRef=ActionRequestReadNvM_Core0
              ActionReadAll_Core0: BswMActionListItemIndex=2, BswMActionListItemRef=ActionReadAll_Core0
          BswM_ALReadNvMToRun_Core0: BswMActionListExecution=BSWM_TRIGGER
            5 x BswMActionListItem, all with BswMAbortOnFail=false, BswMErrorIdEnable=false, UserDefine=false:
              ActionPostReadAll_Core0: BswMActionListItemIndex=0, BswMActionListItemRef=ActionPostReadAll_Core0
              ActionSetTimerAppRunDelay_Core0: BswMActionListItemIndex=1, BswMActionListItemRef=ActionSetTimerAppRunDelay_Core0
              ActionRequestAppRun_Core0: BswMActionListItemIndex=2, BswMActionListItemRef=ActionRequestAppRun_Core0
              ActionSetEcuMAppRun: BswMActionListItemIndex=3, BswMActionListItemRef=ActionSetEcuMAppRun
              ActionRteStart_Core0: BswMActionListItemIndex=4, BswMActionListItemRef=ActionRteStart_Core0
          BswM_ALRunToPostRun_Core0: BswMActionListExecution=BSWM_TRIGGER
            ActionRequestAppPostRun_Core0 (BswMActionListItem): BswMAbortOnFail=false, BswMActionListItemIndex=0, BswMErrorIdEnable=false, UserDefine=false, BswMActionListItemRef=ActionRequestAppPostRun_Core0
            ActionSetEcuMAppPostRun (BswMActionListItem): BswMAbortOnFail=false, BswMActionListItemIndex=1, BswMErrorIdEnable=false, UserDefine=false, BswMActionListItemRef=ActionSetEcuMAppPostRun
          BswM_ALPostRunToRun_Core0: BswMActionListExecution=BSWM_TRIGGER
            3 x BswMActionListItem, all with BswMAbortOnFail=false, BswMErrorIdEnable=false, UserDefine=false:
              ActionSetTimerAppRunDelay_Core0: BswMActionListItemIndex=0, BswMActionListItemRef=ActionSetTimerAppRunDelay_Core0
              ActionSetEcuMAppRun: BswMActionListItemIndex=1, BswMActionListItemRef=ActionSetEcuMAppRun
              ActionRequestAppRun_Core0: BswMActionListItemIndex=2, BswMActionListItemRef=ActionRequestAppRun_Core0
          BswM_ALPrepToRun_Core0: BswMActionListExecution=BSWM_TRIGGER
            4 x BswMActionListItem, all with BswMAbortOnFail=false, BswMErrorIdEnable=false, UserDefine=false:
              ActionSetTimerAppRunDelay_Core0: BswMActionListItemIndex=0, BswMActionListItemRef=ActionSetTimerAppRunDelay_Core0
              ActionSetEcuMAppRun: BswMActionListItemIndex=1, BswMActionListItemRef=ActionSetEcuMAppRun
              ActionRequestAppRun_Core0: BswMActionListItemIndex=2, BswMActionListItemRef=ActionRequestAppRun_Core0
              ActionRteStart_Core0: BswMActionListItemIndex=3, BswMActionListItemRef=ActionRteStart_Core0
          BswM_ALPostRunToPrep_Core0: BswMActionListExecution=BSWM_TRIGGER
            3 x BswMActionListItem, all with BswMAbortOnFail=false, BswMErrorIdEnable=false, UserDefine=false:
              ActionRequestPrepareShutdown_Core0: BswMActionListItemIndex=0, BswMActionListItemRef=ActionRequestPrepareShutdown_Core0
              ActionPreShutdown_Core0: BswMActionListItemIndex=1, BswMActionListItemRef=ActionPreShutdown_Core0
              ActionRteStop_Core0: BswMActionListItemIndex=2, BswMActionListItemRef=ActionRteStop_Core0
          BswM_ALRunToPrep_Core0: BswMActionListExecution=BSWM_TRIGGER
            3 x BswMActionListItem, all with BswMAbortOnFail=false, BswMErrorIdEnable=false, UserDefine=false:
              ActionRequestPrepareShutdown_Core0: BswMActionListItemIndex=0, BswMActionListItemRef=ActionRequestPrepareShutdown_Core0
              ActionPreShutdown_Core0: BswMActionListItemIndex=1, BswMActionListItemRef=ActionPreShutdown_Core0
              ActionRteStop_Core0: BswMActionListItemIndex=2, BswMActionListItemRef=ActionRteStop_Core0
          BswM_ALPrepToWriteNvM_Core0: BswMActionListExecution=BSWM_TRIGGER
            ActionRequestWriteNvM_Core0 (BswMActionListItem): BswMAbortOnFail=false, BswMActionListItemIndex=0, BswMErrorIdEnable=false, UserDefine=false, BswMActionListItemRef=ActionRequestWriteNvM_Core0
            ActionWriteAll_Core0 (BswMActionListItem): BswMAbortOnFail=false, BswMActionListItemIndex=1, BswMErrorIdEnable=false, UserDefine=false, BswMActionListItemRef=ActionWriteAll_Core0
          BswM_ALWriteNvMToSleep_Core0: BswMActionListExecution=BSWM_TRIGGER
            4 x BswMActionListItem, all with BswMAbortOnFail=false, BswMErrorIdEnable=false, UserDefine=false:
              ActionSetEcuMSleep: BswMActionListItemIndex=0, BswMActionListItemRef=ActionSetEcuMSleep
              ActionRequestSleep_Core0: BswMActionListItemIndex=1, BswMActionListItemRef=ActionRequestSleep_Core0
              ActionClearWakeupEvent_Core0: BswMActionListItemIndex=2, BswMActionListItemRef=ActionClearWakeupEvent_Core0
              ActionWriteNvMToSleep_Core0: BswMActionListItemIndex=3, BswMActionListItemRef=ActionWriteNvMToSleep_Core0
          BswM_ALWkupToSleep_Core0: BswMActionListExecution=BSWM_TRIGGER
            4 x BswMActionListItem, all with BswMAbortOnFail=false, BswMErrorIdEnable=false, UserDefine=false:
              ActionSetEcuMSleep: BswMActionListItemIndex=0, BswMActionListItemRef=ActionSetEcuMSleep
              ActionRequestSleep_Core0: BswMActionListItemIndex=1, BswMActionListItemRef=ActionRequestSleep_Core0
              ActionClearWakeupEvent_Core0: BswMActionListItemIndex=2, BswMActionListItemRef=ActionClearWakeupEvent_Core0
              ActionWakeupToSleep_Core0: BswMActionListItemIndex=3, BswMActionListItemRef=ActionWakeupToSleep_Core0
          BswM_ALBODY_LE1_CANTxOff: BswMActionListExecution=BSWM_TRIGGER
            ActionBODY_LE1_CANTxOff (BswMActionListItem): BswMAbortOnFail=false, BswMActionListItemIndex=0, BswMErrorIdEnable=false, UserDefine=false, BswMActionListItemRef=ActionBODY_LE1_CANTxOff
          BswM_ALBODY_LE1_CANTxOn: BswMActionListExecution=BSWM_TRIGGER
            ActionBODY_LE1_CANTxOn (BswMActionListItem): BswMAbortOnFail=false, BswMActionListItemIndex=0, BswMErrorIdEnable=false, UserDefine=false, BswMActionListItemRef=ActionBODY_LE1_CANTxOn
          BswM_ALBODY_LE1_CANRxOff: BswMActionListExecution=BSWM_TRIGGER
            ActionBODY_LE1_CANRxOff (BswMActionListItem): BswMAbortOnFail=false, BswMActionListItemIndex=0, BswMErrorIdEnable=false, UserDefine=false, BswMActionListItemRef=ActionBODY_LE1_CANRxOff
          BswM_ALBODY_LE1_CANRxOn: BswMActionListExecution=BSWM_TRIGGER
            ActionBODY_LE1_CANRxOn (BswMActionListItem): BswMAbortOnFail=false, BswMActionListItemIndex=0, BswMErrorIdEnable=false, UserDefine=false, BswMActionListItemRef=ActionBODY_LE1_CANRxOn
  module config CanIf: implementation-config-variant=STD_CONFIG_VARIANTS_POSTBUILD, module_version_def=4.2.0, module_autosar_version=Ar470
    CanIfPublicCfg:
      CanIfSetBaudrateApi = false
      CanIfPublicDevErrorDetect = false
      CanIfPublicMultipleDrvSupport = false
      CanIfPublicPnSupport = false
      CanIfPublicTxBuffering = false
      CanIfPublicSetDynamicTxIdApi = false
      CanIfPublicReadTxPduNotifyStatusApi = false
      CanIfPublicReadRxPduNotifyStatusApi = false
      CanIfPublicReadRxPduDataApi = false
      CanIfPublicVersionInfoApi = true
      CanIfPublicTxConfirmPollingSupport = true
      CanIfPublicWakeupCheckValidByNM = false
      CanIfPublicWakeupCheckValidByOsekNM = false
      CanIfPublicWakeupCheckValidSupport = false
      CanIfPublicWakeupCheckValidByCallout = false
      CanIfPublicIcomSupport = false
      CanIfMetaDataSupport = false
      CanIfTriggerTransmitSupport = false
      CanIfTxOfflineActiveSupport = false
      CanIfWakeupSupport = false
      CanIfPublicCddHeaderFile = 
      CanIfGenerate32BitsCanId = true
      BusMirroring = false
      CanIfPublicWakeupCheckValidByPnNm = false
      CanIfCanVersionNewerThan422 = true
    CanIfDispatchCfg:
      CanIfDispatchUserCheckTrcvWakeFlagIndicationUL = CANIF_DISPATCH_UL_CDD
      CanIfDispatchUserCheckTrcvWakeFlagIndicationName = 
      CanIfDispatchUserClearTrcvWufFlagIndicationUL = CANIF_DISPATCH_UL_CDD
      CanIfDispatchUserClearTrcvWufFlagIndicationName = 
      CanIfDispatchUserConfirmPnAvailabilityUL = CANIF_DISPATCH_UL_CDD
      CanIfDispatchUserConfirmPnAvailabilityName = 
      CanIfDispatchUserCtrlBusOffUL = CANIF_DISPATCH_UL_CAN_SM
      CanIfDispatchUserCtrlBusOffName = CanSM_ControllerBusOff
      CanIfDispatchUserCtrlModeIndicationUL = CANIF_DISPATCH_UL_CAN_SM
      CanIfDispatchUserCtrlModeIndicationName = CanSM_ControllerModeIndication
      CanIfDispatchUserTrcvModeIndicationUL = CANIF_DISPATCH_UL_CAN_SM
      CanIfDispatchUserTrcvModeIndicationName = CanSM_TransceiverModeIndication
      CanIfDispatchUserValidateWakeupEventUL = CANIF_DISPATCH_UL_CAN_ECUM
      CanIfDispatchUserValidateWakeupEventName = EcuM_ValidateWakeupEvent
      CanIfDispatchUserCurrentIComUL = CANIF_DISPATCH_UL_CAN_SM
      CanIfDispatchUserCurrentIComName = CanSM_CurrentIcomConfiguration
    CanIfPrivateCfg:
      VersionCheck = true
      CanIfPrivateDataLengthCheck = true
      CanIfDlcCheckType = CANIF_DLC_CHECK_AUTOSAR
      CanIfPrivateSoftwareFilterType = CANIF_FILTER_TYPE_INDEX
      CanIfHohOptimze = false
      CanIfSupportTTCAN = false
      CanIfSupportCanIDExtension = true
      CanIfFixedBuffer = true
      CanIfCanFdSupport = true
      CanIfPrivateTxSwFifoSupport = false
      CanIfPrivateTxSwFifoDebug = false
      CanIfPrivateTxSwFifoMainFunction = false
      CanIfPrivateRxPnSupport = false
      CanIfPrivateTxSwFifoTimeout = 20
      CanIfPrivateTxSwFifoMainFunctionPeriodTime = 10
    Cfg_D (CanIfInitCfg): UserDefine=false
      InitHohCfg (CanIfInitHohCfg): CanIfInitRefCfgSet=CanConfigSet
        7 x CanIfHthCfg, all with CanIfHthCanCtrlIdRef=CanIf_BODY_LE1_CAN, CanIfHthFifoDepth=0, CanIfHthMaxdlc=8:
          HOH15_DIAG_RESP_MCM_D_6A3_MCMP_6A4: CanIfHthIdSymRef=HOH15_DIAG_RESP_MCM_D_6A3_MCMP_6A4
          HOH16_MCM_D_1B6_MCM_P_1B7: CanIfHthIdSymRef=HOH16_MCM_D_1B6_MCM_P_1B7
          HOH17_MCM_D_1DF_MCM_P_1E2: CanIfHthIdSymRef=HOH17_MCM_D_1DF_MCM_P_1E2
          HOH18_MCM_D_1E0_MCM_P_1E3: CanIfHthIdSymRef=HOH18_MCM_D_1E0_MCM_P_1E3
          HOH19_MCM_D_1E1_MCM_P_1E4: CanIfHthIdSymRef=HOH19_MCM_D_1E1_MCM_P_1E4
          HOH20_MCM_D_1E8_MCM_P_1EB: CanIfHthIdSymRef=HOH20_MCM_D_1E8_MCM_P_1EB
          HOH21_MCM_D_1EC_MCM_P_1ED: CanIfHthIdSymRef=HOH21_MCM_D_1EC_MCM_P_1ED
        13 x CanIfHrhCfg, all with CanIfHohCanCtrlIdRef=CanIf_BODY_LE1_CAN:
          HOH0_BCU_11E: CanIfHrhIdSymRef=HOH0_BCU_11E
          HOH2_DIAG_REQ_AllECU: CanIfHrhIdSymRef=HOH2_DIAG_REQ_AllECU
          HOH3_DIAG_REQ_MCMD_623_MCMP_624: CanIfHrhIdSymRef=HOH3_DIAG_REQ_MCMD_623_MCMP_624
          HOH4_VC_Data_5E0: CanIfHrhIdSymRef=HOH4_VC_Data_5E0
          HOH5_ZONE_13C: CanIfHrhIdSymRef=HOH5_ZONE_13C
          HOH6_ZONE_MCMD_1C9_MCMP_1CF: CanIfHrhIdSymRef=HOH6_ZONE_MCMD_1C9_MCMP_1CF
          HOH7_ZONE_2EF: CanIfHrhIdSymRef=HOH7_ZONE_2EF
          HOH8_ZONE_3A9: CanIfHrhIdSymRef=HOH8_ZONE_3A9
          HOH9_ZONE_3B2: CanIfHrhIdSymRef=HOH9_ZONE_3B2
          HOH10_MCMD_Zone_FL_MCM_01_1D1_MCMP_Zone_FL_MCM_03_1D3: CanIfHrhIdSymRef=HOH10_MCMD_Zone_FL_MCM_01_1D1_MCMP_Zone_FL_MCM_03_1D3
          HOH11_MCMD_Zone_FL_MCM_02_1D2_MCMP_Zone_FL_MCM_04_1D4: CanIfHrhIdSymRef=HOH11_MCMD_Zone_FL_MCM_02_1D2_MCMP_Zone_FL_MCM_04_1D4
          HOH12_MCMD_ZONE_MCM_05_1B4_MCMP_ZONE_MCM_06_1B5: CanIfHrhIdSymRef=HOH12_MCMD_ZONE_MCM_05_1B4_MCMP_ZONE_MCM_06_1B5
          HOH13_ZONE_PNC: CanIfHrhIdSymRef=HOH13_ZONE_PNC
      7 x CanIfTxPduCfg, all with CanIfTxPduCanIdType=STANDARD_NO_FD_CAN, CanIfPduDlc=8, CanIfTxPduPnFilterPdu=false, CanIfTxPduReadNotifyStatus=false, CanIfTxPduType=STATIC, CanIfTxPduTriggerTransmit=false, CanIfTxPduUserTriggerTransmitName=NULL_PTR, CanIfTxPduCanIdMask=0x1FFFFFFF, CanIfTxPduTruncation=true, UserDefine=false, NetworkName=BODY_LE1_CAN:
        Cfg_D_Tx_BODY_LE1_CAN_MCM_D_1B6: CanIfPduCanId=0x1b6, CanIfTxPduUserTxConfirmationUL=PDUR, CanIfTxPduUserTxConfirmationName=PduR_LoIfTxConfirmation, uplayerPduRef=Cfg_D_Tx_BODY_LE1_CAN_MCM_D_1B6, CanIfTxPduBufferRef=Buffer_HOH16_MCM_D_1B6_MCM_P_1B7
        Cfg_D_Tx_BODY_LE1_CAN_MCM_D_1DF: CanIfPduCanId=0x1df, CanIfTxPduUserTxConfirmationUL=PDUR, CanIfTxPduUserTxConfirmationName=PduR_LoIfTxConfirmation, uplayerPduRef=Cfg_D_Tx_BODY_LE1_CAN_MCM_D_1DF, CanIfTxPduBufferRef=Buffer_HOH17_MCM_D_1DF_MCM_P_1E2
        Cfg_D_Tx_BODY_LE1_CAN_MCM_D_1E0: CanIfPduCanId=0x1e0, CanIfTxPduUserTxConfirmationUL=PDUR, CanIfTxPduUserTxConfirmationName=PduR_LoIfTxConfirmation, uplayerPduRef=Cfg_D_Tx_BODY_LE1_CAN_MCM_D_1E0, CanIfTxPduBufferRef=Buffer_HOH18_MCM_D_1E0_MCM_P_1E3
        Cfg_D_Tx_BODY_LE1_CAN_MCM_D_1E1: CanIfPduCanId=0x1e1, CanIfTxPduUserTxConfirmationUL=PDUR, CanIfTxPduUserTxConfirmationName=PduR_LoIfTxConfirmation, uplayerPduRef=Cfg_D_Tx_BODY_LE1_CAN_MCM_D_1E1, CanIfTxPduBufferRef=Buffer_HOH19_MCM_D_1E1_MCM_P_1E4
        Cfg_D_Tx_BODY_LE1_CAN_MCM_D_1E8: CanIfPduCanId=0x1e8, CanIfTxPduUserTxConfirmationUL=PDUR, CanIfTxPduUserTxConfirmationName=PduR_LoIfTxConfirmation, uplayerPduRef=Cfg_D_Tx_BODY_LE1_CAN_MCM_D_1E8, CanIfTxPduBufferRef=Buffer_HOH20_MCM_D_1E8_MCM_P_1EB
        Cfg_D_Tx_BODY_LE1_CAN_MCM_D_1EC: CanIfPduCanId=0x1ec, CanIfTxPduUserTxConfirmationUL=PDUR, CanIfTxPduUserTxConfirmationName=PduR_LoIfTxConfirmation, uplayerPduRef=Cfg_D_Tx_BODY_LE1_CAN_MCM_D_1EC, CanIfTxPduBufferRef=Buffer_HOH21_MCM_D_1EC_MCM_P_1ED
        Cfg_D_Tx_BODY_LE1_CAN_DIAG_RESP_MCM_D: CanIfPduCanId=0x6a3, CanIfTxPduUserTxConfirmationUL=CAN_TP, CanIfTxPduUserTxConfirmationName=CanTp_TxConfirmation, uplayerPduRef=Cfg_D_Tx_BODY_LE1_CAN_DIAG_RESP_MCM_D, CanIfTxPduBufferRef=Buffer_HOH15_DIAG_RESP_MCM_D_6A3_MCMP_6A4
      13 x CanIfRxPduCfg, all with CanIfRxPduCanIdType=STANDARD_NO_FD_CAN, CanIfPduDlc=8, CanIfRxPduReadData=false, CanIfRxPduDataLengthCheck=false, CanIfRxPduReadNotifyStatus=false, CanIfRxPduCanIdMask=0x1FFFFFFF, UserDefine=false, NetworkName=BODY_LE1_CAN:
        Cfg_D_Rx_BODY_LE1_CAN_BCU_11E: CanIfPduCanId=0x11e, CanIfRxPduUserRxIndicationUL=PDUR, CanIfRxPduUserRxIndicationName=PduR_LoIfRxIndication, uplayerPduRef=Cfg_D_Rx_BODY_LE1_CAN_BCU_11E, CanIfRxPduHrhIdRef=HOH0_BCU_11E
        Cfg_D_Rx_BODY_LE1_CAN_ZONE_13C: CanIfPduCanId=0x13c, CanIfRxPduUserRxIndicationUL=PDUR, CanIfRxPduUserRxIndicationName=PduR_LoIfRxIndication, uplayerPduRef=Cfg_D_Rx_BODY_LE1_CAN_ZONE_13C, CanIfRxPduHrhIdRef=HOH5_ZONE_13C
        Cfg_D_Rx_BODY_LE1_CAN_ZONE_MCM_05: CanIfPduCanId=0x1b4, CanIfRxPduUserRxIndicationUL=PDUR, CanIfRxPduUserRxIndicationName=PduR_LoIfRxIndication, uplayerPduRef=Cfg_D_Rx_BODY_LE1_CAN_ZONE_MCM_05, CanIfRxPduHrhIdRef=HOH12_MCMD_ZONE_MCM_05_1B4_MCMP_ZONE_MCM_06_1B5
        Cfg_D_Rx_BODY_LE1_CAN_ZONE_1C9: CanIfPduCanId=0x1c9, CanIfRxPduUserRxIndicationUL=PDUR, CanIfRxPduUserRxIndicationName=PduR_LoIfRxIndication, uplayerPduRef=Cfg_D_Rx_BODY_LE1_CAN_ZONE_1C9, CanIfRxPduHrhIdRef=HOH6_ZONE_MCMD_1C9_MCMP_1CF
        Cfg_D_Rx_BODY_LE1_CAN_Zone_FL_MCM_01: CanIfPduCanId=0x1d1, CanIfRxPduUserRxIndicationUL=PDUR, CanIfRxPduUserRxIndicationName=PduR_LoIfRxIndication, uplayerPduRef=Cfg_D_Rx_BODY_LE1_CAN_Zone_FL_MCM_01, CanIfRxPduHrhIdRef=HOH10_MCMD_Zone_FL_MCM_01_1D1_MCMP_Zone_FL_MCM_03_1D3
        Cfg_D_Rx_BODY_LE1_CAN_Zone_FL_MCM_02: CanIfPduCanId=0x1d2, CanIfRxPduUserRxIndicationUL=PDUR, CanIfRxPduUserRxIndicationName=PduR_LoIfRxIndication, uplayerPduRef=Cfg_D_Rx_BODY_LE1_CAN_Zone_FL_MCM_02, CanIfRxPduHrhIdRef=HOH11_MCMD_Zone_FL_MCM_02_1D2_MCMP_Zone_FL_MCM_04_1D4
        Cfg_D_Rx_BODY_LE1_CAN_ZONE_2EF: CanIfPduCanId=0x2ef, CanIfRxPduUserRxIndicationUL=PDUR, CanIfRxPduUserRxIndicationName=PduR_LoIfRxIndication, uplayerPduRef=Cfg_D_Rx_BODY_LE1_CAN_ZONE_2EF, CanIfRxPduHrhIdRef=HOH7_ZONE_2EF
        Cfg_D_Rx_BODY_LE1_CAN_ZONE_3A9: CanIfPduCanId=0x3a9, CanIfRxPduUserRxIndicationUL=PDUR, CanIfRxPduUserRxIndicationName=PduR_LoIfRxIndication, uplayerPduRef=Cfg_D_Rx_BODY_LE1_CAN_ZONE_3A9, CanIfRxPduHrhIdRef=HOH8_ZONE_3A9
        Cfg_D_Rx_BODY_LE1_CAN_ZONE_3B2: CanIfPduCanId=0x3b2, CanIfRxPduUserRxIndicationUL=PDUR, CanIfRxPduUserRxIndicationName=PduR_LoIfRxIndication, uplayerPduRef=Cfg_D_Rx_BODY_LE1_CAN_ZONE_3B2, CanIfRxPduHrhIdRef=HOH9_ZONE_3B2
        Cfg_D_Rx_BODY_LE1_CAN_ZONE_PNC: CanIfPduCanId=0x4f7, CanIfRxPduUserRxIndicationUL=PDUR, CanIfRxPduUserRxIndicationName=PduR_LoIfRxIndication, uplayerPduRef=Cfg_D_Rx_BODY_LE1_CAN_ZONE_PNC, CanIfRxPduHrhIdRef=HOH13_ZONE_PNC
        Cfg_D_Rx_BODY_LE1_CAN_VC_Data_5E0: CanIfPduCanId=0x5e0, CanIfRxPduUserRxIndicationUL=PDUR, CanIfRxPduUserRxIndicationName=PduR_LoIfRxIndication, uplayerPduRef=Cfg_D_Rx_BODY_LE1_CAN_VC_Data_5E0, CanIfRxPduHrhIdRef=HOH4_VC_Data_5E0
        Cfg_D_Rx_BODY_LE1_CAN_DIAG_REQ_AllECU: CanIfPduCanId=0x601, CanIfRxPduUserRxIndicationUL=CAN_TP, CanIfRxPduUserRxIndicationName=CanTp_RxIndication, uplayerPduRef=Cfg_D_Rx_BODY_LE1_CAN_DIAG_REQ_AllECU, CanIfRxPduHrhIdRef=HOH2_DIAG_REQ_AllECU
        Cfg_D_Rx_BODY_LE1_CAN_DIAG_REQ_MCM_D: CanIfPduCanId=0x623, CanIfRxPduUserRxIndicationUL=CAN_TP, CanIfRxPduUserRxIndicationName=CanTp_RxIndication, uplayerPduRef=Cfg_D_Rx_BODY_LE1_CAN_DIAG_REQ_MCM_D, CanIfRxPduHrhIdRef=HOH3_DIAG_REQ_MCMD_623_MCMP_624
      7 x CanIfBufferCfg, all with CanIfBufferSize=Auto:
        Buffer_HOH15_DIAG_RESP_MCM_D_6A3_MCMP_6A4: CanIfHohIdSymRef=HOH15_DIAG_RESP_MCM_D_6A3_MCMP_6A4
        Buffer_HOH16_MCM_D_1B6_MCM_P_1B7: CanIfHohIdSymRef=HOH16_MCM_D_1B6_MCM_P_1B7
        Buffer_HOH17_MCM_D_1DF_MCM_P_1E2: CanIfHohIdSymRef=HOH17_MCM_D_1DF_MCM_P_1E2
        Buffer_HOH18_MCM_D_1E0_MCM_P_1E3: CanIfHohIdSymRef=HOH18_MCM_D_1E0_MCM_P_1E3
        Buffer_HOH19_MCM_D_1E1_MCM_P_1E4: CanIfHohIdSymRef=HOH19_MCM_D_1E1_MCM_P_1E4
        Buffer_HOH20_MCM_D_1E8_MCM_P_1EB: CanIfHohIdSymRef=HOH20_MCM_D_1E8_MCM_P_1EB
        Buffer_HOH21_MCM_D_1EC_MCM_P_1ED: CanIfHohIdSymRef=HOH21_MCM_D_1EC_MCM_P_1ED
    Cfg_P (CanIfInitCfg): UserDefine=false
      InitHohCfg (CanIfInitHohCfg): CanIfInitRefCfgSet=CanConfigSet
        7 x CanIfHthCfg, all with CanIfHthCanCtrlIdRef=CanIf_BODY_LE1_CAN, CanIfHthFifoDepth=0, CanIfHthMaxdlc=8:
          HOH15_DIAG_RESP_MCM_D_6A3_MCMP_6A4: CanIfHthIdSymRef=HOH15_DIAG_RESP_MCM_D_6A3_MCMP_6A4
          HOH16_MCM_D_1B6_MCM_P_1B7: CanIfHthIdSymRef=HOH16_MCM_D_1B6_MCM_P_1B7
          HOH17_MCM_D_1DF_MCM_P_1E2: CanIfHthIdSymRef=HOH17_MCM_D_1DF_MCM_P_1E2
          HOH18_MCM_D_1E0_MCM_P_1E3: CanIfHthIdSymRef=HOH18_MCM_D_1E0_MCM_P_1E3
          HOH19_MCM_D_1E1_MCM_P_1E4: CanIfHthIdSymRef=HOH19_MCM_D_1E1_MCM_P_1E4
          HOH20_MCM_D_1E8_MCM_P_1EB: CanIfHthIdSymRef=HOH20_MCM_D_1E8_MCM_P_1EB
          HOH21_MCM_D_1EC_MCM_P_1ED: CanIfHthIdSymRef=HOH21_MCM_D_1EC_MCM_P_1ED
        13 x CanIfHrhCfg, all with CanIfHohCanCtrlIdRef=CanIf_BODY_LE1_CAN:
          HOH0_BCU_11E: CanIfHrhIdSymRef=HOH0_BCU_11E
          HOH2_DIAG_REQ_AllECU: CanIfHrhIdSymRef=HOH2_DIAG_REQ_AllECU
          HOH3_DIAG_REQ_MCMD_623_MCMP_624: CanIfHrhIdSymRef=HOH3_DIAG_REQ_MCMD_623_MCMP_624
          HOH4_VC_Data_5E0: CanIfHrhIdSymRef=HOH4_VC_Data_5E0
          HOH5_ZONE_13C: CanIfHrhIdSymRef=HOH5_ZONE_13C
          HOH6_ZONE_MCMD_1C9_MCMP_1CF: CanIfHrhIdSymRef=HOH6_ZONE_MCMD_1C9_MCMP_1CF
          HOH7_ZONE_2EF: CanIfHrhIdSymRef=HOH7_ZONE_2EF
          HOH8_ZONE_3A9: CanIfHrhIdSymRef=HOH8_ZONE_3A9
          HOH9_ZONE_3B2: CanIfHrhIdSymRef=HOH9_ZONE_3B2
          HOH10_MCMD_Zone_FL_MCM_01_1D1_MCMP_Zone_FL_MCM_03_1D3: CanIfHrhIdSymRef=HOH10_MCMD_Zone_FL_MCM_01_1D1_MCMP_Zone_FL_MCM_03_1D3
          HOH11_MCMD_Zone_FL_MCM_02_1D2_MCMP_Zone_FL_MCM_04_1D4: CanIfHrhIdSymRef=HOH11_MCMD_Zone_FL_MCM_02_1D2_MCMP_Zone_FL_MCM_04_1D4
          HOH12_MCMD_ZONE_MCM_05_1B4_MCMP_ZONE_MCM_06_1B5: CanIfHrhIdSymRef=HOH12_MCMD_ZONE_MCM_05_1B4_MCMP_ZONE_MCM_06_1B5
          HOH13_ZONE_PNC: CanIfHrhIdSymRef=HOH13_ZONE_PNC
      7 x CanIfTxPduCfg, all with CanIfTxPduCanIdType=STANDARD_NO_FD_CAN, CanIfPduDlc=8, CanIfTxPduPnFilterPdu=false, CanIfTxPduReadNotifyStatus=false, CanIfTxPduType=STATIC, CanIfTxPduTriggerTransmit=false, CanIfTxPduUserTriggerTransmitName=NULL_PTR, CanIfTxPduCanIdMask=0x1FFFFFFF, CanIfTxPduTruncation=true, UserDefine=false, NetworkName=BODY_LE1_CAN:
        Cfg_P_Tx_BODY_LE1_CAN_MCM_P_1B7: CanIfPduCanId=0x1b7, CanIfTxPduUserTxConfirmationUL=PDUR, CanIfTxPduUserTxConfirmationName=PduR_LoIfTxConfirmation, uplayerPduRef=Cfg_P_Tx_BODY_LE1_CAN_MCM_P_1B7, CanIfTxPduBufferRef=Buffer_HOH16_MCM_D_1B6_MCM_P_1B7
        Cfg_P_Tx_BODY_LE1_CAN_MCM_P_1E2: CanIfPduCanId=0x1e2, CanIfTxPduUserTxConfirmationUL=PDUR, CanIfTxPduUserTxConfirmationName=PduR_LoIfTxConfirmation, uplayerPduRef=Cfg_P_Tx_BODY_LE1_CAN_MCM_P_1E2, CanIfTxPduBufferRef=Buffer_HOH17_MCM_D_1DF_MCM_P_1E2
        Cfg_P_Tx_BODY_LE1_CAN_MCM_P_1E3: CanIfPduCanId=0x1e3, CanIfTxPduUserTxConfirmationUL=PDUR, CanIfTxPduUserTxConfirmationName=PduR_LoIfTxConfirmation, uplayerPduRef=Cfg_P_Tx_BODY_LE1_CAN_MCM_P_1E3, CanIfTxPduBufferRef=Buffer_HOH18_MCM_D_1E0_MCM_P_1E3
        Cfg_P_Tx_BODY_LE1_CAN_MCM_P_1E4: CanIfPduCanId=0x1e4, CanIfTxPduUserTxConfirmationUL=PDUR, CanIfTxPduUserTxConfirmationName=PduR_LoIfTxConfirmation, uplayerPduRef=Cfg_P_Tx_BODY_LE1_CAN_MCM_P_1E4, CanIfTxPduBufferRef=Buffer_HOH19_MCM_D_1E1_MCM_P_1E4
        Cfg_P_Tx_BODY_LE1_CAN_MCM_P_1EB: CanIfPduCanId=0x1eb, CanIfTxPduUserTxConfirmationUL=PDUR, CanIfTxPduUserTxConfirmationName=PduR_LoIfTxConfirmation, uplayerPduRef=Cfg_P_Tx_BODY_LE1_CAN_MCM_P_1EB, CanIfTxPduBufferRef=Buffer_HOH20_MCM_D_1E8_MCM_P_1EB
        Cfg_P_Tx_BODY_LE1_CAN_MCM_P_1ED: CanIfPduCanId=0x1ed, CanIfTxPduUserTxConfirmationUL=PDUR, CanIfTxPduUserTxConfirmationName=PduR_LoIfTxConfirmation, uplayerPduRef=Cfg_P_Tx_BODY_LE1_CAN_MCM_P_1ED, CanIfTxPduBufferRef=Buffer_HOH21_MCM_D_1EC_MCM_P_1ED
        Cfg_P_Tx_BODY_LE1_CAN_DIAG_RESP_MCM_P: CanIfPduCanId=0x6a4, CanIfTxPduUserTxConfirmationUL=CAN_TP, CanIfTxPduUserTxConfirmationName=CanTp_TxConfirmation, uplayerPduRef=Cfg_P_Tx_BODY_LE1_CAN_DIAG_RESP_MCM_P, CanIfTxPduBufferRef=Buffer_HOH15_DIAG_RESP_MCM_D_6A3_MCMP_6A4
      13 x CanIfRxPduCfg, all with CanIfRxPduCanIdType=STANDARD_NO_FD_CAN, CanIfPduDlc=8, CanIfRxPduReadData=false, CanIfRxPduDataLengthCheck=false, CanIfRxPduReadNotifyStatus=false, CanIfRxPduCanIdMask=0x1FFFFFFF, UserDefine=false, NetworkName=BODY_LE1_CAN:
        Cfg_P_Rx_BODY_LE1_CAN_BCU_11E: CanIfPduCanId=0x11e, CanIfRxPduUserRxIndicationUL=PDUR, CanIfRxPduUserRxIndicationName=PduR_LoIfRxIndication, uplayerPduRef=Cfg_P_Rx_BODY_LE1_CAN_BCU_11E, CanIfRxPduHrhIdRef=HOH0_BCU_11E
        Cfg_P_Rx_BODY_LE1_CAN_ZONE_13C: CanIfPduCanId=0x13c, CanIfRxPduUserRxIndicationUL=PDUR, CanIfRxPduUserRxIndicationName=PduR_LoIfRxIndication, uplayerPduRef=Cfg_P_Rx_BODY_LE1_CAN_ZONE_13C, CanIfRxPduHrhIdRef=HOH5_ZONE_13C
        Cfg_P_Rx_BODY_LE1_CAN_ZONE_MCM_06: CanIfPduCanId=0x1b5, CanIfRxPduUserRxIndicationUL=PDUR, CanIfRxPduUserRxIndicationName=PduR_LoIfRxIndication, uplayerPduRef=Cfg_P_Rx_BODY_LE1_CAN_ZONE_MCM_06, CanIfRxPduHrhIdRef=HOH12_MCMD_ZONE_MCM_05_1B4_MCMP_ZONE_MCM_06_1B5
        Cfg_P_Rx_BODY_LE1_CAN_ZONE_1CF: CanIfPduCanId=0x1cf, CanIfRxPduUserRxIndicationUL=PDUR, CanIfRxPduUserRxIndicationName=PduR_LoIfRxIndication, uplayerPduRef=Cfg_P_Rx_BODY_LE1_CAN_ZONE_1CF, CanIfRxPduHrhIdRef=HOH6_ZONE_MCMD_1C9_MCMP_1CF
        Cfg_P_Rx_BODY_LE1_CAN_Zone_FL_MCM_03: CanIfPduCanId=0x1d3, CanIfRxPduUserRxIndicationUL=PDUR, CanIfRxPduUserRxIndicationName=PduR_LoIfRxIndication, uplayerPduRef=Cfg_P_Rx_BODY_LE1_CAN_Zone_FL_MCM_03, CanIfRxPduHrhIdRef=HOH10_MCMD_Zone_FL_MCM_01_1D1_MCMP_Zone_FL_MCM_03_1D3
        Cfg_P_Rx_BODY_LE1_CAN_Zone_FL_MCM_04: CanIfPduCanId=0x1d4, CanIfRxPduUserRxIndicationUL=PDUR, CanIfRxPduUserRxIndicationName=PduR_LoIfRxIndication, uplayerPduRef=Cfg_P_Rx_BODY_LE1_CAN_Zone_FL_MCM_04, CanIfRxPduHrhIdRef=HOH11_MCMD_Zone_FL_MCM_02_1D2_MCMP_Zone_FL_MCM_04_1D4
        Cfg_P_Rx_BODY_LE1_CAN_ZONE_2EF: CanIfPduCanId=0x2ef, CanIfRxPduUserRxIndicationUL=PDUR, CanIfRxPduUserRxIndicationName=PduR_LoIfRxIndication, uplayerPduRef=Cfg_P_Rx_BODY_LE1_CAN_ZONE_2EF, CanIfRxPduHrhIdRef=HOH7_ZONE_2EF
        Cfg_P_Rx_BODY_LE1_CAN_ZONE_3A9: CanIfPduCanId=0x3a9, CanIfRxPduUserRxIndicationUL=PDUR, CanIfRxPduUserRxIndicationName=PduR_LoIfRxIndication, uplayerPduRef=Cfg_P_Rx_BODY_LE1_CAN_ZONE_3A9, CanIfRxPduHrhIdRef=HOH8_ZONE_3A9
        Cfg_P_Rx_BODY_LE1_CAN_ZONE_3B2: CanIfPduCanId=0x3b2, CanIfRxPduUserRxIndicationUL=PDUR, CanIfRxPduUserRxIndicationName=PduR_LoIfRxIndication, uplayerPduRef=Cfg_P_Rx_BODY_LE1_CAN_ZONE_3B2, CanIfRxPduHrhIdRef=HOH9_ZONE_3B2
        Cfg_P_Rx_BODY_LE1_CAN_ZONE_PNC: CanIfPduCanId=0x4f7, CanIfRxPduUserRxIndicationUL=PDUR, CanIfRxPduUserRxIndicationName=PduR_LoIfRxIndication, uplayerPduRef=Cfg_P_Rx_BODY_LE1_CAN_ZONE_PNC, CanIfRxPduHrhIdRef=HOH13_ZONE_PNC
        Cfg_P_Rx_BODY_LE1_CAN_VC_Data_5E0: CanIfPduCanId=0x5e0, CanIfRxPduUserRxIndicationUL=PDUR, CanIfRxPduUserRxIndicationName=PduR_LoIfRxIndication, uplayerPduRef=Cfg_P_Rx_BODY_LE1_CAN_VC_Data_5E0, CanIfRxPduHrhIdRef=HOH4_VC_Data_5E0
        Cfg_P_Rx_BODY_LE1_CAN_DIAG_REQ_AllECU: CanIfPduCanId=0x601, CanIfRxPduUserRxIndicationUL=CAN_TP, CanIfRxPduUserRxIndicationName=CanTp_RxIndication, uplayerPduRef=Cfg_P_Rx_BODY_LE1_CAN_DIAG_REQ_AllECU, CanIfRxPduHrhIdRef=HOH2_DIAG_REQ_AllECU
        Cfg_P_Rx_BODY_LE1_CAN_DIAG_REQ_MCM_P: CanIfPduCanId=0x624, CanIfRxPduUserRxIndicationUL=CAN_TP, CanIfRxPduUserRxIndicationName=CanTp_RxIndication, uplayerPduRef=Cfg_P_Rx_BODY_LE1_CAN_DIAG_REQ_MCM_P, CanIfRxPduHrhIdRef=HOH3_DIAG_REQ_MCMD_623_MCMP_624
      7 x CanIfBufferCfg, all with CanIfBufferSize=Auto:
        Buffer_HOH15_DIAG_RESP_MCM_D_6A3_MCMP_6A4: CanIfHohIdSymRef=HOH15_DIAG_RESP_MCM_D_6A3_MCMP_6A4
        Buffer_HOH16_MCM_D_1B6_MCM_P_1B7: CanIfHohIdSymRef=HOH16_MCM_D_1B6_MCM_P_1B7
        Buffer_HOH17_MCM_D_1DF_MCM_P_1E2: CanIfHohIdSymRef=HOH17_MCM_D_1DF_MCM_P_1E2
        Buffer_HOH18_MCM_D_1E0_MCM_P_1E3: CanIfHohIdSymRef=HOH18_MCM_D_1E0_MCM_P_1E3
        Buffer_HOH19_MCM_D_1E1_MCM_P_1E4: CanIfHohIdSymRef=HOH19_MCM_D_1E1_MCM_P_1E4
        Buffer_HOH20_MCM_D_1E8_MCM_P_1EB: CanIfHohIdSymRef=HOH20_MCM_D_1E8_MCM_P_1EB
        Buffer_HOH21_MCM_D_1EC_MCM_P_1ED: CanIfHohIdSymRef=HOH21_MCM_D_1EC_MCM_P_1ED
    DefaultCanDrv (CanIfCtrlDrvCfg):
      CanIfCtrlDrvHeaderFile = Can
      CanIfCanWriteAPI = Can_Write
      CanIfCanSetControllerModeAPI = Can_SetControllerMode
      CanIfCanGetControllerErrorStateAPI = Can_GetControllerErrorState
      CanIfCanGetControllerTxErrorCounterAPI = Can_GetControllerTxErrorCounter
      CanIfCanGetControllerRxErrorCounterAPI = Can_GetControllerRxErrorCounter
      CanIfCanCheckWakeupAPI = 
      CanIfCanSetBaudrateAPI = 
      CanIf_BODY_LE1_CAN (CanIfCtrlCfg): CanIfCtrlWakeupSupport=false, FilePath=BODY_LE1_CAN, UserDefine=false, CanIfCtrlCanCtrlRef=CAN0
  module config CanSM: implementation-config-variant=STD_CONFIG_VARIANTS_POSTBUILD, module_version_def=4.1.0, module_autosar_version=Ar470
    CanSMGeneral:
      VersionCheck = true
      CanSMDevErrorDetect = true
      CanSMMainFunctionTimePeriod = 5
      CanSMVersionInfoApi = false
      CanSMTxOfflineActiveSupport = false
      CanSMEnableBusOffDelay = false
      CanSMSetBaudrateApi = false
      CanSMPncSupport = false
      CanSMNoReqInWait = false
      CanSMLightNmSupport = false
      CanSMBswMSupport = true
      CanSMCtrlOptSupport = false
      CanSMComMNwOptSupport = false
      CanSMMultiCoreSupport = false
      CanSMCarPlatform = CANSM_NONE_PLATFORM
      CanSMCanControllerSleepModeSupport = true
    Cfg_D (CanSMConfiguration): CanSMModeRequestRepetitionMax=1, CanSMModeRequestRepetitionTime=10, UserDefine=false
      CanSM_BODY_LE1_CAN (CanSMManagerNetwork):
        CanSMBorCounterL1ToL2 = 5
        CanSMBorTimeL1 = 50
        CanSMBorTimeL2 = 1000
        CanSMBorTimeTxEnsured = 100
        CanSMBorTxConfirmationPolling = true
        FilePath = BODY_LE1_CAN
        UserDefine = false
        CanSMComMNetworkHandleRef = ComM_BODY_LE1_CAN
        CanSMController: CanSMControllerId=CanIf_BODY_LE1_CAN
    Cfg_P (CanSMConfiguration): CanSMModeRequestRepetitionMax=1, CanSMModeRequestRepetitionTime=10, UserDefine=false
      CanSM_BODY_LE1_CAN (CanSMManagerNetwork):
        CanSMBorCounterL1ToL2 = 5
        CanSMBorTimeL1 = 50
        CanSMBorTimeL2 = 1000
        CanSMBorTimeTxEnsured = 100
        CanSMBorTxConfirmationPolling = true
        FilePath = BODY_LE1_CAN
        UserDefine = false
        CanSMComMNetworkHandleRef = ComM_BODY_LE1_CAN
        CanSMController: CanSMControllerId=CanIf_BODY_LE1_CAN
  module config CanTp: implementation-config-variant=STD_CONFIG_VARIANTS_POSTBUILD, module_version_def=4.0.5, module_autosar_version=Ar470
    CanTpGeneral:
      VersionCheck = true
      CanTpChangeParameterApi = false
      CanTpDevErrorDetect = false
      CanTpPaddingByte = 0xAA
      CanTpReadParameterApi = false
      CanTpVersionInfoApi = false
      CanTpTc = false
      CanTpRc = false
      MaxBlockSize = 3
      CanTpDynIdSupport = false
      CanTpFlexibleDataRateSupport = true
      CanTpGenericConnectionSupport = false
      SupportLongFF = false
      CanTpMultiCoreSupport = false
      CanTpCarPlatform = CANTP_NIO_PLATFORM
    Cfg_D (CanTpConfig): CanTpMainFunctionPeriod=10, UserDefine=false
      Ch_BODY_LE1_CAN_0_DiagPhy_Default (CanTpChannel): CanTpChannelMode=CANTP_MODE_HALF_DUPLEX, UserDefine=false
        RxNSdu_DIAG_REQ_MCM_D (CanTpRxNSdu):
          CanTpBs = 0
          CanTpNar = 1000
          CanTpNbr = 65
          CanTpNcr = 1000
          CanTpRxAddressingFormat = CANTP_STANDARD
          CanTpNTa = 0
          CanTpNSa = 0
          CanTpNAe = 0
          CanTpRxNSduId = 0
          CanTpRxPaddingActivation = CanTp_ON
          CanTpRxTaType = CANTP_PHYSICAL
          CanTpRxWftMax = 0
          CanTpSTmin = 20
          ModuleType = DCM
          isGW = false
          UserDefine = false
          RxMaxCanLen = 8
          CanTpRxNSduRef = Cfg_D_Rx_BODY_LE1_CAN_DIAG_REQ_MCM_D
          CanTpRxNPdu: CanTpRxNPduId=19, UserDefine=false, CanTpRxNPduRef=Cfg_D_Rx_BODY_LE1_CAN_DIAG_REQ_MCM_D
          CanTpTxFcNPdu: CanTpTxFcNPduConfirmationPduId=6, UserDefine=false, CanTpTxFcNPduRef=Cfg_D_Tx_BODY_LE1_CAN_DIAG_RESP_MCM_D
        TxNSdu_DIAG_RESP_MCM_D (CanTpTxNSdu):
          CanTpNas = 1000
          CanTpNbs = 1000
          CanTpNcs = 65
          CanTpTxAddressingFormat = CANTP_STANDARD
          CanTpNTa = 0
          CanTpNSa = 0
          CanTpNAe = 0
          CanTpTxNSduId = 0
          CanTpTxPaddingActivation = CanTp_ON
          CanTpTxTaType = CANTP_PHYSICAL
          TxMaxCanLen = 8
          ModuleType = DCM
          isGW = false
          UserDefine = false
          CanTpTxNSduRef = Cfg_D_Tx_BODY_LE1_CAN_DIAG_RESP_MCM_D
          CanTpTxNPdu: CanTpTxNPduConfirmationPduId=6, UserDefine=false, CanTpTxNPduRef=Cfg_D_Tx_BODY_LE1_CAN_DIAG_RESP_MCM_D
          CanTpRxFcNPdu: CanTpRxFcNPduId=19, CanTpRxFcNPduRef=Cfg_D_Rx_BODY_LE1_CAN_DIAG_REQ_MCM_D
      Ch_BODY_LE1_CAN_0_DiagFun_Default (CanTpChannel): CanTpChannelMode=CANTP_MODE_HALF_DUPLEX, UserDefine=false
        RxNSdu_DIAG_REQ_AllECU (CanTpRxNSdu):
          CanTpBs = 0
          CanTpNar = 1000
          CanTpNbr = 65
          CanTpNcr = 1000
          CanTpRxAddressingFormat = CANTP_STANDARD
          CanTpNTa = 0
          CanTpNSa = 0
          CanTpNAe = 0
          CanTpRxNSduId = 1
          CanTpRxPaddingActivation = CanTp_ON
          CanTpRxTaType = CANTP_FUNCTIONAL
          CanTpRxWftMax = 0
          CanTpSTmin = 20
          ModuleType = DCM
          isGW = false
          UserDefine = false
          RxMaxCanLen = 8
          CanTpRxNSduRef = Cfg_D_Rx_BODY_LE1_CAN_DIAG_REQ_AllECU
          CanTpRxNPdu: CanTpRxNPduId=18, UserDefine=false, CanTpRxNPduRef=Cfg_D_Rx_BODY_LE1_CAN_DIAG_REQ_AllECU
    Cfg_P (CanTpConfig): CanTpMainFunctionPeriod=10, UserDefine=false
      Ch_BODY_LE1_CAN_0_DiagPhy_Default (CanTpChannel): CanTpChannelMode=CANTP_MODE_HALF_DUPLEX, UserDefine=false
        RxNSdu_DIAG_REQ_MCM_P (CanTpRxNSdu):
          CanTpBs = 0
          CanTpNar = 1000
          CanTpNbr = 65
          CanTpNcr = 1000
          CanTpRxAddressingFormat = CANTP_STANDARD
          CanTpNTa = 0
          CanTpNSa = 0
          CanTpNAe = 0
          CanTpRxNSduId = 0
          CanTpRxPaddingActivation = CanTp_ON
          CanTpRxTaType = CANTP_PHYSICAL
          CanTpRxWftMax = 0
          CanTpSTmin = 20
          ModuleType = DCM
          isGW = false
          UserDefine = false
          RxMaxCanLen = 8
          CanTpRxNSduRef = Cfg_P_Rx_BODY_LE1_CAN_DIAG_REQ_MCM_P
          CanTpRxNPdu: CanTpRxNPduId=39, UserDefine=false, CanTpRxNPduRef=Cfg_P_Rx_BODY_LE1_CAN_DIAG_REQ_MCM_P
          CanTpTxFcNPdu: CanTpTxFcNPduConfirmationPduId=26, UserDefine=false, CanTpTxFcNPduRef=Cfg_P_Tx_BODY_LE1_CAN_DIAG_RESP_MCM_P
        TxNSdu_DIAG_RESP_MCM_P (CanTpTxNSdu):
          CanTpNas = 1000
          CanTpNbs = 1000
          CanTpNcs = 65
          CanTpTxAddressingFormat = CANTP_STANDARD
          CanTpNTa = 0
          CanTpNSa = 0
          CanTpNAe = 0
          CanTpTxNSduId = 0
          CanTpTxPaddingActivation = CanTp_ON
          CanTpTxTaType = CANTP_PHYSICAL
          TxMaxCanLen = 8
          ModuleType = DCM
          isGW = false
          UserDefine = false
          CanTpTxNSduRef = Cfg_P_Tx_BODY_LE1_CAN_DIAG_RESP_MCM_P
          CanTpTxNPdu: CanTpTxNPduConfirmationPduId=26, UserDefine=false, CanTpTxNPduRef=Cfg_P_Tx_BODY_LE1_CAN_DIAG_RESP_MCM_P
          CanTpRxFcNPdu: CanTpRxFcNPduId=39, CanTpRxFcNPduRef=Cfg_P_Rx_BODY_LE1_CAN_DIAG_REQ_MCM_P
      Ch_BODY_LE1_CAN_0_DiagFun_Default (CanTpChannel): CanTpChannelMode=CANTP_MODE_HALF_DUPLEX, UserDefine=false
        RxNSdu_DIAG_REQ_AllECU (CanTpRxNSdu):
          CanTpBs = 0
          CanTpNar = 1000
          CanTpNbr = 65
          CanTpNcr = 1000
          CanTpRxAddressingFormat = CANTP_STANDARD
          CanTpNTa = 0
          CanTpNSa = 0
          CanTpNAe = 0
          CanTpRxNSduId = 1
          CanTpRxPaddingActivation = CanTp_ON
          CanTpRxTaType = CANTP_FUNCTIONAL
          CanTpRxWftMax = 0
          CanTpSTmin = 20
          ModuleType = DCM
          isGW = false
          UserDefine = false
          RxMaxCanLen = 8
          CanTpRxNSduRef = Cfg_P_Rx_BODY_LE1_CAN_DIAG_REQ_AllECU
          CanTpRxNPdu: CanTpRxNPduId=38, UserDefine=false, CanTpRxNPduRef=Cfg_P_Rx_BODY_LE1_CAN_DIAG_REQ_AllECU
  module config Com: implementation-config-variant=STD_CONFIG_VARIANTS_POSTBUILD, module_version_def=4.2.0, module_autosar_version=Ar470
    ComGeneral:
      VersionCheck = true
      ComConfigurationUseDet = true
      ComEnableMDTForCyclicTransmission = true
      ComRetryFailedTransmitRequests = false
      ComVersionInfoApi = false
      ComCancellationSupport = true
      ComEnableTriggerSendApi = false
      ComTxMixModeOption = OPTION1
      ComMultiCoreSupport = false
      ComEnableSignalGroupArrayApi = false
      ComMetaDataSupport = false
      ComUserCbkHeaderFile = 
      ComSupportedIPduGroups = 2
      PaddingSupport = false
      GroupAPIR3Support = true
      TimeOffsetAnalysisFromArxml = false
      ComUpdateBitClearDelaySupport = false
      ComE2ETxConfirmationCalloutSupport = false
      ComE2ERxIndicationCalloutSupport = false
      ComE2ETriggerTransmitCalloutSupport = false
      ComUpdateBitClearDelayCnt = 3
      ComMasterCoreId = 0
