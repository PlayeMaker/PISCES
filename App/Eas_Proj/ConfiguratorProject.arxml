[part 4 of 4: package /EcucDefs]
AUTOSAR XML (schema 00046)
package /EcucDefs  (continued)
  module config Dcm: implementation-config-variant=STD_CONFIG_VARIANTS_POSTBUILD, module_version_def=4.2.0, module_autosar_version=Ar470
    DcmGeneral:
      VersionCheck = true
      DcmDevErrorDetect = false
      DcmRespondAllRequest = true
      DcmVersionInfoApi = false
      DcmDDDIDStorage = false
      DcmCarPlatform = DCM_NO_PLATFORM
      ResponseWithP2Timer = true
      DcmTaskTime = 10
      DcmHeaderFileInclusion = 
      DcmOBDSupport = false
      DcmEnableSecurityEventReporting = false
      DcmMultiCoreSupport = false
      DcmRxFifoBuffer = false
    Cfg_D (DcmConfigSet): UserDefine=false
      DcmDsd: DcmDsdRequestManufacturerNotificationEnabled=false, DcmDsdRequestSupplierNotificationEnabled=false
        DsdServiceTable0 (DcmDsdServiceTable): DcmDsdSidTabId=0, isUserDefine=false
          11 x DcmDsdService, all with DcmDsdSidTabFnc=, DcmDsdServiceUsed=true, DcmAddressModePhy=true, Lock=true, P4ServerMax=50, isUserDefineService=false, DcmDsdSidTabSessionLevelRef=Extended, DcmDsdSidTabSecurityLevelRef=Unlocked_L2:
            Service10: DcmDsdSidTabSubfuncAvail=true, DcmDsdSidTabServiceId=0x10, DcmAddressModeFun=true, ReqMsgMinLength=2, SupportSuppressPosRspBit=true, isUserDefine=false, DcmDsdSidTabSessionLevelRef=Default, DcmDsdSidTabSessionLevelRef=FactoryTest
              4 x DcmDsdSubService, all with DcmDsdSubServiceFnc=, DcmDsdSubServiceUsed=true, DcmAddressModeFun=true, DcmAddressModePhy=true, Lock=true, DcmDsdSubServiceSecurityLevelRef=Unlocked_L2:
                Default: DcmDsdSubServiceId=0x01, isUserDefine=false, DcmDsdSubServiceSessionLevelRef=Default, DcmDsdSubServiceSessionLevelRef=Extended, DcmDsdSubServiceSessionLevelRef=FactoryTest
                Programming: DcmDsdSubServiceId=0x02, isUserDefine=false, DcmDsdSubServiceSessionLevelRef=Extended
                Extended: DcmDsdSubServiceId=0x03, isUserDefine=false, DcmDsdSubServiceSessionLevelRef=Default, DcmDsdSubServiceSessionLevelRef=Extended
                FactoryTest: DcmDsdSubServiceId=0x66, isUserDefine=true
            Service11: DcmDsdSidTabSubfuncAvail=true, DcmDsdSidTabServiceId=0x11, DcmAddressModeFun=true, ReqMsgMinLength=2, SupportSuppressPosRspBit=true, isUserDefine=false
              HardReset_Reset (DcmDsdSubService):
                DcmDsdSubServiceId = 0x01
                DcmDsdSubServiceFnc = 
                DcmDsdSubServiceUsed = true
                DcmAddressModeFun = true
                DcmAddressModePhy = true
                Lock = true
                isUserDefine = false
                DcmDsdSubServiceSessionLevelRef = Extended
                DcmDsdSubServiceSecurityLevelRef = Unlocked_L2
              Soft_Reset_Reset (DcmDsdSubService):
                DcmDsdSubServiceId = 0x03
                DcmDsdSubServiceFnc = 
                DcmDsdSubServiceUsed = true
                DcmAddressModeFun = true
                DcmAddressModePhy = true
                Lock = true
                isUserDefine = false
                DcmDsdSubServiceSessionLevelRef = Extended
                DcmDsdSubServiceSecurityLevelRef = Unlocked_L2
            Service14: DcmDsdSidTabSubfuncAvail=false, DcmDsdSidTabServiceId=0x14, DcmAddressModeFun=true, ReqMsgMinLength=4, SupportSuppressPosRspBit=false, isUserDefine=false, DcmDsdSidTabSessionLevelRef=Default
            Service19: DcmDsdSidTabSubfuncAvail=true, DcmDsdSidTabServiceId=0x19, DcmAddressModeFun=false, ReqMsgMinLength=2, SupportSuppressPosRspBit=false, isUserDefine=false, DcmDsdSidTabSessionLevelRef=Default
              5 x DcmDsdSubService, all with DcmDsdSubServiceFnc=, DcmDsdSubServiceUsed=true, DcmAddressModeFun=false, DcmAddressModePhy=true, Lock=true, isUserDefine=false, DcmDsdSubServiceSessionLevelRef=Default, DcmDsdSubServiceSessionLevelRef=Extended, DcmDsdSubServiceSecurityLevelRef=Unlocked_L2:
                FaultMemory_ReadNumber: DcmDsdSubServiceId=0x01
                FaultMemory_ReadAllIdentified: DcmDsdSubServiceId=0x02
                FaultMemory_ReadEnvironmentData: DcmDsdSubServiceId=0x04
                FaultMemory_Read_extended_data: DcmDsdSubServiceId=0x06
                FaultMemory_ReadAllSupported: DcmDsdSubServiceId=0x0A
            Service22: DcmDsdSidTabSubfuncAvail=false, DcmDsdSidTabServiceId=0x22, DcmAddressModeFun=true, ReqMsgMinLength=3, SupportSuppressPosRspBit=false, isUserDefine=false, DcmDsdSidTabSessionLevelRef=Default
            Service27: DcmDsdSidTabSubfuncAvail=true, DcmDsdSidTabServiceId=0x27, DcmAddressModeFun=false, ReqMsgMinLength=2, SupportSuppressPosRspBit=false, isUserDefine=false, ManufactoryModeSupport=false, RequestSeedContinuousError=false, Ncr24AfterZeroSeed=true, KeySizeErrEffectAttemptCounter=true
              Request_Seed_Unlocked_L1_Request_Seed (DcmDsdSubService):
                DcmDsdSubServiceId = 0x03
                DcmDsdSubServiceFnc = 
                DcmDsdSubServiceUsed = true
                DcmAddressModeFun = false
                DcmAddressModePhy = true
                Lock = true
                isUserDefine = false
                DcmDsdSubServiceSessionLevelRef = Extended
                DcmDsdSubServiceSecurityLevelRef = Unlocked_L2
              Send_Key_Unlocked_L2_Send (DcmDsdSubService):
                DcmDsdSubServiceId = 0x04
                DcmDsdSubServiceFnc = 
                DcmDsdSubServiceUsed = true
                DcmAddressModeFun = false
                DcmAddressModePhy = true
                Lock = true
                isUserDefine = false
                DcmDsdSubServiceSessionLevelRef = Extended
                DcmDsdSubServiceSecurityLevelRef = Unlocked_L2
            Service28: DcmDsdSidTabSubfuncAvail=true, DcmDsdSidTabServiceId=0x28, DcmAddressModeFun=true, ReqMsgMinLength=3, SupportSuppressPosRspBit=true, isUserDefine=false
              EnableRxAndEnableTx_Control (DcmDsdSubService):
                DcmDsdSubServiceId = 0x00
                DcmDsdSubServiceFnc = 
                DcmDsdSubServiceUsed = true
                DcmAddressModeFun = true
                DcmAddressModePhy = true
                Lock = true
                isUserDefine = false
                DcmDsdSubServiceSessionLevelRef = Extended
                DcmDsdSubServiceSecurityLevelRef = Unlocked_L2
              EnableRxAndDisableTx_Control (DcmDsdSubService):
                DcmDsdSubServiceId = 0x01
                DcmDsdSubServiceFnc = 
                DcmDsdSubServiceUsed = true
                DcmAddressModeFun = true
                DcmAddressModePhy = true
                Lock = true
                isUserDefine = false
                DcmDsdSubServiceSessionLevelRef = Extended
                DcmDsdSubServiceSecurityLevelRef = Unlocked_L2
            Service2E: DcmDsdSidTabSubfuncAvail=false, DcmDsdSidTabServiceId=0x2E, DcmAddressModeFun=false, ReqMsgMinLength=4, SupportSuppressPosRspBit=false, isUserDefine=true, DcmDsdSidTabSessionLevelRef=FactoryTest
            Service31: DcmDsdSidTabSubfuncAvail=true, DcmDsdSidTabServiceId=0x31, DcmAddressModeFun=false, ReqMsgMinLength=4, SupportSuppressPosRspBit=false, isUserDefine=false, DcmDsdSidTabSessionLevelRef=FactoryTest
            Service3E: DcmDsdSidTabSubfuncAvail=true, DcmDsdSidTabServiceId=0x3E, DcmAddressModeFun=true, ReqMsgMinLength=2, SupportSuppressPosRspBit=true, isUserDefine=false, DcmDsdSidTabSessionLevelRef=Default
              TesterPresent_Send (DcmDsdSubService):
                DcmDsdSubServiceId = 0x00
                DcmDsdSubServiceFnc = 
                DcmDsdSubServiceUsed = true
                DcmAddressModeFun = true
                DcmAddressModePhy = true
                Lock = true
                isUserDefine = false
                DcmDsdSubServiceSessionLevelRef = Default
                DcmDsdSubServiceSessionLevelRef = Extended
                DcmDsdSubServiceSecurityLevelRef = Unlocked_L2
            Service85: DcmDsdSidTabSubfuncAvail=true, DcmDsdSidTabServiceId=0x85, DcmAddressModeFun=true, ReqMsgMinLength=2, SupportSuppressPosRspBit=true, isUserDefine=false
              ON_Send (DcmDsdSubService):
                DcmDsdSubServiceId = 0x01
                DcmDsdSubServiceFnc = 
                DcmDsdSubServiceUsed = true
                DcmAddressModeFun = true
                DcmAddressModePhy = true
                Lock = true
                isUserDefine = false
                DcmDsdSubServiceSessionLevelRef = Extended
                DcmDsdSubServiceSecurityLevelRef = Unlocked_L2
              OFF_Send (DcmDsdSubService):
                DcmDsdSubServiceId = 0x02
                DcmDsdSubServiceFnc = 
                DcmDsdSubServiceUsed = true
                DcmAddressModeFun = true
                DcmAddressModePhy = true
                Lock = true
                isUserDefine = false
                DcmDsdSubServiceSessionLevelRef = Extended
                DcmDsdSubServiceSecurityLevelRef = Unlocked_L2
      DcmDsl
        User (DcmDslCallbackDCMRequestService): DcmDslCallbackDCMRequestService=
        DslDiagResp (DcmDslDiagResp): DcmDslDiagRespMaxNumRespPend=4, DcmDslDiagRespOnSecondDeclinedRequest=false
        DslProtocol (DcmDslProtocol)
          DslProtocolRow0 (DcmDslProtocolRow):
            DcmDslProtocolType = DCM_UDS_ON_CAN
            DcmSendRespPendOnRestart = true
            DcmDslProtocolTransType = TYPE1
            DcmDslProtocolRowUsed = true
            DcmDslProtocolPriority = 1
            DcmDslProtocolMaximumResponseSize = 4095
            S3Server = 5000
            DcmTimStrP2ServerAdjust = 20
            DcmTimStrP2StarServerAdjust = 20
            DcmDspProtocolEcuAddr = 0x1234
            DcmDslProtocolRxBufferDepth = 2
            DcmDslProtocolRxBufferRef = Buffer_0
            DcmDslProtocolSIDTable = DsdServiceTable0
            DcmDslProtocolTxBufferRef = Buffer_0
            DcmDemClientRef = DemClient_0
            Dcm_DslConnection_BODY_LE1_CAN_Model_FunGroup0 (DcmDslConnection): FilePath=BODY_LE1_CAN, UserDefine=false
              DslMainConnection (DcmDslMainConnection): DcmDslProtocolRxTesterSourceAddr=0x1234, DcmDslProtocolRxConnectionId=0, DcmDslProtocolComMChannelRef=ComM_BODY_LE1_CAN
                Cfg_D_Rx_BODY_LE1_CAN_DIAG_REQ_AllECU (DcmDslProtocolRx):
                  DcmDslProtocolRxAddrType = DCM_FUNCTIONAL_TYPE
                  DcmDslProtocolRxPduId = 0
                  UserDefine = false
                  DcmDslProtocolRxPduRef = Cfg_D_Rx_BODY_LE1_CAN_DIAG_REQ_AllECU
                Cfg_D_Rx_BODY_LE1_CAN_DIAG_REQ_MCM_D (DcmDslProtocolRx): DcmDslProtocolRxAddrType=DCM_PHYSICAL_TYPE, DcmDslProtocolRxPduId=0, UserDefine=false, DcmDslProtocolRxPduRef=Cfg_D_Rx_BODY_LE1_CAN_DIAG_REQ_MCM_D
                Cfg_D_Tx_BODY_LE1_CAN_DIAG_RESP_MCM_D (DcmDslProtocolTx): DcmDslTxConfirmationPduId=0, UserDefine=false, DcmDslProtocolTxPduRef=Cfg_D_Tx_BODY_LE1_CAN_DIAG_RESP_MCM_D
        Buffer_0 (DcmDslBuffer): DcmDslBufferSize=1024
      DcmDsp:
        DcmDspDDDIDcheckPerSourceDID = false
        DcmDspDataDefaultEndianness = opaque
        DcmDspEnableObdMirror = false
        DcmDspMaxDidToRead = 1
        DcmDspMaxPeriodicDidToRead = 1
        DcmDspPowerDownTime = 0
        DspSession_DsdServiceTable0 (DcmDspSession)
          4 x DcmDspSessionRow, all with DcmDspSessionP2ServerMax=50, DcmDspSessionP2StarServerMax=2000:
            Default: DcmDspSessionForBoot=DCM_NO_BOOT, DcmDspSessionLevel=0x01, isUserDefine=false
            Programming: DcmDspSessionForBoot=DCM_OEM_BOOT, DcmDspSessionLevel=0x02, isUserDefine=false
            Extended: DcmDspSessionForBoot=DCM_NO_BOOT, DcmDspSessionLevel=0x03, isUserDefine=false
            FactoryTest: DcmDspSessionForBoot=DCM_NO_BOOT, DcmDspSessionLevel=0x66, isUserDefine=true
        DspSecurity_DsdServiceTable0 (DcmDspSecurity): DcmDspSecurityMaxAttemptCounterReadoutTime=2000, DcmDspSecurityResetAttemptCounterOnTimeout=false
          Unlocked_L2 (DcmDspSecurityRow):
            DcmDspSecurityADRSize = 0
            DcmDspSecurityDelayTime = 10000
            DcmDspSecurityDelayTimeOnBoot = 0
            DcmDspSecurityKeySize = 4
            DcmDspSecurityLevel = 0x2
            DcmDspSecurityNumAttDelay = 3
            DcmDspSecuritySeedSize = 4
            DcmDspSecurityCompareKeyFnc = CompareKey
            DcmDspSecurityCompareKeyFnc = CompareKey
            DcmDspSecurityGetSeedFnc = GetSeed
            DcmDspSecuritySetAttemptCounterFnc = SetSecurityAttemptCounter
            DcmDspSecurityUsePort = USE_ASYNCH_CLIENT_SERVER
            DcmDspSecurityAttemptCounterEnabled = true
            DcmDspSecurityKeyNumAttDelay = 2
            DcmDspSecuritySeedNumAttDelay = 3
            isUserDefine = false
        DspDatas_DsdServiceTable0 (DspDatas)
          20 x DcmDspData, all with DcmDspDataUsePort=USE_DATA_ASYNCH_CLIENT_SERVER_ERROR, DcmDspDataFreezeCurrentStateFnc=NULL_PTR, DcmDspDataReadDataLengthFnc=NULL_PTR, DcmDspDataResetToDefaultFnc=NULL_PTR, DcmDspDataReturnControlToEcuFnc=NULL_PTR, DcmDspDataShortTermAdjustmentFnc=NULL_PTR, DcmDspDataConditionCheckReadFnc=NULL_PTR, DcmDspDataConditionCheckReadFncUsed=false, DcmDspDataEcuSignal=NULL_PTR, DcmDspDataEndianness=opaque, DcmDspDataGetScalingInfoFnc=NULL_PTR, DcmDspDataReadEcuSignal=NULL_PTR, isCompData=false:
            DspData_0xF010_0: DcmDspDataType=UINT8_N, DcmDspDataByteSize=4, DcmDspDataReadFnc=Dcm_DataServices_0xF010_0_ReadData, DcmDspDataWriteFnc=NULL_PTR, isUserDefine=false
            DspData_0xF110_0: DcmDspDataType=UINT8_N, DcmDspDataByteSize=11, DcmDspDataReadFnc=Dcm_DataServices_0xF110_0_ReadData, DcmDspDataWriteFnc=NULL_PTR, isUserDefine=false
            DspData_0xF111_0: DcmDspDataType=UINT8_N, DcmDspDataByteSize=2, DcmDspDataReadFnc=Dcm_DataServices_0xF111_0_ReadData, DcmDspDataWriteFnc=NULL_PTR, isUserDefine=false
            DspData_0xF118_0: DcmDspDataType=UINT8_N, DcmDspDataByteSize=11, DcmDspDataReadFnc=Dcm_DataServices_0xF118_0_ReadData, DcmDspDataWriteFnc=NULL_PTR, isUserDefine=false
            DspData_0xF119_0: DcmDspDataType=UINT8_N, DcmDspDataByteSize=2, DcmDspDataReadFnc=Dcm_DataServices_0xF119_0_ReadData, DcmDspDataWriteFnc=NULL_PTR, isUserDefine=false
            DspData_0xF150_0: DcmDspDataType=UINT8_N, DcmDspDataByteSize=3, DcmDspDataReadFnc=Dcm_DataServices_0xF150_0_ReadData, DcmDspDataWriteFnc=NULL_PTR, isUserDefine=false
            DspData_0xF15B_0: DcmDspDataType=UINT8_N, DcmDspDataByteSize=12, DcmDspDataReadFnc=Dcm_DataServices_0xF15B_0_ReadData, DcmDspDataWriteFnc=NULL_PTR, isUserDefine=false
            DspData_0xF186_0: DcmDspDataType=UINT8, DcmDspDataByteSize=1, DcmDspDataReadFnc=Dcm_DataServices_0xF186_0_ReadData, DcmDspDataWriteFnc=NULL_PTR, isUserDefine=false
            DspData_0xF18A_0: DcmDspDataType=UINT8_N, DcmDspDataByteSize=8, DcmDspDataReadFnc=Dcm_DataServices_0xF18A_0_ReadData, DcmDspDataWriteFnc=NULL_PTR, isUserDefine=false
            DspData_0xF18B_0: DcmDspDataType=UINT8_N, DcmDspDataByteSize=3, DcmDspDataReadFnc=Dcm_DataServices_0xF18B_0_ReadData, DcmDspDataWriteFnc=Dcm_DataServices_0xF18B_0_WriteData, isUserDefine=false
            DspData_0xF18C_0: DcmDspDataType=UINT8_N, DcmDspDataByteSize=16, DcmDspDataReadFnc=Dcm_DataServices_0xF18C_0_ReadData, DcmDspDataWriteFnc=Dcm_DataServices_0xF18C_0_WriteData, isUserDefine=false
            DspData_0xF193_0: DcmDspDataType=UINT8_N, DcmDspDataByteSize=3, DcmDspDataReadFnc=Dcm_DataServices_0xF193_0_ReadData, DcmDspDataWriteFnc=NULL_PTR, isUserDefine=false
            DspData_0xF195_0: DcmDspDataType=UINT8_N, DcmDspDataByteSize=3, DcmDspDataReadFnc=Dcm_DataServices_0xF195_0_ReadData, DcmDspDataWriteFnc=NULL_PTR, isUserDefine=false
            DspData_0xF19E_0: DcmDspDataType=UINT8_N, DcmDspDataByteSize=3, DcmDspDataReadFnc=Dcm_DataServices_0xF19E_0_ReadData, DcmDspDataWriteFnc=NULL_PTR, isUserDefine=false
            DspData_0xFD{00..02}_0: DcmDspDataType=UINT8_N, DcmDspDataByteSize=3, DcmDspDataReadFnc=Dcm_DataServices_0xFD{00..02}_0_ReadData, DcmDspDataWriteFnc=NULL_PTR, isUserDefine=true
            DspData_0xFD03_0: DcmDspDataType=UINT8_N, DcmDspDataByteSize=2, DcmDspDataReadFnc=Dcm_DataServices_0xFD03_0_ReadData, DcmDspDataWriteFnc=NULL_PTR, isUserDefine=true
            DspData_0xFD05_0: DcmDspDataType=UINT8_N, DcmDspDataByteSize=6, DcmDspDataReadFnc=Dcm_DataServices_0xFD05_0_ReadData, DcmDspDataWriteFnc=NULL_PTR, isUserDefine=true
            DspData_0xFD06_0: DcmDspDataType=UINT8_N, DcmDspDataByteSize=8, DcmDspDataReadFnc=Dcm_DataServices_0xFD06_0_ReadData, DcmDspDataWriteFnc=NULL_PTR, isUserDefine=true
        DspDidInfos_DsdServiceTable0 (DspDidInfos)
          20 x DcmDspDidInfo, all with DcmDspDidDynamicallyDefined=false, DcmDspDDDIDMaxElements=1:
            DidInfo_0xF010: isUserDefine=false
              DcmDspDidRead:
                Lock = true
                DcmAddressModePhy = true
                DcmAddressModeFun = true
                UserDefine = false
                DcmDspDidReadSecurityLevelRef = Unlocked_L2
                DcmDspDidReadSessionRef = Default
                DcmDspDidReadSessionRef = Extended
            DidInfo_0xF110: isUserDefine=false
              DcmDspDidRead:
                Lock = true
                DcmAddressModePhy = true
                DcmAddressModeFun = true
                UserDefine = false
                DcmDspDidReadSecurityLevelRef = Unlocked_L2
                DcmDspDidReadSessionRef = Default
                DcmDspDidReadSessionRef = Extended
            DidInfo_0xF111: isUserDefine=false
              DcmDspDidRead:
                Lock = true
                DcmAddressModePhy = true
                DcmAddressModeFun = true
                UserDefine = false
                DcmDspDidReadSecurityLevelRef = Unlocked_L2
                DcmDspDidReadSessionRef = Default
                DcmDspDidReadSessionRef = Extended
            DidInfo_0xF118: isUserDefine=false
              DcmDspDidRead:
                Lock = true
                DcmAddressModePhy = true
                DcmAddressModeFun = true
                UserDefine = false
                DcmDspDidReadSecurityLevelRef = Unlocked_L2
                DcmDspDidReadSessionRef = Default
                DcmDspDidReadSessionRef = Extended
            DidInfo_0xF119: isUserDefine=false
              DcmDspDidRead:
                Lock = true
                DcmAddressModePhy = true
                DcmAddressModeFun = true
                UserDefine = false
                DcmDspDidReadSecurityLevelRef = Unlocked_L2
                DcmDspDidReadSessionRef = Default
                DcmDspDidReadSessionRef = Extended
            DidInfo_0xF150: isUserDefine=false
              DcmDspDidRead:
                Lock = true
                DcmAddressModePhy = true
                DcmAddressModeFun = true
                UserDefine = false
                DcmDspDidReadSecurityLevelRef = Unlocked_L2
                DcmDspDidReadSessionRef = Default
                DcmDspDidReadSessionRef = Extended
            DidInfo_0xF15B: isUserDefine=false
              DcmDspDidRead:
                Lock = true
                DcmAddressModePhy = true
                DcmAddressModeFun = true
                UserDefine = false
                DcmDspDidReadSecurityLevelRef = Unlocked_L2
                DcmDspDidReadSessionRef = Default
                DcmDspDidReadSessionRef = Extended
            DidInfo_0xF186: isUserDefine=false
              DcmDspDidRead:
                Lock = true
                DcmAddressModePhy = true
                DcmAddressModeFun = true
                UserDefine = false
                DcmDspDidReadSecurityLevelRef = Unlocked_L2
                DcmDspDidReadSessionRef = Default
                DcmDspDidReadSessionRef = Extended
            DidInfo_0xF18A: isUserDefine=false
              DcmDspDidRead:
                Lock = true
                DcmAddressModePhy = true
                DcmAddressModeFun = true
                UserDefine = false
                DcmDspDidReadSecurityLevelRef = Unlocked_L2
                DcmDspDidReadSessionRef = Default
                DcmDspDidReadSessionRef = Extended
            DidInfo_0xF18B: isUserDefine=false
              DcmDspDidRead:
                Lock = true
                DcmAddressModePhy = true
                DcmAddressModeFun = true
                UserDefine = false
                DcmDspDidReadSecurityLevelRef = Unlocked_L2
                DcmDspDidReadSessionRef = Default
                DcmDspDidReadSessionRef = Extended
              DcmDspDidWrite:
                Lock = true
                DcmAddressModePhy = true
                DcmAddressModeFun = false
                UserDefine = true
                DcmDspDidWriteSecurityLevelRef = Unlocked_L2
                DcmDspDidWriteSessionRef = Extended
                DcmDspDidWriteSessionRef = FactoryTest
            DidInfo_0xF18C: isUserDefine=false
              DcmDspDidRead:
                Lock = true
                DcmAddressModePhy = true
                DcmAddressModeFun = true
                UserDefine = false
                DcmDspDidReadSecurityLevelRef = Unlocked_L2
                DcmDspDidReadSessionRef = Default
                DcmDspDidReadSessionRef = Extended
              DcmDspDidWrite:
                Lock = true
                DcmAddressModePhy = true
                DcmAddressModeFun = false
                UserDefine = true
                DcmDspDidWriteSecurityLevelRef = Unlocked_L2
                DcmDspDidWriteSessionRef = Extended
                DcmDspDidWriteSessionRef = FactoryTest
            DidInfo_0xF193: isUserDefine=false
              DcmDspDidRead:
                Lock = true
                DcmAddressModePhy = true
                DcmAddressModeFun = true
                UserDefine = false
                DcmDspDidReadSecurityLevelRef = Unlocked_L2
                DcmDspDidReadSessionRef = Default
                DcmDspDidReadSessionRef = Extended
            DidInfo_0xF195: isUserDefine=false
              DcmDspDidRead:
                Lock = true
                DcmAddressModePhy = true
                DcmAddressModeFun = true
                UserDefine = false
                DcmDspDidReadSecurityLevelRef = Unlocked_L2
                DcmDspDidReadSessionRef = Default
                DcmDspDidReadSessionRef = Extended
            DidInfo_0xF19E: isUserDefine=false
              DcmDspDidRead:
                Lock = true
                DcmAddressModePhy = true
                DcmAddressModeFun = true
                UserDefine = false
                DcmDspDidReadSecurityLevelRef = Unlocked_L2
                DcmDspDidReadSessionRef = Default
                DcmDspDidReadSessionRef = Extended
            DidInfo_0xFD00: isUserDefine=true
              DspDidRead (DcmDspDidRead):
                Lock = true
                DcmAddressModePhy = true
                DcmAddressModeFun = true
                UserDefine = true
                DcmDspDidReadSecurityLevelRef = Unlocked_L2
                DcmDspDidReadSessionRef = Default
                DcmDspDidReadSessionRef = Extended
            DidInfo_0xFD01: isUserDefine=true
              DcmDspDidRead:
                Lock = true
                DcmAddressModePhy = true
                DcmAddressModeFun = true
                UserDefine = true
                DcmDspDidReadSecurityLevelRef = Unlocked_L2
                DcmDspDidReadSessionRef = Default
                DcmDspDidReadSessionRef = Extended
            DidInfo_0xFD02: isUserDefine=true
              DcmDspDidRead:
                Lock = true
                DcmAddressModePhy = true
                DcmAddressModeFun = true
                UserDefine = true
                DcmDspDidReadSecurityLevelRef = Unlocked_L2
                DcmDspDidReadSessionRef = Default
                DcmDspDidReadSessionRef = Extended
            DidInfo_0xFD03: isUserDefine=true
              DcmDspDidRead:
                Lock = true
                DcmAddressModePhy = true
                DcmAddressModeFun = true
                UserDefine = true
                DcmDspDidReadSecurityLevelRef = Unlocked_L2
                DcmDspDidReadSessionRef = Default
                DcmDspDidReadSessionRef = Extended
            DidInfo_0xFD05: isUserDefine=true
              DcmDspDidRead:
                Lock = true
                DcmAddressModePhy = true
                DcmAddressModeFun = true
                UserDefine = true
                DcmDspDidReadSecurityLevelRef = Unlocked_L2
                DcmDspDidReadSessionRef = Default
                DcmDspDidReadSessionRef = Extended
            DidInfo_0xFD06: isUserDefine=true
              DcmDspDidRead:
                Lock = true
                DcmAddressModePhy = true
                DcmAddressModeFun = true
                UserDefine = true
                DcmDspDidReadSecurityLevelRef = Unlocked_L2
                DcmDspDidReadSessionRef = Default
                DcmDspDidReadSessionRef = Extended
        DspDids_DsdServiceTable0 (DspDids)
          20 x DcmDspDid, all with DcmDspDidUsed=true, DcmDspDidUsePort=USE_DATA_ELEMENT_SPECIFIC_INTERFACES, returnControlToECU=false, resetToDefault=false, freezeCurrentState=false, shortTermAdjustment=false, ReqOptionByteLength=0, RespOptionByteLength=0:
            DID_0xF010: DcmDspDidIdentifier=0xF010, DcmDspDidSize=0x4, isUserDefine=false, DcmDspDidInfoRef=DidInfo_0xF010, DcmDspDidRef=DID_0xF010
              DcmDspDidSignal_0xF010_0 (DcmDspDidSignal): DcmDspDidByteOffset=0, UserDefine=false, DcmDspDidDataRef=DspData_0xF010_0
            DID_0xF110: DcmDspDidIdentifier=0xF110, DcmDspDidSize=0xb, isUserDefine=false, DcmDspDidInfoRef=DidInfo_0xF110, DcmDspDidRef=DID_0xF110
              DcmDspDidSignal_0xF110_0 (DcmDspDidSignal): DcmDspDidByteOffset=0, UserDefine=false, DcmDspDidDataRef=DspData_0xF110_0
            DID_0xF111: DcmDspDidIdentifier=0xF111, DcmDspDidSize=0x2, isUserDefine=false, DcmDspDidInfoRef=DidInfo_0xF111, DcmDspDidRef=DID_0xF111
              DcmDspDidSignal_0xF111_0 (DcmDspDidSignal): DcmDspDidByteOffset=0, UserDefine=false, DcmDspDidDataRef=DspData_0xF111_0
            DID_0xF118: DcmDspDidIdentifier=0xF118, DcmDspDidSize=0xb, isUserDefine=false, DcmDspDidInfoRef=DidInfo_0xF118, DcmDspDidRef=DID_0xF118
              DcmDspDidSignal_0xF118_0 (DcmDspDidSignal): DcmDspDidByteOffset=0, UserDefine=false, DcmDspDidDataRef=DspData_0xF118_0
            DID_0xF119: DcmDspDidIdentifier=0xF119, DcmDspDidSize=0x2, isUserDefine=false, DcmDspDidInfoRef=DidInfo_0xF119, DcmDspDidRef=DID_0xF119
              DcmDspDidSignal_0xF119_0 (DcmDspDidSignal): DcmDspDidByteOffset=0, UserDefine=false, DcmDspDidDataRef=DspData_0xF119_0
            DID_0xF150: DcmDspDidIdentifier=0xF150, DcmDspDidSize=0x3, isUserDefine=false, DcmDspDidInfoRef=DidInfo_0xF150, DcmDspDidRef=DID_0xF150
              DcmDspDidSignal_0xF150_0 (DcmDspDidSignal): DcmDspDidByteOffset=0, UserDefine=false, DcmDspDidDataRef=DspData_0xF150_0
            DID_0xF15B: DcmDspDidIdentifier=0xF15B, DcmDspDidSize=0xc, isUserDefine=false, DcmDspDidInfoRef=DidInfo_0xF15B, DcmDspDidRef=DID_0xF15B
              DcmDspDidSignal_0xF15B_0 (DcmDspDidSignal): DcmDspDidByteOffset=0, UserDefine=false, DcmDspDidDataRef=DspData_0xF15B_0
            DID_0xF186: DcmDspDidIdentifier=0xF186, DcmDspDidSize=0x1, isUserDefine=false, DcmDspDidInfoRef=DidInfo_0xF186, DcmDspDidRef=DID_0xF186
              DcmDspDidSignal_0xF186_0 (DcmDspDidSignal): DcmDspDidByteOffset=0, UserDefine=false, DcmDspDidDataRef=DspData_0xF186_0
            DID_0xF18A: DcmDspDidIdentifier=0xF18A, DcmDspDidSize=0x8, isUserDefine=false, DcmDspDidInfoRef=DidInfo_0xF18A, DcmDspDidRef=DID_0xF18A
              DcmDspDidSignal_0xF18A_0 (DcmDspDidSignal): DcmDspDidByteOffset=0, UserDefine=false, DcmDspDidDataRef=DspData_0xF18A_0
            DID_0xF18B: DcmDspDidIdentifier=0xF18B, DcmDspDidSize=0x3, isUserDefine=false, DcmDspDidInfoRef=DidInfo_0xF18B, DcmDspDidRef=DID_0xF18B
              DcmDspDidSignal_0xF18B_0 (DcmDspDidSignal): DcmDspDidByteOffset=0, UserDefine=false, DcmDspDidDataRef=DspData_0xF18B_0
            DID_0xF18C: DcmDspDidIdentifier=0xF18C, DcmDspDidSize=0x10, isUserDefine=false, DcmDspDidInfoRef=DidInfo_0xF18C, DcmDspDidRef=DID_0xF18C
              DcmDspDidSignal_0xF18C_0 (DcmDspDidSignal): DcmDspDidByteOffset=0, UserDefine=false, DcmDspDidDataRef=DspData_0xF18C_0
            DID_0xF193: DcmDspDidIdentifier=0xF193, DcmDspDidSize=0x3, isUserDefine=false, DcmDspDidInfoRef=DidInfo_0xF193, DcmDspDidRef=DID_0xF193
              DcmDspDidSignal_0xF193_0 (DcmDspDidSignal): DcmDspDidByteOffset=0, UserDefine=false, DcmDspDidDataRef=DspData_0xF193_0
            DID_0xF195: DcmDspDidIdentifier=0xF195, DcmDspDidSize=0x3, isUserDefine=false, DcmDspDidInfoRef=DidInfo_0xF195, DcmDspDidRef=DID_0xF195
              DcmDspDidSignal_0xF195_0 (DcmDspDidSignal): DcmDspDidByteOffset=0, UserDefine=false, DcmDspDidDataRef=DspData_0xF195_0
            DID_0xF19E: DcmDspDidIdentifier=0xF19E, DcmDspDidSize=0x3, isUserDefine=false, DcmDspDidInfoRef=DidInfo_0xF19E, DcmDspDidRef=DID_0xF19E
              DcmDspDidSignal_0xF19E_0 (DcmDspDidSignal): DcmDspDidByteOffset=0, UserDefine=false, DcmDspDidDataRef=DspData_0xF19E_0
            DID_0xFD00: DcmDspDidIdentifier=0xFD00, DcmDspDidSize=0x3, isUserDefine=true, DcmDspDidInfoRef=DidInfo_0xFD00, DcmDspDidRef=DID_0xFD00
              DcmDspDidSignal_0xFD00_0 (DcmDspDidSignal): DcmDspDidByteOffset=0, UserDefine=true, DcmDspDidDataRef=DspData_0xFD00_0
            DID_0xFD01: DcmDspDidIdentifier=0xFD01, DcmDspDidSize=0x3, isUserDefine=true, DcmDspDidInfoRef=DidInfo_0xFD01, DcmDspDidRef=DID_0xFD01
              DcmDspDidSignal_0xFD01_0 (DcmDspDidSignal): DcmDspDidByteOffset=0, UserDefine=true, DcmDspDidDataRef=DspData_0xFD01_0
            DID_0xFD02: DcmDspDidIdentifier=0xFD02, DcmDspDidSize=0x3, isUserDefine=true, DcmDspDidInfoRef=DidInfo_0xFD02, DcmDspDidRef=DID_0xFD02
              DcmDspDidSignal_0xFD02_0 (DcmDspDidSignal): DcmDspDidByteOffset=0, UserDefine=true, DcmDspDidDataRef=DspData_0xFD02_0
            DID_0xFD03: DcmDspDidIdentifier=0xFD03, DcmDspDidSize=0x2, isUserDefine=true, DcmDspDidInfoRef=DidInfo_0xFD03, DcmDspDidRef=DID_0xFD03
              DcmDspDidSignal_0xFD03_0 (DcmDspDidSignal): DcmDspDidByteOffset=0, UserDefine=true, DcmDspDidDataRef=DspData_0xFD03_0
            DID_0xFD05: DcmDspDidIdentifier=0xFD05, DcmDspDidSize=0x6, isUserDefine=true, DcmDspDidInfoRef=DidInfo_0xFD05, DcmDspDidRef=DID_0xFD05
              DcmDspDidSignal_0xFD05_0 (DcmDspDidSignal): DcmDspDidByteOffset=0, UserDefine=true, DcmDspDidDataRef=DspData_0xFD05_0
            DID_0xFD06: DcmDspDidIdentifier=0xFD06, DcmDspDidSize=0x8, isUserDefine=true, DcmDspDidInfoRef=DidInfo_0xFD06, DcmDspDidRef=DID_0xFD06
              DcmDspDidSignal_0xFD06_0 (DcmDspDidSignal): DcmDspDidByteOffset=0, UserDefine=true, DcmDspDidDataRef=DspData_0xFD06_0
        DspRoutines_DsdServiceTable0 (DspRoutines)
          4 x DcmDspRoutine, all with DcmDspRoutineUsePort=true, DcmDspRoutineUsed=true, DcmDspRoutineInfoByte=0x0, DcmDspRoutineFncSignature=ROUTINE_FNC_NORMAL:
            DspRoutine0x0203: DcmDspRoutineIdentifier=0x0203, isUserDefine=false
              DspRoutine0x0203_Start (DcmDspStartRoutine):
                DcmDspStartRoutineFnc = Dcm_RoutineServices_0x0203_Start
                P4ServerMax = 0
                DcmDspRoutineInterfaceArgumentIntegrity = false
                DcmDspStartRoutineConfirmationEnabled = false
                DcmDspStartRoutineConfirmationFnc = 
                isUserDefine = false
                DcmDspStartRoutineCommonAuthorizationRef = DspRoutine0x0203_Start
                DspStartRoutineOut (DcmDspStartRoutineOut)
                  DspRoutine0x0203_StartOutSignal (DcmDspStartRoutineOutSignal): DcmDspRoutineSignalType=UINT8, DcmDspRoutineParameterSize=1, DcmDspRoutineSignalPos=0, DcmDspRoutineSignalEndianness=opaque
            DspRoutine0xFD04: DcmDspRoutineIdentifier=0xFD04, isUserDefine=true
              DspRoutine0xFD04_Start (DcmDspStartRoutine):
                DcmDspStartRoutineFnc = Dcm_RoutineServices_0xFD04_Start
                P4ServerMax = 0
                DcmDspRoutineInterfaceArgumentIntegrity = false
                DcmDspStartRoutineConfirmationEnabled = false
                DcmDspStartRoutineConfirmationFnc = 
                isUserDefine = true
                DcmDspStartRoutineCommonAuthorizationRef = DspRoutine0xFD04
                DspStartRoutineIn (DcmDspStartRoutineIn)
                  DspRoutine0xFD04_StartInSignal (DcmDspStartRoutineInSignal): DcmDspRoutineSignalType=VARIABLE_LENGTH, DcmDspRoutineParameterSize=3, DcmDspRoutineSignalPos=0, DcmDspRoutineSignalEndianness=opaque
                DspStartRoutineOut (DcmDspStartRoutineOut)
                  DspRoutine0xFD04_StartOutSignal (DcmDspStartRoutineOutSignal): DcmDspRoutineSignalType=VARIABLE_LENGTH, DcmDspRoutineParameterSize=3, DcmDspRoutineSignalPos=0, DcmDspRoutineSignalEndianness=opaque
              DspRoutine0xFD04_Stop (DcmDspStopRoutine):
                DcmDspStopRoutineFnc = Dcm_RoutineServices_0xFD04_Stop
                P4ServerMax = 0
                DcmDspRoutineInterfaceArgumentIntegrity = false
                DcmDspStopRoutineConfirmationEnabled = false
                DcmDspStopRoutineConfirmationFnc = 
                isUserDefine = true
                DcmDspStopRoutineCommonAuthorizationRef = DspRoutine0xFD04
                DspStopRoutineIn (DcmDspRoutineStopIn)
                  DspRoutine0xFD04_StopInSignal (DcmDspRoutineStopInSignal): DcmDspRoutineSignalType=VARIABLE_LENGTH, DcmDspRoutineParameterSize=3, DcmDspRoutineSignalPos=0, DcmDspRoutineSignalEndianness=opaque
                DspStopRoutineOut (DcmDspRoutineStopOut)
                  DspRoutine0xFD04_StopOutSignal (DcmDspRoutineStopOutSignal): DcmDspRoutineSignalType=VARIABLE_LENGTH, DcmDspRoutineParameterSize=3, DcmDspRoutineSignalPos=0, DcmDspRoutineSignalEndianness=opaque
            DspRoutine0xFD05: DcmDspRoutineIdentifier=0xFD05, isUserDefine=true
              DspRoutine0xFD05_Start (DcmDspStartRoutine):
                DcmDspStartRoutineFnc = Dcm_RoutineServices_0xFD05_Start
                P4ServerMax = 0
                DcmDspRoutineInterfaceArgumentIntegrity = false
                DcmDspStartRoutineConfirmationEnabled = false
                DcmDspStartRoutineConfirmationFnc = 
                isUserDefine = true
                DcmDspStartRoutineCommonAuthorizationRef = DspRoutine0xFD05
                DspStartRoutineIn (DcmDspStartRoutineIn)
                  DspRoutine0xFD05_StartInSignal (DcmDspStartRoutineInSignal): DcmDspRoutineSignalType=VARIABLE_LENGTH, DcmDspRoutineParameterSize=2, DcmDspRoutineSignalPos=0, DcmDspRoutineSignalEndianness=opaque
                DspStartRoutineOut (DcmDspStartRoutineOut)
                  DspRoutine0xFD05_StartOutSignal (DcmDspStartRoutineOutSignal): DcmDspRoutineSignalType=VARIABLE_LENGTH, DcmDspRoutineParameterSize=2, DcmDspRoutineSignalPos=0, DcmDspRoutineSignalEndianness=opaque
            DspRoutine0xFD10: DcmDspRoutineIdentifier=0xFD10, isUserDefine=true
              DspRoutine0xFD10_Start (DcmDspStartRoutine):
                DcmDspStartRoutineFnc = Dcm_RoutineServices_0xFD10_Start
                P4ServerMax = 0
                DcmDspRoutineInterfaceArgumentIntegrity = false
                DcmDspStartRoutineConfirmationEnabled = false
                DcmDspStartRoutineConfirmationFnc = 
                isUserDefine = true
                DcmDspStartRoutineCommonAuthorizationRef = DspRoutine0xFD10
        DspCommonAuthorizations_DsdServiceTable0 (DspCommonAuthorizations)
          4 x DcmDspCommonAuthorization, all with DcmAddressModePhy=true, DcmAddressModeFun=false, Lock=true, DcmDspSecurityLevelRef=Unlocked_L2:
            DspRoutine0x0203_Start: isUserDefine=false, DcmDspSessionRef=Extended
            DspRoutine0xFD04: isUserDefine=true, DcmDspSessionRef=FactoryTest
            DspRoutine0xFD05: isUserDefine=true, DcmDspSessionRef=FactoryTest
            DspRoutine0xFD10: isUserDefine=true, DcmDspSessionRef=FactoryTest
        DspPids_DsdServiceTable0 (DspPids)
        DspRequestControls_DsdServiceTable0 (DcmDspRequestControls)
        DspVehInfos_DsdServiceTable0 (DcmDspVehInfos)
        DspComControl_DsdServiceTable0 (DcmDspComControl): isUserDefine=false
          ComM_BODY_LE1_CAN (DcmDspComControlAllChanne): DcmDspComControlAllChannelUsed=true, isUserDefine=false, DcmDspAllComMChannelRef=ComM_BODY_LE1_CAN
        DspMemory_DsdServiceTable0 (DcmDspMemory): isUserDefine=false
          DspMemoryIdInfo (DcmDspMemoryIdInfo): DcmDspMemoryIdValue=0
        DspEcuReset_DsdServiceTable0 (DspEcuReset)
          HardReset_Reset (DcmDspEcuResetRow): DcmDspEcuResetId=0x01, DcmResponseToEcuReset=BEFORE_RESET, isUserDefine=false
          Soft_Reset_Reset (DcmDspEcuResetRow): DcmDspEcuResetId=0x03, DcmResponseToEcuReset=BEFORE_RESET, isUserDefine=false
        DspControlDTCSetting (DcmDspControlDTCSetting): DcmSupportDTCSettingControlOptionRecord=true, isUserDefine=false
        DspReadDTCInformation (DcmDspReadDTCInformation): DcmDspReadDTCInformationSupportedObdUdsDtcSeparation=false
    Cfg_P (DcmConfigSet): UserDefine=false
      DcmDsd: DcmDsdRequestManufacturerNotificationEnabled=false, DcmDsdRequestSupplierNotificationEnabled=false
        DsdServiceTable0 (DcmDsdServiceTable): DcmDsdSidTabId=0, isUserDefine=false
          11 x DcmDsdService, all with DcmDsdSidTabFnc=, DcmDsdServiceUsed=true, DcmAddressModePhy=true, Lock=true, P4ServerMax=50, isUserDefineService=false, DcmDsdSidTabSessionLevelRef=Extended, DcmDsdSidTabSecurityLevelRef=Unlocked_L2:
            Service10: DcmDsdSidTabSubfuncAvail=true, DcmDsdSidTabServiceId=0x10, DcmAddressModeFun=true, ReqMsgMinLength=2, SupportSuppressPosRspBit=true, isUserDefine=false, DcmDsdSidTabSessionLevelRef=Default, DcmDsdSidTabSessionLevelRef=FactoryTest
              4 x DcmDsdSubService, all with DcmDsdSubServiceFnc=, DcmDsdSubServiceUsed=true, DcmAddressModeFun=true, DcmAddressModePhy=true, Lock=true, DcmDsdSubServiceSecurityLevelRef=Unlocked_L2:
                Default: DcmDsdSubServiceId=0x01, isUserDefine=false, DcmDsdSubServiceSessionLevelRef=Default, DcmDsdSubServiceSessionLevelRef=Extended, DcmDsdSubServiceSessionLevelRef=FactoryTest
                Programming: DcmDsdSubServiceId=0x02, isUserDefine=false, DcmDsdSubServiceSessionLevelRef=Extended
                Extended: DcmDsdSubServiceId=0x03, isUserDefine=false, DcmDsdSubServiceSessionLevelRef=Default, DcmDsdSubServiceSessionLevelRef=Extended
                FactoryTest: DcmDsdSubServiceId=0x66, isUserDefine=true
            Service11: DcmDsdSidTabSubfuncAvail=true, DcmDsdSidTabServiceId=0x11, DcmAddressModeFun=true, ReqMsgMinLength=2, SupportSuppressPosRspBit=true, isUserDefine=false
              HardReset_Reset (DcmDsdSubService):
                DcmDsdSubServiceId = 0x01
                DcmDsdSubServiceFnc = 
                DcmDsdSubServiceUsed = true
                DcmAddressModeFun = true
                DcmAddressModePhy = true
                Lock = true
                isUserDefine = false
                DcmDsdSubServiceSessionLevelRef = Extended
                DcmDsdSubServiceSecurityLevelRef = Unlocked_L2
              Soft_Reset_Reset (DcmDsdSubService):
                DcmDsdSubServiceId = 0x03
                DcmDsdSubServiceFnc = 
                DcmDsdSubServiceUsed = true
                DcmAddressModeFun = true
                DcmAddressModePhy = true
                Lock = true
                isUserDefine = false
                DcmDsdSubServiceSessionLevelRef = Extended
                DcmDsdSubServiceSecurityLevelRef = Unlocked_L2
            Service14: DcmDsdSidTabSubfuncAvail=false, DcmDsdSidTabServiceId=0x14, DcmAddressModeFun=true, ReqMsgMinLength=4, SupportSuppressPosRspBit=false, isUserDefine=false, DcmDsdSidTabSessionLevelRef=Default
            Service19: DcmDsdSidTabSubfuncAvail=true, DcmDsdSidTabServiceId=0x19, DcmAddressModeFun=false, ReqMsgMinLength=2, SupportSuppressPosRspBit=false, isUserDefine=false, DcmDsdSidTabSessionLevelRef=Default
              5 x DcmDsdSubService, all with DcmDsdSubServiceFnc=, DcmDsdSubServiceUsed=true, DcmAddressModeFun=false, DcmAddressModePhy=true, Lock=true, isUserDefine=false, DcmDsdSubServiceSessionLevelRef=Default, DcmDsdSubServiceSessionLevelRef=Extended, DcmDsdSubServiceSecurityLevelRef=Unlocked_L2:
                FaultMemory_ReadNumber: DcmDsdSubServiceId=0x01
                FaultMemory_ReadAllIdentified: DcmDsdSubServiceId=0x02
                FaultMemory_ReadEnvironmentData: DcmDsdSubServiceId=0x04
                FaultMemory_Read_extended_data: DcmDsdSubServiceId=0x06
                FaultMemory_ReadAllSupported: DcmDsdSubServiceId=0x0A
            Service22: DcmDsdSidTabSubfuncAvail=false, DcmDsdSidTabServiceId=0x22, DcmAddressModeFun=true, ReqMsgMinLength=3, SupportSuppressPosRspBit=false, isUserDefine=false, DcmDsdSidTabSessionLevelRef=Default
            Service27: DcmDsdSidTabSubfuncAvail=true, DcmDsdSidTabServiceId=0x27, DcmAddressModeFun=false, ReqMsgMinLength=2, SupportSuppressPosRspBit=false, isUserDefine=false, ManufactoryModeSupport=false, RequestSeedContinuousError=false, Ncr24AfterZeroSeed=true, KeySizeErrEffectAttemptCounter=true
              Request_Seed_Unlocked_L1_Request_Seed (DcmDsdSubService):
                DcmDsdSubServiceId = 0x03
                DcmDsdSubServiceFnc = 
                DcmDsdSubServiceUsed = true
                DcmAddressModeFun = false
                DcmAddressModePhy = true
                Lock = true
                isUserDefine = false
                DcmDsdSubServiceSessionLevelRef = Extended
                DcmDsdSubServiceSecurityLevelRef = Unlocked_L2
              Send_Key_Unlocked_L2_Send (DcmDsdSubService):
                DcmDsdSubServiceId = 0x04
                DcmDsdSubServiceFnc = 
                DcmDsdSubServiceUsed = true
                DcmAddressModeFun = false
                DcmAddressModePhy = true
                Lock = true
                isUserDefine = false
                DcmDsdSubServiceSessionLevelRef = Extended
                DcmDsdSubServiceSecurityLevelRef = Unlocked_L2
            Service28: DcmDsdSidTabSubfuncAvail=true, DcmDsdSidTabServiceId=0x28, DcmAddressModeFun=true, ReqMsgMinLength=3, SupportSuppressPosRspBit=true, isUserDefine=false
              EnableRxAndEnableTx_Control (DcmDsdSubService):
                DcmDsdSubServiceId = 0x00
                DcmDsdSubServiceFnc = 
                DcmDsdSubServiceUsed = true
                DcmAddressModeFun = true
                DcmAddressModePhy = true
                Lock = true
                isUserDefine = false
                DcmDsdSubServiceSessionLevelRef = Extended
                DcmDsdSubServiceSecurityLevelRef = Unlocked_L2
              EnableRxAndDisableTx_Control (DcmDsdSubService):
                DcmDsdSubServiceId = 0x01
                DcmDsdSubServiceFnc = 
                DcmDsdSubServiceUsed = true
                DcmAddressModeFun = true
                DcmAddressModePhy = true
                Lock = true
                isUserDefine = false
                DcmDsdSubServiceSessionLevelRef = Extended
                DcmDsdSubServiceSecurityLevelRef = Unlocked_L2
            Service31: DcmDsdSidTabSubfuncAvail=true, DcmDsdSidTabServiceId=0x31, DcmAddressModeFun=false, ReqMsgMinLength=4, SupportSuppressPosRspBit=false, isUserDefine=false, DcmDsdSidTabSessionLevelRef=FactoryTest
            Service3E: DcmDsdSidTabSubfuncAvail=true, DcmDsdSidTabServiceId=0x3E, DcmAddressModeFun=true, ReqMsgMinLength=2, SupportSuppressPosRspBit=true, isUserDefine=false, DcmDsdSidTabSessionLevelRef=Default
              TesterPresent_Send (DcmDsdSubService):
                DcmDsdSubServiceId = 0x00
                DcmDsdSubServiceFnc = 
                DcmDsdSubServiceUsed = true
                DcmAddressModeFun = true
                DcmAddressModePhy = true
                Lock = true
                isUserDefine = false
                DcmDsdSubServiceSessionLevelRef = Default
                DcmDsdSubServiceSessionLevelRef = Extended
                DcmDsdSubServiceSecurityLevelRef = Unlocked_L2
            Service85: DcmDsdSidTabSubfuncAvail=true, DcmDsdSidTabServiceId=0x85, DcmAddressModeFun=true, ReqMsgMinLength=2, SupportSuppressPosRspBit=true, isUserDefine=false
              ON_Send (DcmDsdSubService):
                DcmDsdSubServiceId = 0x01
                DcmDsdSubServiceFnc = 
                DcmDsdSubServiceUsed = true
                DcmAddressModeFun = true
                DcmAddressModePhy = true
                Lock = true
                isUserDefine = false
                DcmDsdSubServiceSessionLevelRef = Extended
                DcmDsdSubServiceSecurityLevelRef = Unlocked_L2
              OFF_Send (DcmDsdSubService):
                DcmDsdSubServiceId = 0x02
                DcmDsdSubServiceFnc = 
                DcmDsdSubServiceUsed = true
                DcmAddressModeFun = true
                DcmAddressModePhy = true
                Lock = true
                isUserDefine = false
                DcmDsdSubServiceSessionLevelRef = Extended
                DcmDsdSubServiceSecurityLevelRef = Unlocked_L2
            Service2E: DcmDsdSidTabSubfuncAvail=false, DcmDsdSidTabServiceId=0x2E, DcmAddressModeFun=false, ReqMsgMinLength=4, SupportSuppressPosRspBit=false, isUserDefine=true, DcmDsdSidTabSessionLevelRef=FactoryTest
      DcmDsl
        User (DcmDslCallbackDCMRequestService): DcmDslCallbackDCMRequestService=
        DslDiagResp (DcmDslDiagResp): DcmDslDiagRespMaxNumRespPend=4, DcmDslDiagRespOnSecondDeclinedRequest=false
        DslProtocol (DcmDslProtocol)
          DslProtocolRow0 (DcmDslProtocolRow):
            DcmDslProtocolType = DCM_UDS_ON_CAN
            DcmSendRespPendOnRestart = true
            DcmDslProtocolTransType = TYPE1
            DcmDslProtocolRowUsed = true
            DcmDslProtocolPriority = 1
            DcmDslProtocolMaximumResponseSize = 4095
            S3Server = 5000
            DcmTimStrP2ServerAdjust = 20
            DcmTimStrP2StarServerAdjust = 20
            DcmDspProtocolEcuAddr = 0x1234
            DcmDslProtocolRxBufferDepth = 2
            DcmDslProtocolRxBufferRef = Buffer_0
            DcmDslProtocolSIDTable = DsdServiceTable0
            DcmDslProtocolTxBufferRef = Buffer_0
            DcmDemClientRef = DemClient_0
            Dcm_DslConnection_BODY_LE1_CAN_Model_FunGroup0 (DcmDslConnection): FilePath=BODY_LE1_CAN, UserDefine=false
              DslMainConnection (DcmDslMainConnection): DcmDslProtocolRxTesterSourceAddr=0x1234, DcmDslProtocolRxConnectionId=0, DcmDslProtocolComMChannelRef=ComM_BODY_LE1_CAN
                Cfg_P_Rx_BODY_LE1_CAN_DIAG_REQ_AllECU (DcmDslProtocolRx):
                  DcmDslProtocolRxAddrType = DCM_FUNCTIONAL_TYPE
                  DcmDslProtocolRxPduId = 0
                  UserDefine = false
                  DcmDslProtocolRxPduRef = Cfg_P_Rx_BODY_LE1_CAN_DIAG_REQ_AllECU
                Cfg_P_Rx_BODY_LE1_CAN_DIAG_REQ_MCM_P (DcmDslProtocolRx): DcmDslProtocolRxAddrType=DCM_PHYSICAL_TYPE, DcmDslProtocolRxPduId=0, UserDefine=false, DcmDslProtocolRxPduRef=Cfg_P_Rx_BODY_LE1_CAN_DIAG_REQ_MCM_P
                Cfg_P_Tx_BODY_LE1_CAN_DIAG_RESP_MCM_P (DcmDslProtocolTx): DcmDslTxConfirmationPduId=0, UserDefine=false, DcmDslProtocolTxPduRef=Cfg_P_Tx_BODY_LE1_CAN_DIAG_RESP_MCM_P
        Buffer_0 (DcmDslBuffer): DcmDslBufferSize=1024
      DcmDsp:
        DcmDspDDDIDcheckPerSourceDID = false
        DcmDspDataDefaultEndianness = opaque
        DcmDspEnableObdMirror = false
        DcmDspMaxDidToRead = 1
        DcmDspMaxPeriodicDidToRead = 1
        DcmDspPowerDownTime = 0
        DspSession_DsdServiceTable0 (DcmDspSession)
          4 x DcmDspSessionRow, all with DcmDspSessionP2ServerMax=50, DcmDspSessionP2StarServerMax=2000:
            Default: DcmDspSessionForBoot=DCM_NO_BOOT, DcmDspSessionLevel=0x01, isUserDefine=false
            Programming: DcmDspSessionForBoot=DCM_OEM_BOOT, DcmDspSessionLevel=0x02, isUserDefine=false
            Extended: DcmDspSessionForBoot=DCM_NO_BOOT, DcmDspSessionLevel=0x03, isUserDefine=false
            FactoryTest: DcmDspSessionForBoot=DCM_NO_BOOT, DcmDspSessionLevel=0x66, isUserDefine=true
        DspSecurity_DsdServiceTable0 (DcmDspSecurity): DcmDspSecurityMaxAttemptCounterReadoutTime=2000, DcmDspSecurityResetAttemptCounterOnTimeout=false
          Unlocked_L2 (DcmDspSecurityRow):
            DcmDspSecurityADRSize = 0
            DcmDspSecurityDelayTime = 10000
            DcmDspSecurityDelayTimeOnBoot = 0
            DcmDspSecurityKeySize = 4
            DcmDspSecurityLevel = 0x2
            DcmDspSecurityNumAttDelay = 3
            DcmDspSecuritySeedSize = 4
            DcmDspSecurityCompareKeyFnc = CompareKey
            DcmDspSecurityCompareKeyFnc = CompareKey
            DcmDspSecurityGetSeedFnc = GetSeed
            DcmDspSecuritySetAttemptCounterFnc = SetSecurityAttemptCounter
            DcmDspSecurityUsePort = USE_ASYNCH_CLIENT_SERVER
            DcmDspSecurityAttemptCounterEnabled = true
            DcmDspSecurityKeyNumAttDelay = 2
            DcmDspSecuritySeedNumAttDelay = 3
            isUserDefine = false
        DspDatas_DsdServiceTable0 (DspDatas)
          20 x DcmDspData, all with DcmDspDataUsePort=USE_DATA_ASYNCH_CLIENT_SERVER_ERROR, DcmDspDataFreezeCurrentStateFnc=NULL_PTR, DcmDspDataReadDataLengthFnc=NULL_PTR, DcmDspDataResetToDefaultFnc=NULL_PTR, DcmDspDataReturnControlToEcuFnc=NULL_PTR, DcmDspDataShortTermAdjustmentFnc=NULL_PTR, DcmDspDataConditionCheckReadFnc=NULL_PTR, DcmDspDataConditionCheckReadFncUsed=false, DcmDspDataEcuSignal=NULL_PTR, DcmDspDataEndianness=opaque, DcmDspDataGetScalingInfoFnc=NULL_PTR, DcmDspDataReadEcuSignal=NULL_PTR, isCompData=false:
            DspData_0xF010_0: DcmDspDataType=UINT8_N, DcmDspDataByteSize=4, DcmDspDataReadFnc=Dcm_DataServices_0xF010_0_ReadData, DcmDspDataWriteFnc=NULL_PTR, isUserDefine=false
            DspData_0xF110_0: DcmDspDataType=UINT8_N, DcmDspDataByteSize=11, DcmDspDataReadFnc=Dcm_DataServices_0xF110_0_ReadData, DcmDspDataWriteFnc=NULL_PTR, isUserDefine=false
            DspData_0xF111_0: DcmDspDataType=UINT8_N, DcmDspDataByteSize=2, DcmDspDataReadFnc=Dcm_DataServices_0xF111_0_ReadData, DcmDspDataWriteFnc=NULL_PTR, isUserDefine=false
            DspData_0xF118_0: DcmDspDataType=UINT8_N, DcmDspDataByteSize=11, DcmDspDataReadFnc=Dcm_DataServices_0xF118_0_ReadData, DcmDspDataWriteFnc=NULL_PTR, isUserDefine=false
            DspData_0xF119_0: DcmDspDataType=UINT8_N, DcmDspDataByteSize=2, DcmDspDataReadFnc=Dcm_DataServices_0xF119_0_ReadData, DcmDspDataWriteFnc=NULL_PTR, isUserDefine=false
            DspData_0xF150_0: DcmDspDataType=UINT8_N, DcmDspDataByteSize=3, DcmDspDataReadFnc=Dcm_DataServices_0xF150_0_ReadData, DcmDspDataWriteFnc=NULL_PTR, isUserDefine=false
            DspData_0xF15B_0: DcmDspDataType=UINT8_N, DcmDspDataByteSize=12, DcmDspDataReadFnc=Dcm_DataServices_0xF15B_0_ReadData, DcmDspDataWriteFnc=NULL_PTR, isUserDefine=false
            DspData_0xF186_0: DcmDspDataType=UINT8, DcmDspDataByteSize=1, DcmDspDataReadFnc=Dcm_DataServices_0xF186_0_ReadData, DcmDspDataWriteFnc=NULL_PTR, isUserDefine=false
            DspData_0xF18A_0: DcmDspDataType=UINT8_N, DcmDspDataByteSize=8, DcmDspDataReadFnc=Dcm_DataServices_0xF18A_0_ReadData, DcmDspDataWriteFnc=NULL_PTR, isUserDefine=false
            DspData_0xF18B_0: DcmDspDataType=UINT8_N, DcmDspDataByteSize=3, DcmDspDataReadFnc=Dcm_DataServices_0xF18B_0_ReadData, DcmDspDataWriteFnc=Dcm_DataServices_0xF18B_0_WriteData, isUserDefine=false
            DspData_0xF18C_0: DcmDspDataType=UINT8_N, DcmDspDataByteSize=16, DcmDspDataReadFnc=Dcm_DataServices_0xF18C_0_ReadData, DcmDspDataWriteFnc=Dcm_DataServices_0xF18C_0_WriteData, isUserDefine=false
            DspData_0xF193_0: DcmDspDataType=UINT8_N, DcmDspDataByteSize=3, DcmDspDataReadFnc=Dcm_DataServices_0xF193_0_ReadData, DcmDspDataWriteFnc=NULL_PTR, isUserDefine=false
            DspData_0xF195_0: DcmDspDataType=UINT8_N, DcmDspDataByteSize=3, DcmDspDataReadFnc=Dcm_DataServices_0xF195_0_ReadData, DcmDspDataWriteFnc=NULL_PTR, isUserDefine=false
            DspData_0xF19E_0: DcmDspDataType=UINT8_N, DcmDspDataByteSize=3, DcmDspDataReadFnc=Dcm_DataServices_0xF19E_0_ReadData, DcmDspDataWriteFnc=NULL_PTR, isUserDefine=false
            DspData_0xFD{00..02}_0: DcmDspDataType=UINT8_N, DcmDspDataByteSize=3, DcmDspDataReadFnc=Dcm_DataServices_0xFD{00..02}_0_ReadData, DcmDspDataWriteFnc=NULL_PTR, isUserDefine=true
            DspData_0xFD03_0: DcmDspDataType=UINT8_N, DcmDspDataByteSize=2, DcmDspDataReadFnc=Dcm_DataServices_0xFD03_0_ReadData, DcmDspDataWriteFnc=NULL_PTR, isUserDefine=true
            DspData_0xFD05_0: DcmDspDataType=UINT8_N, DcmDspDataByteSize=6, DcmDspDataReadFnc=Dcm_DataServices_0xFD05_0_ReadData, DcmDspDataWriteFnc=NULL_PTR, isUserDefine=true
            DspData_0xFD06_0: DcmDspDataType=UINT8_N, DcmDspDataByteSize=8, DcmDspDataReadFnc=NULL_PTR, DcmDspDataWriteFnc=NULL_PTR, isUserDefine=true
        DspDidInfos_DsdServiceTable0 (DspDidInfos)
          20 x DcmDspDidInfo, all with DcmDspDidDynamicallyDefined=false, DcmDspDDDIDMaxElements=1:
            DidInfo_0xF010: isUserDefine=false
              DcmDspDidRead:
                Lock = true
                DcmAddressModePhy = true
                DcmAddressModeFun = true
                UserDefine = false
                DcmDspDidReadSecurityLevelRef = Unlocked_L2
                DcmDspDidReadSessionRef = Default
                DcmDspDidReadSessionRef = Extended
            DidInfo_0xF110: isUserDefine=false
              DcmDspDidRead:
                Lock = true
                DcmAddressModePhy = true
                DcmAddressModeFun = true
                UserDefine = false
                DcmDspDidReadSecurityLevelRef = Unlocked_L2
                DcmDspDidReadSessionRef = Default
                DcmDspDidReadSessionRef = Extended
            DidInfo_0xF111: isUserDefine=false
              DcmDspDidRead:
                Lock = true
                DcmAddressModePhy = true
                DcmAddressModeFun = true
                UserDefine = false
                DcmDspDidReadSecurityLevelRef = Unlocked_L2
                DcmDspDidReadSessionRef = Default
                DcmDspDidReadSessionRef = Extended
            DidInfo_0xF118: isUserDefine=false
              DcmDspDidRead:
                Lock = true
                DcmAddressModePhy = true
                DcmAddressModeFun = true
                UserDefine = false
                DcmDspDidReadSecurityLevelRef = Unlocked_L2
                DcmDspDidReadSessionRef = Default
                DcmDspDidReadSessionRef = Extended
            DidInfo_0xF119: isUserDefine=false
              DcmDspDidRead:
                Lock = true
                DcmAddressModePhy = true
                DcmAddressModeFun = true
                UserDefine = false
                DcmDspDidReadSecurityLevelRef = Unlocked_L2
                DcmDspDidReadSessionRef = Default
                DcmDspDidReadSessionRef = Extended
            DidInfo_0xF150: isUserDefine=false
              DcmDspDidRead:
                Lock = true
                DcmAddressModePhy = true
                DcmAddressModeFun = true
                UserDefine = false
                DcmDspDidReadSecurityLevelRef = Unlocked_L2
                DcmDspDidReadSessionRef = Default
                DcmDspDidReadSessionRef = Extended
            DidInfo_0xF15B: isUserDefine=false
              DcmDspDidRead:
                Lock = true
                DcmAddressModePhy = true
                DcmAddressModeFun = true
                UserDefine = false
                DcmDspDidReadSecurityLevelRef = Unlocked_L2
                DcmDspDidReadSessionRef = Default
                DcmDspDidReadSessionRef = Extended
            DidInfo_0xF186: isUserDefine=false
              DcmDspDidRead:
                Lock = true
                DcmAddressModePhy = true
                DcmAddressModeFun = true
                UserDefine = false
                DcmDspDidReadSecurityLevelRef = Unlocked_L2
                DcmDspDidReadSessionRef = Default
                DcmDspDidReadSessionRef = Extended
            DidInfo_0xF18A: isUserDefine=false
              DcmDspDidRead:
                Lock = true
                DcmAddressModePhy = true
                DcmAddressModeFun = true
                UserDefine = false
                DcmDspDidReadSecurityLevelRef = Unlocked_L2
                DcmDspDidReadSessionRef = Default
                DcmDspDidReadSessionRef = Extended
            DidInfo_0xF18B: isUserDefine=false
              DcmDspDidRead:
                Lock = true
                DcmAddressModePhy = true
                DcmAddressModeFun = true
                UserDefine = false
                DcmDspDidReadSecurityLevelRef = Unlocked_L2
                DcmDspDidReadSessionRef = Default
                DcmDspDidReadSessionRef = Extended
              DcmDspDidWrite:
                Lock = true
                DcmAddressModePhy = true
                DcmAddressModeFun = false
                UserDefine = true
                DcmDspDidWriteSecurityLevelRef = Unlocked_L2
                DcmDspDidWriteSessionRef = Extended
                DcmDspDidWriteSessionRef = FactoryTest
            DidInfo_0xF18C: isUserDefine=false
              DcmDspDidRead:
                Lock = true
                DcmAddressModePhy = true
                DcmAddressModeFun = true
                UserDefine = false
                DcmDspDidReadSecurityLevelRef = Unlocked_L2
                DcmDspDidReadSessionRef = Default
                DcmDspDidReadSessionRef = Extended
              DcmDspDidWrite:
                Lock = true
                DcmAddressModePhy = true
                DcmAddressModeFun = false
                UserDefine = true
                DcmDspDidWriteSecurityLevelRef = Unlocked_L2
                DcmDspDidWriteSessionRef = Extended
                DcmDspDidWriteSessionRef = FactoryTest
            DidInfo_0xF193: isUserDefine=false
              DcmDspDidRead:
                Lock = true
                DcmAddressModePhy = true
                DcmAddressModeFun = true
                UserDefine = false
                DcmDspDidReadSecurityLevelRef = Unlocked_L2
                DcmDspDidReadSessionRef = Default
                DcmDspDidReadSessionRef = Extended
            DidInfo_0xF195: isUserDefine=false
              DcmDspDidRead:
                Lock = true
                DcmAddressModePhy = true
                DcmAddressModeFun = true
                UserDefine = false
                DcmDspDidReadSecurityLevelRef = Unlocked_L2
                DcmDspDidReadSessionRef = Default
                DcmDspDidReadSessionRef = Extended
            DidInfo_0xF19E: isUserDefine=false
              DcmDspDidRead:
                Lock = true
                DcmAddressModePhy = true
                DcmAddressModeFun = true
                UserDefine = false
                DcmDspDidReadSecurityLevelRef = Unlocked_L2
                DcmDspDidReadSessionRef = Default
                DcmDspDidReadSessionRef = Extended
            DidInfo_0xFD00: isUserDefine=true
              DcmDspDidRead:
                Lock = true
                DcmAddressModePhy = true
                DcmAddressModeFun = true
                UserDefine = true
                DcmDspDidReadSecurityLevelRef = Unlocked_L2
                DcmDspDidReadSessionRef = Default
                DcmDspDidReadSessionRef = Extended
            DidInfo_0xFD01: isUserDefine=true
              DcmDspDidRead:
                Lock = true
                DcmAddressModePhy = true
                DcmAddressModeFun = true
                UserDefine = true
                DcmDspDidReadSecurityLevelRef = Unlocked_L2
                DcmDspDidReadSessionRef = Default
                DcmDspDidReadSessionRef = Extended
            DidInfo_0xFD02: isUserDefine=true
              DspDidRead (DcmDspDidRead):
                Lock = true
                DcmAddressModePhy = true
                DcmAddressModeFun = true
                UserDefine = true
                DcmDspDidReadSecurityLevelRef = Unlocked_L2
                DcmDspDidReadSessionRef = Default
                DcmDspDidReadSessionRef = Extended
            DidInfo_0xFD03: isUserDefine=true
              DcmDspDidRead:
                Lock = true
                DcmAddressModePhy = true
                DcmAddressModeFun = true
                UserDefine = true
                DcmDspDidReadSecurityLevelRef = Unlocked_L2
                DcmDspDidReadSessionRef = Default
                DcmDspDidReadSessionRef = Extended
            DidInfo_0xFD05: isUserDefine=true
              DcmDspDidRead:
                Lock = true
                DcmAddressModePhy = true
                DcmAddressModeFun = true
                UserDefine = true
                DcmDspDidReadSecurityLevelRef = Unlocked_L2
                DcmDspDidReadSessionRef = Default
                DcmDspDidReadSessionRef = Extended
            DidInfo_0xFD06: isUserDefine=true
              DcmDspDidRead:
                Lock = true
                DcmAddressModePhy = true
                DcmAddressModeFun = true
                UserDefine = true
                DcmDspDidReadSecurityLevelRef = Unlocked_L2
                DcmDspDidReadSessionRef = Default
                DcmDspDidReadSessionRef = Extended
        DspDids_DsdServiceTable0 (DspDids)
          20 x DcmDspDid, all with DcmDspDidUsed=true, DcmDspDidUsePort=USE_DATA_ELEMENT_SPECIFIC_INTERFACES, returnControlToECU=false, resetToDefault=false, freezeCurrentState=false, shortTermAdjustment=false, ReqOptionByteLength=0, RespOptionByteLength=0:
            DID_0xF010: DcmDspDidIdentifier=0xF010, DcmDspDidSize=0x4, isUserDefine=false, DcmDspDidInfoRef=DidInfo_0xF010, DcmDspDidRef=DID_0xF010
              DcmDspDidSignal_0xF010_0 (DcmDspDidSignal): DcmDspDidByteOffset=0, UserDefine=false, DcmDspDidDataRef=DspData_0xF010_0
            DID_0xF110: DcmDspDidIdentifier=0xF110, DcmDspDidSize=0xb, isUserDefine=false, DcmDspDidInfoRef=DidInfo_0xF110, DcmDspDidRef=DID_0xF110
              DcmDspDidSignal_0xF110_0 (DcmDspDidSignal): DcmDspDidByteOffset=0, UserDefine=false, DcmDspDidDataRef=DspData_0xF110_0
            DID_0xF111: DcmDspDidIdentifier=0xF111, DcmDspDidSize=0x2, isUserDefine=false, DcmDspDidInfoRef=DidInfo_0xF111, DcmDspDidRef=DID_0xF111
              DcmDspDidSignal_0xF111_0 (DcmDspDidSignal): DcmDspDidByteOffset=0, UserDefine=false, DcmDspDidDataRef=DspData_0xF111_0
            DID_0xF118: DcmDspDidIdentifier=0xF118, DcmDspDidSize=0xb, isUserDefine=false, DcmDspDidInfoRef=DidInfo_0xF118, DcmDspDidRef=DID_0xF118
              DcmDspDidSignal_0xF118_0 (DcmDspDidSignal): DcmDspDidByteOffset=0, UserDefine=false, DcmDspDidDataRef=DspData_0xF118_0
            DID_0xF119: DcmDspDidIdentifier=0xF119, DcmDspDidSize=0x2, isUserDefine=false, DcmDspDidInfoRef=DidInfo_0xF119, DcmDspDidRef=DID_0xF119
              DcmDspDidSignal_0xF119_0 (DcmDspDidSignal): DcmDspDidByteOffset=0, UserDefine=false, DcmDspDidDataRef=DspData_0xF119_0
            DID_0xF150: DcmDspDidIdentifier=0xF150, DcmDspDidSize=0x3, isUserDefine=false, DcmDspDidInfoRef=DidInfo_0xF150, DcmDspDidRef=DID_0xF150
              DcmDspDidSignal_0xF150_0 (DcmDspDidSignal): DcmDspDidByteOffset=0, UserDefine=false, DcmDspDidDataRef=DspData_0xF150_0
            DID_0xF15B: DcmDspDidIdentifier=0xF15B, DcmDspDidSize=0xc, isUserDefine=false, DcmDspDidInfoRef=DidInfo_0xF15B, DcmDspDidRef=DID_0xF15B
              DcmDspDidSignal_0xF15B_0 (DcmDspDidSignal): DcmDspDidByteOffset=0, UserDefine=false, DcmDspDidDataRef=DspData_0xF15B_0
            DID_0xF186: DcmDspDidIdentifier=0xF186, DcmDspDidSize=0x1, isUserDefine=false, DcmDspDidInfoRef=DidInfo_0xF186, DcmDspDidRef=DID_0xF186
              DcmDspDidSignal_0xF186_0 (DcmDspDidSignal): DcmDspDidByteOffset=0, UserDefine=false, DcmDspDidDataRef=DspData_0xF186_0
            DID_0xF18A: DcmDspDidIdentifier=0xF18A, DcmDspDidSize=0x8, isUserDefine=false, DcmDspDidInfoRef=DidInfo_0xF18A, DcmDspDidRef=DID_0xF18A
              DcmDspDidSignal_0xF18A_0 (DcmDspDidSignal): DcmDspDidByteOffset=0, UserDefine=false, DcmDspDidDataRef=DspData_0xF18A_0
            DID_0xF18B: DcmDspDidIdentifier=0xF18B, DcmDspDidSize=0x3, isUserDefine=false, DcmDspDidInfoRef=DidInfo_0xF18B, DcmDspDidRef=DID_0xF18B
              DcmDspDidSignal_0xF18B_0 (DcmDspDidSignal): DcmDspDidByteOffset=0, UserDefine=false, DcmDspDidDataRef=DspData_0xF18B_0
            DID_0xF18C: DcmDspDidIdentifier=0xF18C, DcmDspDidSize=0x10, isUserDefine=false, DcmDspDidInfoRef=DidInfo_0xF18C, DcmDspDidRef=DID_0xF18C
              DcmDspDidSignal_0xF18C_0 (DcmDspDidSignal): DcmDspDidByteOffset=0, UserDefine=false, DcmDspDidDataRef=DspData_0xF18C_0
            DID_0xF193: DcmDspDidIdentifier=0xF193, DcmDspDidSize=0x3, isUserDefine=false, DcmDspDidInfoRef=DidInfo_0xF193, DcmDspDidRef=DID_0xF193
              DcmDspDidSignal_0xF193_0 (DcmDspDidSignal): DcmDspDidByteOffset=0, UserDefine=false, DcmDspDidDataRef=DspData_0xF193_0
            DID_0xF195: DcmDspDidIdentifier=0xF195, DcmDspDidSize=0x3, isUserDefine=false, DcmDspDidInfoRef=DidInfo_0xF195, DcmDspDidRef=DID_0xF195
              DcmDspDidSignal_0xF195_0 (DcmDspDidSignal): DcmDspDidByteOffset=0, UserDefine=false, DcmDspDidDataRef=DspData_0xF195_0
            DID_0xF19E: DcmDspDidIdentifier=0xF19E, DcmDspDidSize=0x3, isUserDefine=false, DcmDspDidInfoRef=DidInfo_0xF19E, DcmDspDidRef=DID_0xF19E
              DcmDspDidSignal_0xF19E_0 (DcmDspDidSignal): DcmDspDidByteOffset=0, UserDefine=false, DcmDspDidDataRef=DspData_0xF19E_0
            DID_0xFD00: DcmDspDidIdentifier=0xFD00, DcmDspDidSize=0x3, isUserDefine=true, DcmDspDidInfoRef=DidInfo_0xFD00, DcmDspDidRef=DID_0xFD00
              DcmDspDidSignal_0xFD00_0 (DcmDspDidSignal): DcmDspDidByteOffset=0, UserDefine=true, DcmDspDidDataRef=DspData_0xFD00_0
            DID_0xFD01: DcmDspDidIdentifier=0xFD01, DcmDspDidSize=0x3, isUserDefine=true, DcmDspDidInfoRef=DidInfo_0xFD01, DcmDspDidRef=DID_0xFD01
              DcmDspDidSignal_0xFD01_0 (DcmDspDidSignal): DcmDspDidByteOffset=0, UserDefine=true, DcmDspDidDataRef=DspData_0xFD01_0
            DID_0xFD02: DcmDspDidIdentifier=0xFD02, DcmDspDidSize=0x3, isUserDefine=true, DcmDspDidInfoRef=DidInfo_0xFD02, DcmDspDidRef=DID_0xFD02
              DcmDspDidSignal_0xFD02_0 (DcmDspDidSignal): DcmDspDidByteOffset=0, UserDefine=true, DcmDspDidDataRef=DspData_0xFD02_0
            DID_0xFD03: DcmDspDidIdentifier=0xFD03, DcmDspDidSize=0x2, isUserDefine=true, DcmDspDidInfoRef=DidInfo_0xFD03, DcmDspDidRef=DID_0xFD03
              DcmDspDidSignal_0xFD03_0 (DcmDspDidSignal): DcmDspDidByteOffset=0, UserDefine=true, DcmDspDidDataRef=DspData_0xFD03_0
            DID_0xFD05: DcmDspDidIdentifier=0xFD05, DcmDspDidSize=0x6, isUserDefine=true, DcmDspDidInfoRef=DidInfo_0xFD05, DcmDspDidRef=DID_0xFD05
              DcmDspDidSignal_0xFD05_0 (DcmDspDidSignal): DcmDspDidByteOffset=0, UserDefine=true, DcmDspDidDataRef=DspData_0xFD05_0
            DID_0xFD06: DcmDspDidIdentifier=, DcmDspDidSize=0x8, isUserDefine=true, DcmDspDidRef=DID_0xFD06
              DcmDspDidSignal_0xFD06_0 (DcmDspDidSignal): DcmDspDidByteOffset=0, UserDefine=true, DcmDspDidDataRef=DspData_0xFD06_0
        DspRoutines_DsdServiceTable0 (DspRoutines)
          4 x DcmDspRoutine, all with DcmDspRoutineUsePort=true, DcmDspRoutineUsed=true, DcmDspRoutineInfoByte=0x0, DcmDspRoutineFncSignature=ROUTINE_FNC_NORMAL:
            DspRoutine0x0203: DcmDspRoutineIdentifier=0x0203, isUserDefine=false
              DspRoutine0x0203_Start (DcmDspStartRoutine):
                DcmDspStartRoutineFnc = Dcm_RoutineServices_0x0203_Start
                P4ServerMax = 0
                DcmDspRoutineInterfaceArgumentIntegrity = false
                DcmDspStartRoutineConfirmationEnabled = false
                DcmDspStartRoutineConfirmationFnc = 
                isUserDefine = false
                DcmDspStartRoutineCommonAuthorizationRef = DspRoutine0x0203_Start
                DspStartRoutineOut (DcmDspStartRoutineOut)
                  DspRoutine0x0203_StartOutSignal (DcmDspStartRoutineOutSignal): DcmDspRoutineSignalType=UINT8, DcmDspRoutineParameterSize=1, DcmDspRoutineSignalPos=0, DcmDspRoutineSignalEndianness=opaque
            DspRoutine0xFD04: DcmDspRoutineIdentifier=0xFD04, isUserDefine=true
              DspRoutine0xFD04_Start (DcmDspStartRoutine):
                DcmDspStartRoutineFnc = Dcm_RoutineServices_0xFD04_Start
                P4ServerMax = 0
                DcmDspRoutineInterfaceArgumentIntegrity = false
                DcmDspStartRoutineConfirmationEnabled = false
                DcmDspStartRoutineConfirmationFnc = 
                isUserDefine = true
                DcmDspStartRoutineCommonAuthorizationRef = DspRoutine0xFD04
                DspStartRoutineIn (DcmDspStartRoutineIn)
                  DspRoutine0xFD04_StartInSignal (DcmDspStartRoutineInSignal): DcmDspRoutineSignalType=VARIABLE_LENGTH, DcmDspRoutineParameterSize=4, DcmDspRoutineSignalPos=0, DcmDspRoutineSignalEndianness=opaque
                DspStartRoutineOut (DcmDspStartRoutineOut)
                  DspRoutine0xFD04_StartOutSignal (DcmDspStartRoutineOutSignal): DcmDspRoutineSignalType=UINT32, DcmDspRoutineParameterSize=4, DcmDspRoutineSignalPos=0, DcmDspRoutineSignalEndianness=opaque
              DspRoutine0xFD04_Stop (DcmDspStopRoutine):
                DcmDspStopRoutineFnc = Dcm_RoutineServices_0xFD04_Stop
                P4ServerMax = 0
                DcmDspRoutineInterfaceArgumentIntegrity = false
                DcmDspStopRoutineConfirmationEnabled = false
                DcmDspStopRoutineConfirmationFnc = 
                isUserDefine = true
                DcmDspStopRoutineCommonAuthorizationRef = DspRoutine0xFD04
                DspStopRoutineIn (DcmDspRoutineStopIn)
                  DspRoutine0xFD04_StopInSignal (DcmDspRoutineStopInSignal): DcmDspRoutineSignalType=VARIABLE_LENGTH, DcmDspRoutineParameterSize=3, DcmDspRoutineSignalPos=0, DcmDspRoutineSignalEndianness=opaque
                DspStopRoutineOut (DcmDspRoutineStopOut)
                  DspRoutine0xFD04_StopOutSignal (DcmDspRoutineStopOutSignal): DcmDspRoutineSignalType=VARIABLE_LENGTH, DcmDspRoutineParameterSize=3, DcmDspRoutineSignalPos=0, DcmDspRoutineSignalEndianness=opaque
            DspRoutine0xFD05: DcmDspRoutineIdentifier=0xFD05, isUserDefine=true
              DspRoutine0xFD05_Start (DcmDspStartRoutine):
                DcmDspStartRoutineFnc = Dcm_RoutineServices_0xFD05_Start
                P4ServerMax = 0
                DcmDspRoutineInterfaceArgumentIntegrity = false
                DcmDspStartRoutineConfirmationEnabled = false
                DcmDspStartRoutineConfirmationFnc = 
                isUserDefine = true
                DcmDspStartRoutineCommonAuthorizationRef = DspRoutine0xFD05
                DspStartRoutineIn (DcmDspStartRoutineIn)
                  DspRoutine0xFD05_StartInSignal (DcmDspStartRoutineInSignal): DcmDspRoutineSignalType=VARIABLE_LENGTH, DcmDspRoutineParameterSize=2, DcmDspRoutineSignalPos=0, DcmDspRoutineSignalEndianness=opaque
                DspStartRoutineOut (DcmDspStartRoutineOut)
                  DspRoutine0xFD05_StartOutSignal (DcmDspStartRoutineOutSignal): DcmDspRoutineSignalType=VARIABLE_LENGTH, DcmDspRoutineParameterSize=2, DcmDspRoutineSignalPos=0, DcmDspRoutineSignalEndianness=opaque
            DspRoutine0xFD10: DcmDspRoutineIdentifier=0xFD10, isUserDefine=true
              DspRoutine0xFD10_Start (DcmDspStartRoutine):
                DcmDspStartRoutineFnc = Dcm_RoutineServices_0xFD10_Start
                P4ServerMax = 0
                DcmDspRoutineInterfaceArgumentIntegrity = false
                DcmDspStartRoutineConfirmationEnabled = false
                DcmDspStartRoutineConfirmationFnc = 
                isUserDefine = true
                DcmDspStartRoutineCommonAuthorizationRef = DspRoutine0xFD10
        DspCommonAuthorizations_DsdServiceTable0 (DspCommonAuthorizations)
          4 x DcmDspCommonAuthorization, all with DcmAddressModePhy=true, DcmAddressModeFun=false, Lock=true, DcmDspSecurityLevelRef=Unlocked_L2:
            DspRoutine0x0203_Start: isUserDefine=false, DcmDspSessionRef=Extended
            DspRoutine0xFD04: isUserDefine=true, DcmDspSessionRef=FactoryTest
            DspRoutine0xFD05: isUserDefine=true, DcmDspSessionRef=FactoryTest
            DspRoutine0xFD10: isUserDefine=true, DcmDspSessionRef=FactoryTest
        DspPids_DsdServiceTable0 (DspPids)
        DspRequestControls_DsdServiceTable0 (DcmDspRequestControls)
        DspVehInfos_DsdServiceTable0 (DcmDspVehInfos)
        DspComControl_DsdServiceTable0 (DcmDspComControl): isUserDefine=false
          ComM_BODY_LE1_CAN (DcmDspComControlAllChanne): DcmDspComControlAllChannelUsed=true, isUserDefine=false, DcmDspAllComMChannelRef=ComM_BODY_LE1_CAN
        DspMemory_DsdServiceTable0 (DcmDspMemory): isUserDefine=false
          DspMemoryIdInfo (DcmDspMemoryIdInfo): DcmDspMemoryIdValue=0
        DspEcuReset_DsdServiceTable0 (DspEcuReset)
          HardReset_Reset (DcmDspEcuResetRow): DcmDspEcuResetId=0x01, DcmResponseToEcuReset=BEFORE_RESET, isUserDefine=false
          Soft_Reset_Reset (DcmDspEcuResetRow): DcmDspEcuResetId=0x03, DcmResponseToEcuReset=BEFORE_RESET, isUserDefine=false
        DspControlDTCSetting (DcmDspControlDTCSetting): DcmSupportDTCSettingControlOptionRecord=true, isUserDefine=false
        DspReadDTCInformation (DcmDspReadDTCInformation): DcmDspReadDTCInformationSupportedObdUdsDtcSeparation=false
  module config Dem: implementation-config-variant=STD_CONFIG_VARIANTS_POSTBUILD, module_version_def=4.2.0, module_autosar_version=Ar470
    DemGeneral:
      VersionCheck = true
      DemDebounceCounterBasedSupport = true
      DemDebounceTimeBasedSupport = true
      DemDevErrorDetect = false
      DemOBDSupport = DEM_OBD_NO_OBD_SUPPORT
      DemPTOSupport = false
      DemStatusBitStorageTestFailed = false
      DemTriggerFiMReports = false
      DemTriggerMonitorInitBeforeClearOk = false
      DemVersionInfoApi = true
      DemAgingRequieresTestedCycle = true
      DemGeneralInterfaceSupport = false
      DemResetConfirmedBitOnOverflow = true
      DemClearDTCBehavior = DEM_CLRRESP_VOLATILE
      DemEventCombinationSupport = DEM_EVCOMB_DISABLED
      DemStatusBitHandlingTestFailedSinceLastClear = DEM_STATUS_BIT_AGING_AND_DISPLACEMENT
      DemSuppressionSupport = DEM_NO_SUPPRESSION
      DemAvailabilitySupport = DEM_NO_AVAILABILITY
      DemClearDTCLimitation = DEM_ALL_SUPPORTED_DTCS
      DemDataElementDefaultEndianness = opaque
      DemBswErrorBufferSize = 8
      DemMaxNumberPrestoredFF = 0
      DemTaskTime = 10
      MaxNumCaptureDataPerMainCycle = 4
      DemHeaderFileInclusion = 
      DemCmaPlatformEnable = false
      DemNvMSupport = true
      DemDTCLastStatusSupport = false
      DemAgingRequiresNotFailedCycle = false
      DemGeneralCallbackMonitorStatusChangedFnc = 
      DemMultiCoreSupport = false
      DemCoreNumber = 1
      DemMasterCoreId = 0
      OperationCycle_DEM_IGNITION (DemOperationCycle): DemOperationCycleId=0
      OperationCycle_DEM_WARMUP (DemOperationCycle): DemOperationCycleId=1
      12 x DemEnableCondition, all with DemEnableConditionStatus=false:
        PowerVoltage_9V_16V: DemEnableConditionId=0
        ECU_ActiveStatus: DemEnableConditionId=1
        AfterPowerIGN_1s: DemEnableConditionId=2
        EnteringNetworkModeFor3s: DemEnableConditionId=3
        NotInBusoffStatus: DemEnableConditionId=4
        StopMonitoringImmediatelyWhenNotInNetworkMode: DemEnableConditionId=5
        VehState_Driving_or_DrvRdy_for_3seconds: DemEnableConditionId=6
        TheValveIStarted: DemEnableConditionId=7
        TheAirPumpIsStarted: DemEnableConditionId=8
        TheHeatorIStarted: DemEnableConditionId=9
        IGNPowerOn: DemEnableConditionId=10
        OnlyDracoHorizonVersion: DemEnableConditionId=11
      9 x DemEnableConditionGroup:
        DECG_C00B88: DemEnableConditionRef=PowerVoltage_9V_16V, DemEnableConditionRef=ECU_ActiveStatus
        DECG_800117_800116: DemEnableConditionRef=AfterPowerIGN_1s
        DECG_F3A987_F3B287_F1D387_F1D487: DemEnableConditionRef=PowerVoltage_9V_16V, DemEnableConditionRef=VehState_Driving_or_DrvRdy_for_3seconds, DemEnableConditionRef=NotInBusoffStatus
        DECG_9D0119_9D0218: DemEnableConditionRef=TheValveIStarted, DemEnableConditionRef=IGNPowerOn
        DECG_9D0319_9D0418: DemEnableConditionRef=TheAirPumpIsStarted, DemEnableConditionRef=IGNPowerOn
        DECG_9C0119_9C0218: DemEnableConditionRef=TheHeatorIStarted, DemEnableConditionRef=IGNPowerOn
        DECG_9C0311_9C0415_9D0511_9D0615: DemEnableConditionRef=IGNPowerOn
        DECG_9C0511_9C0615: DemEnableConditionRef=IGNPowerOn, DemEnableConditionRef=OnlyDracoHorizonVersion
        DECG_F13C87: DemEnableConditionRef=PowerVoltage_9V_16V, DemEnableConditionRef=EnteringNetworkModeFor3s, DemEnableConditionRef=NotInBusoffStatus, DemEnableConditionRef=StopMonitoringImmediatelyWhenNotInNetworkMode
      DemEventMemorySet_0 (DemEventMemorySet): DemMaxNumberEventEntryPermanent=0, DemTypeOfDTCSupported=DEM_DTC_TRANSLATION_ISO15031_6
        DemPrimaryMemory:
          UserDefine = false
          DemMaxNumberEventEntryPrimary = 20
          DemEventDisplacementStrategy = DEM_DISPLACEMENT_NONE
          DemEventMemoryEntryStorageTrigger = DEM_TRIGGER_ON_TEST_FAILED
          DemOccurrenceCounterProcessing = DEM_PROCESS_OCCCTR_TF
          DemTypeOfFreezeFrameRecordNumeration = DEM_FF_RECNUM_CONFIGURED
          DemDtcStatusAvailabilityMask = 0x9
          20 x DemEventEntryBlock:
            DemEventEntryBlock{0..19}: DemEventEntryBlockRef=NVM_PrimaryDataEntry_0_{0..19}
      DemClient_0 (DemClient): DemClientFunctionality=DEM_CLIENT_USES_FULL_FUNCTIONALITY, DemClientId=0, DemClientUsesRte=true, DemEventMemorySetRef=DemEventMemorySet_0
      10 x DemDataElementClass, all with UserDefine=true:
        DataElement0_OCC
          DataElement0_OCC_InternalData0 (DemInternalDataElementClass): DemInternalDataElement=DEM_OCCCTR, DemDataElementDataSize=1
        DataElement1_Year
          DataElement1_Year_ExternalCSData (DemExternalCSDataElementClass):
            DemDataElementUsePort = true
            DemDataElementReadFnc = ReadDataElement
            DemDataElementArraySize = 1
            DemDataElementDataType = UINT8
            DemDataElementProvideMonitorData = false
        DataElement2_Month
          DataElement2_Month_ExternalCSData (DemExternalCSDataElementClass):
            DemDataElementUsePort = true
            DemDataElementReadFnc = ReadDataElement
            DemDataElementArraySize = 1
            DemDataElementDataType = UINT8
            DemDataElementProvideMonitorData = false
        DataElement3_Day
          DataElement3_Day_ExternalCSData0 (DemExternalCSDataElementClass):
            DemDataElementUsePort = true
            DemDataElementReadFnc = ReadDataElement
            DemDataElementArraySize = 1
            DemDataElementDataType = UINT8
            DemDataElementProvideMonitorData = false
        DataElement4_Hour
          DataElement4_Hour_ExternalCSData0 (DemExternalCSDataElementClass):
            DemDataElementUsePort = true
            DemDataElementReadFnc = ReadDataElement
            DemDataElementArraySize = 1
            DemDataElementDataType = UINT8
            DemDataElementProvideMonitorData = false
        DataElement5_Minute
          DataElement5_Minute_ExternalCSData0 (DemExternalCSDataElementClass):
            DemDataElementUsePort = true
            DemDataElementReadFnc = ReadDataElement
            DemDataElementArraySize = 1
            DemDataElementDataType = UINT8
            DemDataElementProvideMonitorData = false
        DataElement6_Second
          DataElement6_Second_ExternalCSData0 (DemExternalCSDataElementClass):
            DemDataElementUsePort = true
            DemDataElementReadFnc = ReadDataElement
            DemDataElementArraySize = 1
            DemDataElementDataType = UINT8
            DemDataElementProvideMonitorData = false
        DataElement7_Odometer
          DataElement7_Odometer_ExternalCSData0 (DemExternalCSDataElementClass):
            DemDataElementUsePort = true
            DemDataElementReadFnc = ReadDataElement
            DemDataElementArraySize = 3
            DemDataElementDataType = UINT8_N
            DemDataElementProvideMonitorData = false
        DataElement8_LV_Battery_Voltage
          DataElement8_LV_Battery_Voltage_ExternalCSData0 (DemExternalCSDataElementClass):
            DemDataElementUsePort = true
            DemDataElementReadFnc = ReadDataElement
            DemDataElementArraySize = 1
            DemDataElementDataType = UINT8
            DemDataElementProvideMonitorData = false
        DataElement9_VehicleSpeed
          DataElement9_VehicleSpeed_ExternalCSData0 (DemExternalCSDataElementClass):
            DemDataElementUsePort = true
            DemDataElementReadFnc = ReadDataElement
            DemDataElementArraySize = 2
            DemDataElementDataType = UINT8_N
            DemDataElementProvideMonitorData = false
      DemExtendedDataRecordClass0 (DemExtendedDataRecordClass):
        DemExtendedDataRecordNumber = 0x1
        DemExtendedDataRecordUpdate = DEM_UPDATE_RECORD_NO
        DemExtendedDataRecordTrigger = DEM_TRIGGER_ON_CONFIRMED
        UserDefine = true
        DemDataElementClassRef = DataElement0_OCC_InternalData0
        DemDataElementClassRef = DataElement1_Year_ExternalCSData
        DemDataElementClassRef = DataElement2_Month_ExternalCSData
        DemDataElementClassRef = DataElement3_Day_ExternalCSData0
        DemDataElementClassRef = DataElement4_Hour_ExternalCSData0
        DemDataElementClassRef = DataElement5_Minute_ExternalCSData0
        DemDataElementClassRef = DataElement6_Second_ExternalCSData0
        DemDataElementClassRef = DataElement7_Odometer_ExternalCSData0
        DemDataElementClassRef = DataElement8_LV_Battery_Voltage_ExternalCSData0
        DemDataElementClassRef = DataElement9_VehicleSpeed_ExternalCSData0
      DemExtendedDataClass0 (DemExtendedDataClass): DemExtendedDataRecordClassRef=DemExtendedDataRecordClass0
      NVM_BLOCKID (DemNvRamBlockId): DemNvRamBlockIdRef=NVM_Dem_StorageMem
      DemGeneralJ1939:
        DemJ1939ClearDtcSupport = false
        DemJ1939Dm31Support = false
        DemJ1939ExpandedFreezeFrameSupport = false
        DemJ1939FreezeFrameSupport = false
        DemJ1939RatioSupport = false
        DemJ1939Readiness{1..3}Support = false
        DemJ1939ReadingDtcSupport = false
        DTCStatus (DemCallbackJ1939DTCStatusChanged): DemCallbackDTCStatusChangedFnc=CallbackDTCStatusChange
      DemGeneralOBD:
        UserDefine = false
        DemOBDCentralizedPID21Handling = false
        DemOBDCentralizedPID31Handling = false
        DemOBDCompliancy = 0
        DemOBDEngineType = DEM_IGNITION_COMPRESSION
        DemOBDEventDisplacement = false
        DemSupportedObdUdsDtcSeparation = false
        DemOBDDelayedDCYConfirmedAndMIL = false
    Cfg_D (DemConfigSet): UserDefine=false
      DemDTCClassTable_0 (DemDTC)
        20 x DemDTCRow, all with DemDTCSeverity=DEM_SEVERITY_NO_SEVERITY, DemDTCFunctionalUnit=0, DemWWHOBDDTCClass=DEM_DTC_WWHOBD_CLASS_C, DemNvStorageStrategy=DURING_SHUTDOWN, UserDefine=false:
          DTC_0x800116: DemDtcValue=0x800116, DemDTCAttributesRef=DemDTCAttribute_0
          DTC_0x800117: DemDtcValue=0x800117, DemDTCAttributesRef=DemDTCAttribute_0
          DTC_0x9C0119: DemDtcValue=0x9C0119, DemDTCAttributesRef=DemDTCAttribute_0
          DTC_0x9C0218: DemDtcValue=0x9C0218, DemDTCAttributesRef=DemDTCAttribute_0
          DTC_0x9C0311: DemDtcValue=0x9C0311, DemDTCAttributesRef=DemDTCAttribute_0
          DTC_0x9C0415: DemDtcValue=0x9C0415, DemDTCAttributesRef=DemDTCAttribute_0
          DTC_0x9C0511: DemDtcValue=0x9C0511, DemDTCAttributesRef=DemDTCAttribute_0
          DTC_0x9C0615: DemDtcValue=0x9C0615, DemDTCAttributesRef=DemDTCAttribute_0
          DTC_0x9D0119: DemDtcValue=0x9D0119, DemDTCAttributesRef=DemDTCAttribute_0
          DTC_0x9D0218: DemDtcValue=0x9D0218, DemDTCAttributesRef=DemDTCAttribute_0
          DTC_0x9D0319: DemDtcValue=0x9D0319, DemDTCAttributesRef=DemDTCAttribute_0
          DTC_0x9D0418: DemDtcValue=0x9D0418, DemDTCAttributesRef=DemDTCAttribute_0
          DTC_0x9D0511: DemDtcValue=0x9D0511, DemDTCAttributesRef=DemDTCAttribute_0
          DTC_0x9D0615: DemDtcValue=0x9D0615, DemDTCAttributesRef=DemDTCAttribute_0
          DTC_0xC00B88: DemDtcValue=0xC00B88, DemDTCAttributesRef=DemDTCAttribute_0
          DTC_0xF13C87: DemDtcValue=0xF13C87, DemDTCAttributesRef=DemDTCAttribute_0
          DTC_0xF1D187: DemDtcValue=0xF1D187, DemDTCAttributesRef=DemDTCAttributes1
          DTC_0xF1D287: DemDtcValue=0xF1D287, DemDTCAttributesRef=DemDTCAttributes1
          DTC_0xF3A987: DemDtcValue=0xF3A987, DemDTCAttributesRef=DemDTCAttribute_0
          DTC_0xF3B287: DemDtcValue=0xF3B287, DemDTCAttributesRef=DemDTCAttribute_0
      DemDTCAttribute_0 (DemDTCAttributes):
        DemDTCSignificance = FAULT
        DemAgingCycleCounterThreshold = 40
        DemAgingCycleCounterThresholdForTFSLC = 1
        DemDTCPriority = 1
        DemMaxNumberFreezeFrameRecords = 0
        DemAgingCycleRef = OperationCycle_DEM_IGNITION
        DemExtendedDataClassRef = DemExtendedDataClass0
        DemMemoryDestinationRef = DemPrimaryMemory
      DemDTCAttributes1 (DemDTCAttributes):
        DemDTCSignificance = FAULT
        DemAgingCycleCounterThreshold = 40
        DemAgingCycleCounterThresholdForTFSLC = 1
        DemDTCPriority = 1
        DemMaxNumberFreezeFrameRecords = 0
        DemAgingCycleRef = OperationCycle_DEM_WARMUP
        DemExtendedDataClassRef = DemExtendedDataClass0
        DemMemoryDestinationRef = DemPrimaryMemory
      DemEventParameterTable_0 (DemEventParameter)
        20 x DemEventParameterRow, all with DemEventAvailable=true, DemFFPrestorageSupported=false, DemEventKind=DEM_EVENT_KIND_SWC, DemReportBehavior=REPORT_AFTER_INIT, DemComponentPriority=0, CallbackClearEventAllowedEnable=false, CallbackInitMForEEnable=false, CallbackEventDataChangedEnable=false, CallbackEventUdsStatusChangedEnable=false, CallbackMonitorStatusChangedEnable=false, DemEventConfirmationThreshold=1, DemCausalityDelayTime=0, DemEventRecoverableInSameOperationCycle=true, DemFFPrestorageInNvm=false, DemEventReportingType=STANDARD_REPORTING, DemEventAvailableInVariant=true, DemEventAssociatedIdentification=0, DemEventConfirmationThresholdCounterAdaptable=false, DemOperationCycleRef=OperationCycle_DEM_IGNITION:
          Event_0x800116: DemEventId=0, DemDTCRef=DTC_0x800116, DemEnableConditionGroupRef=DECG_800117_800116
            DemDebounceAlgorithmClass: DemCallbackGetFDCFnc=false, DemDebounceTimeBaseRef=DemDebounceTimeBaseClass1_1000ms_1000ms
          Event_0x800117: DemEventId=1, DemDTCRef=DTC_0x800117, DemEnableConditionGroupRef=DECG_800117_800116
            DemDebounceAlgorithmClass: DemCallbackGetFDCFnc=false, DemDebounceTimeBaseRef=DemDebounceTimeBaseClass1_1000ms_1000ms
          Event_0x9C0119: DemEventId=2, DemDTCRef=DTC_0x9C0119, DemEnableConditionGroupRef=DECG_9D0119_9D0218
            DemDebounceAlgorithmClass: DemCallbackGetFDCFnc=false, DemDebounceTimeBaseRef=DemDebounceTimeBaseClass2_1000ms_0ms
          Event_0x9C0218: DemEventId=3, DemDTCRef=DTC_0x9C0218, DemEnableConditionGroupRef=DECG_9D0119_9D0218
            DemDebounceAlgorithmClass: DemCallbackGetFDCFnc=false, DemDebounceTimeBaseRef=DemDebounceTimeBaseClass3_1000ms_2000ms
          Event_0x9C0311: DemEventId=4, DemDTCRef=DTC_0x9C0311, DemEnableConditionGroupRef=DECG_9C0311_9C0415_9D0511_9D0615
            DemDebounceAlgorithmClass: DemCallbackGetFDCFnc=false, DemDebounceTimeBaseRef=DemDebounceTimeBaseClass4_40000ms_2000ms
          Event_0x9C0415: DemEventId=5, DemDTCRef=DTC_0x9C0415, DemEnableConditionGroupRef=DECG_9C0311_9C0415_9D0511_9D0615
            DemDebounceAlgorithmClass: DemCallbackGetFDCFnc=false, DemDebounceTimeBaseRef=DemDebounceTimeBaseClass4_40000ms_2000ms
          Event_0x9C0511: DemEventId=6, DemDTCRef=DTC_0x9C0511, DemEnableConditionGroupRef=DECG_9C0311_9C0415_9D0511_9D0615
            DemDebounceAlgorithmClass: DemCallbackGetFDCFnc=false, DemDebounceTimeBaseRef=DemDebounceTimeBaseClass5_0ms_2000ms
          Event_0x9C0615: DemEventId=7, DemDTCRef=DTC_0x9C0615, DemEnableConditionGroupRef=DECG_9C0311_9C0415_9D0511_9D0615
            DemDebounceAlgorithmClass: DemCallbackGetFDCFnc=false, DemDebounceTimeBaseRef=DemDebounceTimeBaseClass5_0ms_2000ms
          Event_0x9D0119: DemEventId=8, DemDTCRef=DTC_0x9D0119, DemEnableConditionGroupRef=DECG_9D0119_9D0218
            DemDebounceAlgorithmClass: DemCallbackGetFDCFnc=false, DemDebounceTimeBaseRef=DemDebounceTimeBaseClass2_1000ms_0ms
          Event_0x9D0218: DemEventId=9, DemDTCRef=DTC_0x9D0218, DemEnableConditionGroupRef=DECG_9D0119_9D0218
            DemDebounceAlgorithmClass: DemCallbackGetFDCFnc=false, DemDebounceTimeBaseRef=DemDebounceTimeBaseClass2_1000ms_0ms
          Event_0x9D0319: DemEventId=10, DemDTCRef=DTC_0x9D0319, DemEnableConditionGroupRef=DECG_9D0319_9D0418
            DemDebounceAlgorithmClass: DemCallbackGetFDCFnc=false, DemDebounceTimeBaseRef=DemDebounceTimeBaseClass2_1000ms_0ms
          Event_0x9D0418: DemEventId=11, DemDTCRef=DTC_0x9D0418, DemEnableConditionGroupRef=DECG_9D0319_9D0418
            DemDebounceAlgorithmClass: DemCallbackGetFDCFnc=false, DemDebounceTimeBaseRef=DemDebounceTimeBaseClass2_1000ms_0ms
          Event_0x9D0511: DemEventId=12, DemDTCRef=DTC_0x9D0511, DemEnableConditionGroupRef=DECG_9C0511_9C0615
            DemDebounceAlgorithmClass: DemCallbackGetFDCFnc=true
          Event_0x9D0615: DemEventId=13, DemDTCRef=DTC_0x9D0615, DemEnableConditionGroupRef=DECG_9C0511_9C0615
            DemDebounceAlgorithmClass: DemCallbackGetFDCFnc=true
          Event_0xC00B88: DemEventId=14, DemDTCRef=DTC_0xC00B88, DemEnableConditionGroupRef=DECG_C00B88
            DemDebounceAlgorithmClass: DemCallbackGetFDCFnc=false, DemDebounceTimeBaseRef=DemDebounceTimeBaseClass0_250ms_0ms
          Event_0xF13C87: DemEventId=15, DemDTCRef=DTC_0xF13C87, DemEnableConditionGroupRef=DECG_F13C87
            DemDebounceAlgorithmClass: DemCallbackGetFDCFnc=true
          Event_0xF1D187: DemEventId=16, DemDTCRef=DTC_0xF1D187, DemEnableConditionGroupRef=DECG_F3A987_F3B287_F1D387_F1D487
            DemDebounceAlgorithmClass: DemCallbackGetFDCFnc=true
          Event_0xF1D287: DemEventId=17, DemDTCRef=DTC_0xF1D287, DemEnableConditionGroupRef=DECG_F3A987_F3B287_F1D387_F1D487
            DemDebounceAlgorithmClass: DemCallbackGetFDCFnc=true
          Event_0xF3A987: DemEventId=18, DemDTCRef=DTC_0xF3A987, DemEnableConditionGroupRef=DECG_F3A987_F3B287_F1D387_F1D487
            DemDebounceAlgorithmClass: DemCallbackGetFDCFnc=true
          Event_0xF3B287: DemEventId=19, DemDTCRef=DTC_0xF3B287, DemEnableConditionGroupRef=DECG_F3A987_F3B287_F1D387_F1D487
            DemDebounceAlgorithmClass: DemCallbackGetFDCFnc=true
      6 x DemDebounceTimeBaseClass, all with DemDebounceBehavior=DEM_DEBOUNCE_FREEZE:
        DemDebounceTimeBaseClass0_250ms_0ms: DemDebounceTimeFailedThreshold=250, DemDebounceTimePassedThreshold=10, DemTimeBasedFdcThresholdStorageValue=250
        DemDebounceTimeBaseClass1_1000ms_1000ms: DemDebounceTimeFailedThreshold=1000, DemDebounceTimePassedThreshold=1000, DemTimeBasedFdcThresholdStorageValue=1000
        DemDebounceTimeBaseClass2_1000ms_0ms: DemDebounceTimeFailedThreshold=1000, DemDebounceTimePassedThreshold=10, DemTimeBasedFdcThresholdStorageValue=1000
        DemDebounceTimeBaseClass3_1000ms_2000ms: DemDebounceTimeFailedThreshold=1000, DemDebounceTimePassedThreshold=2000, DemTimeBasedFdcThresholdStorageValue=1000
        DemDebounceTimeBaseClass4_40000ms_2000ms: DemDebounceTimeFailedThreshold=40000, DemDebounceTimePassedThreshold=2000, DemTimeBasedFdcThresholdStorageValue=40000
        DemDebounceTimeBaseClass5_0ms_2000ms: DemDebounceTimeFailedThreshold=10, DemDebounceTimePassedThreshold=2000, DemTimeBasedFdcThresholdStorageValue=10
    Cfg_P (DemConfigSet): UserDefine=false
      DemDTCClassTable_0 (DemDTC)
        20 x DemDTCRow, all with DemDTCSeverity=DEM_SEVERITY_NO_SEVERITY, DemDTCFunctionalUnit=0, DemWWHOBDDTCClass=DEM_DTC_WWHOBD_CLASS_C, DemNvStorageStrategy=DURING_SHUTDOWN, UserDefine=false:
          DTC_0x800116: DemDtcValue=0x800116, DemDTCAttributesRef=DemDTCAttribute_0
          DTC_0x800117: DemDtcValue=0x800117, DemDTCAttributesRef=DemDTCAttribute_0
          DTC_0x9C0119: DemDtcValue=0x9C0119, DemDTCAttributesRef=DemDTCAttribute_0
          DTC_0x9C0218: DemDtcValue=0x9C0218, DemDTCAttributesRef=DemDTCAttribute_0
          DTC_0x9C0311: DemDtcValue=0x9C0311, DemDTCAttributesRef=DemDTCAttribute_0
          DTC_0x9C0415: DemDtcValue=0x9C0415, DemDTCAttributesRef=DemDTCAttribute_0
          DTC_0x9C0511: DemDtcValue=0x9C0511, DemDTCAttributesRef=DemDTCAttribute_0
          DTC_0x9C0615: DemDtcValue=0x9C0615, DemDTCAttributesRef=DemDTCAttribute_0
          DTC_0x9D0119: DemDtcValue=0x9D0119, DemDTCAttributesRef=DemDTCAttribute_0
          DTC_0x9D0218: DemDtcValue=0x9D0218, DemDTCAttributesRef=DemDTCAttribute_0
          DTC_0x9D0319: DemDtcValue=0x9D0319, DemDTCAttributesRef=DemDTCAttribute_0
          DTC_0x9D0418: DemDtcValue=0x9D0418, DemDTCAttributesRef=DemDTCAttribute_0
          DTC_0x9D0511: DemDtcValue=0x9D0511, DemDTCAttributesRef=DemDTCAttribute_0
          DTC_0x9D0615: DemDtcValue=0x9D0615, DemDTCAttributesRef=DemDTCAttribute_0
          DTC_0xC00B88: DemDtcValue=0xC00B88, DemDTCAttributesRef=DemDTCAttribute_0
          DTC_0xF13C87: DemDtcValue=0xF13C87, DemDTCAttributesRef=DemDTCAttribute_0
          DTC_0xF1D387: DemDtcValue=0xF1D387, DemDTCAttributesRef=DemDTCAttributes1
          DTC_0xF1D487: DemDtcValue=0xF1D487, DemDTCAttributesRef=DemDTCAttributes1
          DTC_0xF3A987: DemDtcValue=0xF3A987, DemDTCAttributesRef=DemDTCAttribute_0
          DTC_0xF3B287: DemDtcValue=0xF3B287, DemDTCAttributesRef=DemDTCAttribute_0
      DemDTCAttribute_0 (DemDTCAttributes):
        DemDTCSignificance = FAULT
        DemAgingCycleCounterThreshold = 40
        DemAgingCycleCounterThresholdForTFSLC = 1
        DemDTCPriority = 1
        DemMaxNumberFreezeFrameRecords = 0
        DemAgingCycleRef = OperationCycle_DEM_IGNITION
        DemExtendedDataClassRef = DemExtendedDataClass0
        DemMemoryDestinationRef = DemPrimaryMemory
      DemDTCAttributes1 (DemDTCAttributes):
        DemDTCSignificance = FAULT
        DemAgingCycleCounterThreshold = 40
        DemAgingCycleCounterThresholdForTFSLC = 1
        DemDTCPriority = 1
        DemMaxNumberFreezeFrameRecords = 0
        DemAgingCycleRef = OperationCycle_DEM_WARMUP
        DemExtendedDataClassRef = DemExtendedDataClass0
        DemMemoryDestinationRef = DemPrimaryMemory
      DemEventParameterTable_0 (DemEventParameter)
        20 x DemEventParameterRow, all with DemEventAvailable=true, DemFFPrestorageSupported=false, DemEventKind=DEM_EVENT_KIND_SWC, DemReportBehavior=REPORT_AFTER_INIT, DemComponentPriority=0, CallbackClearEventAllowedEnable=false, CallbackInitMForEEnable=false, CallbackEventDataChangedEnable=false, CallbackEventUdsStatusChangedEnable=false, CallbackMonitorStatusChangedEnable=false, DemEventConfirmationThreshold=1, DemCausalityDelayTime=0, DemEventRecoverableInSameOperationCycle=true, DemFFPrestorageInNvm=false, DemEventReportingType=STANDARD_REPORTING, DemEventAvailableInVariant=true, DemEventAssociatedIdentification=0, DemEventConfirmationThresholdCounterAdaptable=false, DemOperationCycleRef=OperationCycle_DEM_IGNITION:
          Event_0x800116: DemEventId=0, DemDTCRef=DTC_0x800116, DemEnableConditionGroupRef=DECG_800117_800116
            DemDebounceAlgorithmClass: DemCallbackGetFDCFnc=false, DemDebounceTimeBaseRef=DemDebounceTimeBaseClass1_1000ms_1000ms
          Event_0x800117: DemEventId=1, DemDTCRef=DTC_0x800117, DemEnableConditionGroupRef=DECG_800117_800116
            DemDebounceAlgorithmClass: DemCallbackGetFDCFnc=false, DemDebounceTimeBaseRef=DemDebounceTimeBaseClass1_1000ms_1000ms
          Event_0x9C0119: DemEventId=2, DemDTCRef=DTC_0x9C0119, DemEnableConditionGroupRef=DECG_9C0119_9C0218
            DemDebounceAlgorithmClass: DemCallbackGetFDCFnc=false, DemDebounceTimeBaseRef=DemDebounceTimeBaseClass2_1000ms_0ms
          Event_0x9C0218: DemEventId=3, DemDTCRef=DTC_0x9C0218, DemEnableConditionGroupRef=DECG_9C0119_9C0218
            DemDebounceAlgorithmClass: DemCallbackGetFDCFnc=false, DemDebounceTimeBaseRef=DemDebounceTimeBaseClass3_1000ms_2000ms
          Event_0x9C0311: DemEventId=4, DemDTCRef=DTC_0x9C0311, DemEnableConditionGroupRef=DECG_9C0311_9C0415_9D0511_9D0615
            DemDebounceAlgorithmClass: DemCallbackGetFDCFnc=false, DemDebounceTimeBaseRef=DemDebounceTimeBaseClass4_40000ms_2000ms
          Event_0x9C0415: DemEventId=5, DemDTCRef=DTC_0x9C0415, DemEnableConditionGroupRef=DECG_9C0311_9C0415_9D0511_9D0615
            DemDebounceAlgorithmClass: DemCallbackGetFDCFnc=false, DemDebounceTimeBaseRef=DemDebounceTimeBaseClass4_40000ms_2000ms
          Event_0x9C0511: DemEventId=6, DemDTCRef=DTC_0x9C0511, DemEnableConditionGroupRef=DECG_9C0511_9C0615
            DemDebounceAlgorithmClass: DemCallbackGetFDCFnc=false, DemDebounceTimeBaseRef=DemDebounceTimeBaseClass5_0ms_2000ms
          Event_0x9C0615: DemEventId=7, DemDTCRef=DTC_0x9C0615, DemEnableConditionGroupRef=DECG_9C0511_9C0615
            DemDebounceAlgorithmClass: DemCallbackGetFDCFnc=false, DemDebounceTimeBaseRef=DemDebounceTimeBaseClass5_0ms_2000ms
          Event_0x9D0119: DemEventId=8, DemDTCRef=DTC_0x9D0119, DemEnableConditionGroupRef=DECG_9D0119_9D0218
            DemDebounceAlgorithmClass: DemCallbackGetFDCFnc=false, DemDebounceTimeBaseRef=DemDebounceTimeBaseClass2_1000ms_0ms
          Event_0x9D0218: DemEventId=9, DemDTCRef=DTC_0x9D0218, DemEnableConditionGroupRef=DECG_9D0119_9D0218
            DemDebounceAlgorithmClass: DemCallbackGetFDCFnc=false, DemDebounceTimeBaseRef=DemDebounceTimeBaseClass2_1000ms_0ms
          Event_0x9D0319: DemEventId=10, DemDTCRef=DTC_0x9D0319, DemEnableConditionGroupRef=DECG_9D0319_9D0418
            DemDebounceAlgorithmClass: DemCallbackGetFDCFnc=false, DemDebounceTimeBaseRef=DemDebounceTimeBaseClass2_1000ms_0ms
          Event_0x9D0418: DemEventId=11, DemDTCRef=DTC_0x9D0418, DemEnableConditionGroupRef=DECG_9D0319_9D0418
            DemDebounceAlgorithmClass: DemCallbackGetFDCFnc=false, DemDebounceTimeBaseRef=DemDebounceTimeBaseClass2_1000ms_0ms
          Event_0x9D0511: DemEventId=12, DemDTCRef=DTC_0x9D0511, DemEnableConditionGroupRef=DECG_9C0311_9C0415_9D0511_9D0615
            DemDebounceAlgorithmClass: DemCallbackGetFDCFnc=true
          Event_0x9D0615: DemEventId=13, DemDTCRef=DTC_0x9D0615, DemEnableConditionGroupRef=DECG_9C0311_9C0415_9D0511_9D0615
            DemDebounceAlgorithmClass: DemCallbackGetFDCFnc=true
          Event_0xC00B88: DemEventId=14, DemDTCRef=DTC_0xC00B88, DemEnableConditionGroupRef=DECG_C00B88
            DemDebounceAlgorithmClass: DemCallbackGetFDCFnc=false, DemDebounceTimeBaseRef=DemDebounceTimeBaseClass0_250ms_0ms
          Event_0xF13C87: DemEventId=15, DemDTCRef=DTC_0xF13C87, DemEnableConditionGroupRef=DECG_F13C87
            DemDebounceAlgorithmClass: DemCallbackGetFDCFnc=true
          Event_0xF1D387: DemEventId=16, DemDTCRef=DTC_0xF1D387, DemEnableConditionGroupRef=DECG_F3A987_F3B287_F1D387_F1D487
            DemDebounceAlgorithmClass: DemCallbackGetFDCFnc=true
          Event_0xF1D487: DemEventId=17, DemDTCRef=DTC_0xF1D487, DemEnableConditionGroupRef=DECG_F3A987_F3B287_F1D387_F1D487
            DemDebounceAlgorithmClass: DemCallbackGetFDCFnc=true
          Event_0xF3A987: DemEventId=18, DemDTCRef=DTC_0xF3A987, DemEnableConditionGroupRef=DECG_F3A987_F3B287_F1D387_F1D487
            DemDebounceAlgorithmClass: DemCallbackGetFDCFnc=true
          Event_0xF3B287: DemEventId=19, DemDTCRef=DTC_0xF3B287, DemEnableConditionGroupRef=DECG_F3A987_F3B287_F1D387_F1D487
            DemDebounceAlgorithmClass: DemCallbackGetFDCFnc=true
      6 x DemDebounceTimeBaseClass, all with DemDebounceBehavior=DEM_DEBOUNCE_FREEZE:
        DemDebounceTimeBaseClass0_250ms_0ms: DemDebounceTimeFailedThreshold=250, DemDebounceTimePassedThreshold=10, DemTimeBasedFdcThresholdStorageValue=250
        DemDebounceTimeBaseClass1_1000ms_1000ms: DemDebounceTimeFailedThreshold=1000, DemDebounceTimePassedThreshold=1000, DemTimeBasedFdcThresholdStorageValue=1000
        DemDebounceTimeBaseClass2_1000ms_0ms: DemDebounceTimeFailedThreshold=1000, DemDebounceTimePassedThreshold=10, DemTimeBasedFdcThresholdStorageValue=1000
        DemDebounceTimeBaseClass3_1000ms_2000ms: DemDebounceTimeFailedThreshold=1000, DemDebounceTimePassedThreshold=2000, DemTimeBasedFdcThresholdStorageValue=1000
        DemDebounceTimeBaseClass4_40000ms_2000ms: DemDebounceTimeFailedThreshold=40000, DemDebounceTimePassedThreshold=2000, DemTimeBasedFdcThresholdStorageValue=40000
        DemDebounceTimeBaseClass5_0ms_2000ms: DemDebounceTimeFailedThreshold=10, DemDebounceTimePassedThreshold=2000, DemTimeBasedFdcThresholdStorageValue=10
  module config Det: implementation-config-variant=STD_CONFIG_VARIANTS_PRECOMPILE, module_version_def=4.0.3, module_autosar_version=Ar470
    DetGeneral:
      DetDebugLoop = false
      DetForwardToDlt = false
      VersionCheck = true
      DetVersionApi = false
      DetErrorHook = 
      CddHeaderFile = 
      DetReportRuntimeErrorCallout = 
      DetReportTransientFaultCallout = 
    DetConfigSet (DetModuleInstance)
  module config EcuC: implementation-config-variant=STD_CONFIG_VARIANTS_PRECOMPILE, module_version_def=4.0.0, module_autosar_version=Ar470
    EcucVariationResolver
    EcucPduCollection: PduIdTypeEnum=uint8, PduLengthTypeEnum=uint16
      40 x Pdu, all with PduLength=8, DynamicLength=false, J1939Requestable=false, UserDefine=false, PduType=DBC, isExcel=false, EcucPduDefaultPartitionRef=EcucPartition0:
        Cfg_D_Tx_BODY_LE1_CAN_MCM_D_1B6: SysTPduToFrameMappingRef=Cfg_D_Tx_BODY_LE1_CAN_MCM_D_1B6
        Cfg_D_Tx_BODY_LE1_CAN_MCM_D_1DF: SysTPduToFrameMappingRef=Cfg_D_Tx_BODY_LE1_CAN_MCM_D_1DF
        Cfg_D_Tx_BODY_LE1_CAN_MCM_D_1E0: SysTPduToFrameMappingRef=Cfg_D_Tx_BODY_LE1_CAN_MCM_D_1E0
        Cfg_D_Tx_BODY_LE1_CAN_MCM_D_1E1: SysTPduToFrameMappingRef=Cfg_D_Tx_BODY_LE1_CAN_MCM_D_1E1
        Cfg_D_Tx_BODY_LE1_CAN_MCM_D_1E8: SysTPduToFrameMappingRef=Cfg_D_Tx_BODY_LE1_CAN_MCM_D_1E8
        Cfg_D_Tx_BODY_LE1_CAN_MCM_D_1EC: SysTPduToFrameMappingRef=Cfg_D_Tx_BODY_LE1_CAN_MCM_D_1EC
        Cfg_D_Tx_BODY_LE1_CAN_DIAG_RESP_MCM_D: SysTPduToFrameMappingRef=Cfg_D_Tx_BODY_LE1_CAN_DIAG_RESP_MCM_D
        Cfg_D_Rx_BODY_LE1_CAN_BCU_11E: SysTPduToFrameMappingRef=Cfg_D_Rx_BODY_LE1_CAN_BCU_11E
        Cfg_D_Rx_BODY_LE1_CAN_ZONE_13C: SysTPduToFrameMappingRef=Cfg_D_Rx_BODY_LE1_CAN_ZONE_13C
        Cfg_D_Rx_BODY_LE1_CAN_ZONE_MCM_05: SysTPduToFrameMappingRef=Cfg_D_Rx_BODY_LE1_CAN_ZONE_MCM_05
        Cfg_D_Rx_BODY_LE1_CAN_ZONE_1C9: SysTPduToFrameMappingRef=Cfg_D_Rx_BODY_LE1_CAN_ZONE_1C9
        Cfg_D_Rx_BODY_LE1_CAN_Zone_FL_MCM_01: SysTPduToFrameMappingRef=Cfg_D_Rx_BODY_LE1_CAN_Zone_FL_MCM_01
        Cfg_D_Rx_BODY_LE1_CAN_Zone_FL_MCM_02: SysTPduToFrameMappingRef=Cfg_D_Rx_BODY_LE1_CAN_Zone_FL_MCM_02
        Cfg_D_Rx_BODY_LE1_CAN_ZONE_2EF: SysTPduToFrameMappingRef=Cfg_D_Rx_BODY_LE1_CAN_ZONE_2EF
        Cfg_D_Rx_BODY_LE1_CAN_ZONE_3A9: SysTPduToFrameMappingRef=Cfg_D_Rx_BODY_LE1_CAN_ZONE_3A9
        Cfg_D_Rx_BODY_LE1_CAN_ZONE_3B2: SysTPduToFrameMappingRef=Cfg_D_Rx_BODY_LE1_CAN_ZONE_3B2
        Cfg_D_Rx_BODY_LE1_CAN_ZONE_PNC: SysTPduToFrameMappingRef=Cfg_D_Rx_BODY_LE1_CAN_ZONE_PNC
        Cfg_D_Rx_BODY_LE1_CAN_VC_Data_5E0: SysTPduToFrameMappingRef=Cfg_D_Rx_BODY_LE1_CAN_VC_Data_5E0
        Cfg_D_Rx_BODY_LE1_CAN_DIAG_REQ_AllECU: SysTPduToFrameMappingRef=Cfg_D_Rx_BODY_LE1_CAN_DIAG_REQ_AllECU
        Cfg_D_Rx_BODY_LE1_CAN_DIAG_REQ_MCM_D: SysTPduToFrameMappingRef=Cfg_D_Rx_BODY_LE1_CAN_DIAG_REQ_MCM_D
        Cfg_P_Tx_BODY_LE1_CAN_MCM_P_1B7: SysTPduToFrameMappingRef=Cfg_P_Tx_BODY_LE1_CAN_MCM_P_1B7
        Cfg_P_Tx_BODY_LE1_CAN_MCM_P_1E{2..4}: SysTPduToFrameMappingRef=Cfg_P_Tx_BODY_LE1_CAN_MCM_P_1E{2..4}
        Cfg_P_Tx_BODY_LE1_CAN_MCM_P_1EB: SysTPduToFrameMappingRef=Cfg_P_Tx_BODY_LE1_CAN_MCM_P_1EB
        Cfg_P_Tx_BODY_LE1_CAN_MCM_P_1ED: SysTPduToFrameMappingRef=Cfg_P_Tx_BODY_LE1_CAN_MCM_P_1ED
        Cfg_P_Tx_BODY_LE1_CAN_DIAG_RESP_MCM_P: SysTPduToFrameMappingRef=Cfg_P_Tx_BODY_LE1_CAN_DIAG_RESP_MCM_P
        Cfg_P_Rx_BODY_LE1_CAN_BCU_11E: SysTPduToFrameMappingRef=Cfg_P_Rx_BODY_LE1_CAN_BCU_11E
        Cfg_P_Rx_BODY_LE1_CAN_ZONE_13C: SysTPduToFrameMappingRef=Cfg_P_Rx_BODY_LE1_CAN_ZONE_13C
        Cfg_P_Rx_BODY_LE1_CAN_ZONE_MCM_06: SysTPduToFrameMappingRef=Cfg_P_Rx_BODY_LE1_CAN_ZONE_MCM_06
        Cfg_P_Rx_BODY_LE1_CAN_ZONE_1CF: SysTPduToFrameMappingRef=Cfg_P_Rx_BODY_LE1_CAN_ZONE_1CF
        Cfg_P_Rx_BODY_LE1_CAN_Zone_FL_MCM_03: SysTPduToFrameMappingRef=Cfg_P_Rx_BODY_LE1_CAN_Zone_FL_MCM_03
        Cfg_P_Rx_BODY_LE1_CAN_Zone_FL_MCM_04: SysTPduToFrameMappingRef=Cfg_P_Rx_BODY_LE1_CAN_Zone_FL_MCM_04
        Cfg_P_Rx_BODY_LE1_CAN_ZONE_2EF: SysTPduToFrameMappingRef=Cfg_P_Rx_BODY_LE1_CAN_ZONE_2EF
        Cfg_P_Rx_BODY_LE1_CAN_ZONE_3A9: SysTPduToFrameMappingRef=Cfg_P_Rx_BODY_LE1_CAN_ZONE_3A9
        Cfg_P_Rx_BODY_LE1_CAN_ZONE_3B2: SysTPduToFrameMappingRef=Cfg_P_Rx_BODY_LE1_CAN_ZONE_3B2
        Cfg_P_Rx_BODY_LE1_CAN_ZONE_PNC: SysTPduToFrameMappingRef=Cfg_P_Rx_BODY_LE1_CAN_ZONE_PNC
        Cfg_P_Rx_BODY_LE1_CAN_VC_Data_5E0: SysTPduToFrameMappingRef=Cfg_P_Rx_BODY_LE1_CAN_VC_Data_5E0
        Cfg_P_Rx_BODY_LE1_CAN_DIAG_REQ_AllECU: SysTPduToFrameMappingRef=Cfg_P_Rx_BODY_LE1_CAN_DIAG_REQ_AllECU
        Cfg_P_Rx_BODY_LE1_CAN_DIAG_REQ_MCM_P: SysTPduToFrameMappingRef=Cfg_P_Rx_BODY_LE1_CAN_DIAG_REQ_MCM_P
    EcucHardware: EcucCoreNum=1, EcucCoreMasterId=0
      EcucCoreDefinition0 (EcucCoreDefinition): EcucCoreId=0
    EcucPartitionCollection
      EcucPartition0 (EcucPartition): EcucPartitionBswModuleExecution=false, PartitionCanBeRestarted=false, EcucDefaultBswPartition=false, EcuCCoreRef=EcucCoreDefinition0
  module config EcuM: implementation-config-variant=STD_CONFIG_VARIANTS_POSTBUILD, module_version_def=4.0.4, module_autosar_version=Ar470
    EcuMGeneral:
      VersionCheck = true
      EcuMDevErrorDetect = false
      EcuMVersionInfoApi = true
      EcuMIncludeDet = true
      EcuMMainFunctionPeriod = 5
      EcuMCoreNumber = 1
      EcuMCoreMasterId = 0
    EcuMFlexGeneral: EcuMAlarmClockPresent=false, EcuMResetLoopDetection=false, EcuMModeHandling=true, EcuMSetProgrammableInterrupts=true
    EcuMCfgSet0 (EcuMConfiguration)
      EcuMCommonConfiguration: EcuMConfigConsistencyHash=0xd051109b, InterruptsBlockMechanism=NONE, EcuMIgnoreWakeupEvValOffPreOS=false, EcuMDefaultAppMode=0
        EcuMDefaultShutdownTarget: EcuMDefaultState=EcuMShutDownOff
        5 x EcuMWakeupSource, all with EcuMValidationTimeout=0, EcuMCheckWakeupTimeout=0, EcuMWakeupSourcePolling=false:
          WkSource_Power: EcuMWakeupSourceId=0
          WkSource_Reset: EcuMWakeupSourceId=1
          WkSource_Internal_Reset: EcuMWakeupSourceId=2
          WkSource_Internal_Wdg: EcuMWakeupSourceId=3
          WkSource_External_Wdg: EcuMWakeupSourceId=4
      EcuMFlexConfiguration: EcuMNormalMcuModeRef=0
        3 x EcuMResetMode:
          Reset_Mcu: EcuMResetModeId=0
          Reset_Wdg: EcuMResetModeId=1
          Reset_IO: EcuMResetModeId=2
        4 x EcuMShutdownCause:
          Cause_Unknown: EcuMShutdownCauseId=0
          Cause_Ecu_State: EcuMShutdownCauseId=1
          Cause_WdgM: EcuMShutdownCauseId=2
          Cause_Dcm: EcuMShutdownCauseId=3
        User0 (EcuMFlexUserConfig): EcuMFlexUser=0x0
        CoreConfig_0 (EcuMCoreConfig): OsCore=Core0, EcuMSleepEventRef=/EAS/Os/OsEvent/, EcuMShutdownEventRef=/EAS/Os/OsEvent/
  module config MemIf: implementation-config-variant=STD_CONFIG_VARIANTS_PRECOMPILE, module_version_def=4.0.2, module_autosar_version=Ar470
    MemIfGeneral: MemIfDevErrorDetect=false, MemIfVersionInfoApi=false, VersionCheck=true, MemIfNumberOfDevices=1
    Device0 (MemIfDevice):
      DeviceId = 0
      DeviceHeaderFile = Fee
      DeviceType = Fee
      Mode = Fee_SetMode
      Read = Fee_Read
      Write = Fee_Write
      Cancel = Fee_Cancel
      Status = Fee_GetStatus
      InvalidateBlock = Fee_InvalidateBlock
      JobResult = Fee_GetJobResult
      EraseBlock = Fee_EraseImmediateBlock
  module config MemMap: implementation-config-variant=STD_CONFIG_VARIANTS_PRECOMPILE, module_version_def=4.0.0, module_autosar_version=Ar470
    MemMapGeneral: IDE=UserDefine, ChipName=UserDefine, isAuto=false
  module config NvM: implementation-config-variant=STD_CONFIG_VARIANTS_PRECOMPILE, module_version_def=4.2.0, module_autosar_version=Ar470
    NvMCommon:
      NvMApiConfigClass = NVM_API_CONFIG_CLASS_3
      NvMBswMMultiBlockJobStatusInformation = true
      NvMCompiledConfigId = 38942
      NvMCrcNumOfBytes = 10
      NvMDatasetSelectionBits = 0
      NvMDevErrorDetect = true
      NvMDrvModeSwitch = false
      NvMDynamicConfiguration = false
      NvMJobPrioritization = false
      NvMMultiBlockCallback = NVM_NULL
      NvMPollingMode = false
      NvMRepeatMirrorOperations = 0
      NvMSetRamBlockStatusApi = false
      NvMSizeImmediateJobQueue = 1
      NvMSizeStandardJobQueue = 10
      NvMVersionInfoApi = false
      NvMEraseApi = false
      NvMInvalidApi = false
      NvMCancelJobApi = false
      VersionCheck = true
      NvMImplicitRestoreApi = false
      NvMLowBlockIdSaved = false
      NvMReadOpBytes = 0
      NvMSpecialReadRom = false
      NvMSetBlockLockApi = false
      NvMWriteProtectedSupport = false
      NvMMultiCoreSupport = false
      NvMBlockAgentBufferSize = 50
      NvMCsmRetryCounter = 0
    26 x NvMBlockDescriptor, all with NvMBlockCrcType=NVM_CRC8, NvMBlockJobPriority=1, NvMBlockManagementType=NVM_BLOCK_NATIVE, NvMBlockUseSyncMechanism=false, NvMBlockWriteProt=false, NvMBswMBlockStatusInformation=false, NvMCalcRamBlockCrc=false, NvMInitBlockCallback=NVM_NULL, NvMMaxNumOfReadRetries=0, NvMMaxNumOfWriteRetries=0, NvMNvBlockNum=1, NvMNvramDeviceId=0, NvMRomBlockNum=0, NvMSelectBlockForFirstInitAll=false, NvMSingleBlockCallback=NVM_NULL, NvMWriteBlockOnce=false, NvMBlockUseCrc=false, NvMSelectBlockForReadAll=true, NvMSelectBlockForWriteAll=true, NvMWriteVerification=false, NvMWriteVerificationDataSize=10, NvMStaticBlockIDCheck=false, NvMResistantToChangedSw=false, NvMReadRamBlockFromNvCallback=NVM_NULL, NvMWriteRamBlockToNvCallback=NVM_NULL, NvMBlockUseAutoValidation=false, NvMBlockUseCRCCompMechanism=false, NvMBlockUseSetRamBlockStatus=false, NvMBlockUseCompression=false, NvMBlockUsePort=false, NvMBlockCompressionLength=1:
      Block0: NvMNvBlockBaseNumber=0, NvMNvBlockLength=1, NvMNvramBlockIdentifier=0, NvMRamBlockDataAddress=NVM_NULL, NvMRomBlockDataAddress=NVM_NULL, NvMBlockHeaderInclude=, UserDefine=false
      Block_CfgID: NvMNvBlockBaseNumber=1, NvMNvBlockLength=2, NvMNvramBlockIdentifier=1, NvMRamBlockDataAddress=NvM_CfgIDBuffer, NvMRomBlockDataAddress=NvM_CompiledConfigId, NvMBlockHeaderInclude=, UserDefine=false
        NvMTargetBlockReference
      NVM_PrimaryDataEntry_0_0: NvMNvBlockBaseNumber=2, NvMNvBlockLength=19, NvMNvramBlockIdentifier=2, NvMRamBlockDataAddress=&PrimaryDataEntry_0_0, NvMRomBlockDataAddress=NVM_NULL, NvMBlockHeaderInclude=BSW_APP, UserDefine=true
        NvMTargetBlockReference
      NVM_PrimaryDataEntry_0_1: NvMNvBlockBaseNumber=3, NvMNvBlockLength=19, NvMNvramBlockIdentifier=3, NvMRamBlockDataAddress=&PrimaryDataEntry_0_1, NvMRomBlockDataAddress=NVM_NULL, NvMBlockHeaderInclude=Dem, UserDefine=true
        NvMTargetBlockReference
      NVM_PrimaryDataEntry_0_2: NvMNvBlockBaseNumber=4, NvMNvBlockLength=19, NvMNvramBlockIdentifier=4, NvMRamBlockDataAddress=&PrimaryDataEntry_0_2, NvMRomBlockDataAddress=NVM_NULL, NvMBlockHeaderInclude=, UserDefine=true
        NvMTargetBlockReference
      NVM_PrimaryDataEntry_0_3: NvMNvBlockBaseNumber=5, NvMNvBlockLength=19, NvMNvramBlockIdentifier=5, NvMRamBlockDataAddress=&PrimaryDataEntry_0_3, NvMRomBlockDataAddress=NVM_NULL, NvMBlockHeaderInclude=, UserDefine=true
        NvMTargetBlockReference
      NVM_PrimaryDataEntry_0_4: NvMNvBlockBaseNumber=6, NvMNvBlockLength=19, NvMNvramBlockIdentifier=6, NvMRamBlockDataAddress=&PrimaryDataEntry_0_4, NvMRomBlockDataAddress=NVM_NULL, NvMBlockHeaderInclude=, UserDefine=true
        NvMTargetBlockReference
      NVM_PrimaryDataEntry_0_5: NvMNvBlockBaseNumber=7, NvMNvBlockLength=19, NvMNvramBlockIdentifier=7, NvMRamBlockDataAddress=&PrimaryDataEntry_0_5, NvMRomBlockDataAddress=NVM_NULL, NvMBlockHeaderInclude=, UserDefine=true
        NvMTargetBlockReference
      NVM_PrimaryDataEntry_0_6: NvMNvBlockBaseNumber=8, NvMNvBlockLength=19, NvMNvramBlockIdentifier=8, NvMRamBlockDataAddress=&PrimaryDataEntry_0_6, NvMRomBlockDataAddress=NVM_NULL, NvMBlockHeaderInclude=, UserDefine=true
        NvMTargetBlockReference
      NVM_PrimaryDataEntry_0_7: NvMNvBlockBaseNumber=9, NvMNvBlockLength=19, NvMNvramBlockIdentifier=9, NvMRamBlockDataAddress=&PrimaryDataEntry_0_7, NvMRomBlockDataAddress=NVM_NULL, NvMBlockHeaderInclude=, UserDefine=true
        NvMTargetBlockReference
      NVM_PrimaryDataEntry_0_8: NvMNvBlockBaseNumber=10, NvMNvBlockLength=19, NvMNvramBlockIdentifier=10, NvMRamBlockDataAddress=&PrimaryDataEntry_0_8, NvMRomBlockDataAddress=NVM_NULL, NvMBlockHeaderInclude=, UserDefine=true
        NvMTargetBlockReference
      NVM_PrimaryDataEntry_0_9: NvMNvBlockBaseNumber=11, NvMNvBlockLength=19, NvMNvramBlockIdentifier=11, NvMRamBlockDataAddress=&PrimaryDataEntry_0_9, NvMRomBlockDataAddress=NVM_NULL, NvMBlockHeaderInclude=, UserDefine=true
        NvMTargetBlockReference
      NVM_PrimaryDataEntry_0_10: NvMNvBlockBaseNumber=12, NvMNvBlockLength=19, NvMNvramBlockIdentifier=12, NvMRamBlockDataAddress=&PrimaryDataEntry_0_10, NvMRomBlockDataAddress=NVM_NULL, NvMBlockHeaderInclude=, UserDefine=true
        NvMTargetBlockReference
      NVM_PrimaryDataEntry_0_11: NvMNvBlockBaseNumber=13, NvMNvBlockLength=19, NvMNvramBlockIdentifier=13, NvMRamBlockDataAddress=&PrimaryDataEntry_0_11, NvMRomBlockDataAddress=NVM_NULL, NvMBlockHeaderInclude=, UserDefine=true
        NvMTargetBlockReference
      NVM_PrimaryDataEntry_0_12: NvMNvBlockBaseNumber=14, NvMNvBlockLength=19, NvMNvramBlockIdentifier=14, NvMRamBlockDataAddress=&PrimaryDataEntry_0_12, NvMRomBlockDataAddress=NVM_NULL, NvMBlockHeaderInclude=, UserDefine=true
        NvMTargetBlockReference
      NVM_PrimaryDataEntry_0_13: NvMNvBlockBaseNumber=15, NvMNvBlockLength=19, NvMNvramBlockIdentifier=15, NvMRamBlockDataAddress=&PrimaryDataEntry_0_13, NvMRomBlockDataAddress=NVM_NULL, NvMBlockHeaderInclude=, UserDefine=true
        NvMTargetBlockReference
      NVM_PrimaryDataEntry_0_14: NvMNvBlockBaseNumber=16, NvMNvBlockLength=19, NvMNvramBlockIdentifier=16, NvMRamBlockDataAddress=&PrimaryDataEntry_0_14, NvMRomBlockDataAddress=NVM_NULL, NvMBlockHeaderInclude=, UserDefine=true
        NvMTargetBlockReference
      NVM_PrimaryDataEntry_0_15: NvMNvBlockBaseNumber=17, NvMNvBlockLength=19, NvMNvramBlockIdentifier=17, NvMRamBlockDataAddress=&PrimaryDataEntry_0_15, NvMRomBlockDataAddress=NVM_NULL, NvMBlockHeaderInclude=, UserDefine=true
        NvMTargetBlockReference
      NVM_PrimaryDataEntry_0_16: NvMNvBlockBaseNumber=18, NvMNvBlockLength=19, NvMNvramBlockIdentifier=18, NvMRamBlockDataAddress=&PrimaryDataEntry_0_16, NvMRomBlockDataAddress=NVM_NULL, NvMBlockHeaderInclude=, UserDefine=true
        NvMTargetBlockReference
      NVM_PrimaryDataEntry_0_17: NvMNvBlockBaseNumber=19, NvMNvBlockLength=19, NvMNvramBlockIdentifier=19, NvMRamBlockDataAddress=&PrimaryDataEntry_0_17, NvMRomBlockDataAddress=NVM_NULL, NvMBlockHeaderInclude=, UserDefine=true
        NvMTargetBlockReference
      NVM_PrimaryDataEntry_0_18: NvMNvBlockBaseNumber=20, NvMNvBlockLength=19, NvMNvramBlockIdentifier=20, NvMRamBlockDataAddress=&PrimaryDataEntry_0_18, NvMRomBlockDataAddress=NVM_NULL, NvMBlockHeaderInclude=, UserDefine=true
        NvMTargetBlockReference
      NVM_PrimaryDataEntry_0_19: NvMNvBlockBaseNumber=21, NvMNvBlockLength=19, NvMNvramBlockIdentifier=21, NvMRamBlockDataAddress=&PrimaryDataEntry_0_19, NvMRomBlockDataAddress=NVM_NULL, NvMBlockHeaderInclude=, UserDefine=true
        NvMTargetBlockReference
      NVM_Dem_StorageMem: NvMNvBlockBaseNumber=22, NvMNvBlockLength=156, NvMNvramBlockIdentifier=22, NvMRamBlockDataAddress=&Dem_StorageMem, NvMRomBlockDataAddress=NVM_NULL, NvMBlockHeaderInclude=, UserDefine=true
        NvMTargetBlockReference
      FEE_App_Serial_number: NvMNvBlockBaseNumber=23, NvMNvBlockLength=16, NvMNvramBlockIdentifier=23, NvMRamBlockDataAddress=&serial_number, NvMRomBlockDataAddress=NVM_NULL, NvMBlockHeaderInclude=Memory, UserDefine=true
        NvMTargetBlockReference
      FEE_App_Manufacturing_Date: NvMNvBlockBaseNumber=24, NvMNvBlockLength=3, NvMNvramBlockIdentifier=24, NvMRamBlockDataAddress=&manufacturing_date, NvMRomBlockDataAddress=NVM_NULL, NvMBlockHeaderInclude=Memory, UserDefine=true
        NvMTargetBlockReference
      FEE_App_FAA_Flag: NvMNvBlockBaseNumber=25, NvMNvBlockLength=1, NvMNvramBlockIdentifier=25, NvMRamBlockDataAddress=&faa_flag, NvMRomBlockDataAddress=NVM_NULL, NvMBlockHeaderInclude=Memory, UserDefine=true
        NvMTargetBlockReference
    NvmDemEventParameterRefs
  module config PduR: implementation-config-variant=STD_CONFIG_VARIANTS_POSTBUILD, module_version_def=4.0.3, module_autosar_version=Ar470
    PduRGeneral:
      VersionCheck = true
      PduRDevErrorDetect = false
      PduRVersionInfoApi = false
      PduRZeroCostOperation = false
      CanIfModuleSupport = true
      CanTpModuleSupport = true
      ComModuleSupport = true
      DcmModuleSupport = true
      LinIfModuleSupport = false
      LinTpModuleSupport = false
      DoIPIfModuleSupport = false
      DoIPTpModuleSupport = false
      SoAdIfModuleSupport = false
      SoAdTpModuleSupport = false
      CddModuleSupport = false
      J1939DcmModuleSupport = false
      J1939TpModuleSupport = false
      CanNmModuleSupport = false
      J1939RmModuleSupport = false
      FrIfModuleSupport = false
      FrTpModuleSupport = false
      SecOcModuleSupport = false
      UdpNmModuleSupport = false
      IpduMModuleSupport = false
      IpduMIfModuleSupport = false
      SecOcIfModuleSupport = false
      SecOcTpModuleSupport = false
      LdComModuleSupport = false
      SomeIpTpModuleSupport = false
      SomeIpModuleSupport = false
      DltModuleSupport = false
      IdsMModuleSupport = false
      DoIPGWModuleSupport = false
      MirrorModuleSupport = false
      MulticoreSupport = false
    Cfg_D (PduRRoutingTables): PduRConfigurationId=0, UserDefine=false
      PduRRoutingTable: PduRMaxRoutingPathCnt=255, PduRMaxRoutingPathGroupCnt=255, PduRMaxRoutingTableCnt=255
        20 x PduRRoutingPath, all with UserDefine=false:
          Cfg_D_Rx_BODY_LE1_CAN_BCU_11E_CANIF_COM
            Src_Cfg_D_Rx_BODY_LE1_CAN_BCU_11E (PduRSrcPdu):
              PduRSourcePduHandleId = 0
              PduRSrcModule = CANIF
              PduRSrcPduUpTxConf = true
              PduRSrcPduCoreId = 0
              UserDefine = false
              PduRSrcPduRef = Cfg_D_Rx_BODY_LE1_CAN_BCU_11E
            Dest_Cfg_D_Rx_BODY_LE1_CAN_BCU_11E (PduRDestPdu):
              PduRDestPduDataProvision = PDUR_DIRECT
              PduRDestPduHandleId = 0
              PduRTpThreshold = 7
              PduRTransmissionConfirmation = true
              PduRDestPduLength = 8
              PduRDestModule = COM
              PduRDestPduCoreId = 0
              UserDefine = false
              PduRDestPduRef = Cfg_D_Rx_BODY_LE1_CAN_BCU_11E
          Cfg_D_Rx_BODY_LE1_CAN_ZONE_13C_CANIF_COM
            Src_Cfg_D_Rx_BODY_LE1_CAN_ZONE_13C (PduRSrcPdu):
              PduRSourcePduHandleId = 1
              PduRSrcModule = CANIF
              PduRSrcPduUpTxConf = true
              PduRSrcPduCoreId = 0
              UserDefine = false
              PduRSrcPduRef = Cfg_D_Rx_BODY_LE1_CAN_ZONE_13C
            Dest_Cfg_D_Rx_BODY_LE1_CAN_ZONE_13C (PduRDestPdu):
              PduRDestPduDataProvision = PDUR_DIRECT
              PduRDestPduHandleId = 0
              PduRTpThreshold = 7
              PduRTransmissionConfirmation = true
              PduRDestPduLength = 8
              PduRDestModule = COM
              PduRDestPduCoreId = 0
              UserDefine = false
              PduRDestPduRef = Cfg_D_Rx_BODY_LE1_CAN_ZONE_13C
          Cfg_D_Rx_BODY_LE1_CAN_ZONE_MCM_05_CANIF_COM
            Src_Cfg_D_Rx_BODY_LE1_CAN_ZONE_MCM_05 (PduRSrcPdu):
              PduRSourcePduHandleId = 2
              PduRSrcModule = CANIF
              PduRSrcPduUpTxConf = true
              PduRSrcPduCoreId = 0
              UserDefine = false
              PduRSrcPduRef = Cfg_D_Rx_BODY_LE1_CAN_ZONE_MCM_05
            Dest_Cfg_D_Rx_BODY_LE1_CAN_ZONE_MCM_05 (PduRDestPdu):
              PduRDestPduDataProvision = PDUR_DIRECT
              PduRDestPduHandleId = 0
              PduRTpThreshold = 7
              PduRTransmissionConfirmation = true
              PduRDestPduLength = 8
              PduRDestModule = COM
              PduRDestPduCoreId = 0
              UserDefine = false
              PduRDestPduRef = Cfg_D_Rx_BODY_LE1_CAN_ZONE_MCM_05
          Cfg_D_Rx_BODY_LE1_CAN_ZONE_1C9_CANIF_COM
            Src_Cfg_D_Rx_BODY_LE1_CAN_ZONE_1C9 (PduRSrcPdu):
              PduRSourcePduHandleId = 3
              PduRSrcModule = CANIF
              PduRSrcPduUpTxConf = true
              PduRSrcPduCoreId = 0
              UserDefine = false
              PduRSrcPduRef = Cfg_D_Rx_BODY_LE1_CAN_ZONE_1C9
            Dest_Cfg_D_Rx_BODY_LE1_CAN_ZONE_1C9 (PduRDestPdu):
              PduRDestPduDataProvision = PDUR_DIRECT
              PduRDestPduHandleId = 0
              PduRTpThreshold = 7
              PduRTransmissionConfirmation = true
              PduRDestPduLength = 8
              PduRDestModule = COM
              PduRDestPduCoreId = 0
              UserDefine = false
              PduRDestPduRef = Cfg_D_Rx_BODY_LE1_CAN_ZONE_1C9
          Cfg_D_Rx_BODY_LE1_CAN_Zone_FL_MCM_01_CANIF_COM
            Src_Cfg_D_Rx_BODY_LE1_CAN_Zone_FL_MCM_01 (PduRSrcPdu):
              PduRSourcePduHandleId = 4
              PduRSrcModule = CANIF
              PduRSrcPduUpTxConf = true
              PduRSrcPduCoreId = 0
              UserDefine = false
              PduRSrcPduRef = Cfg_D_Rx_BODY_LE1_CAN_Zone_FL_MCM_01
            Dest_Cfg_D_Rx_BODY_LE1_CAN_Zone_FL_MCM_01 (PduRDestPdu):
              PduRDestPduDataProvision = PDUR_DIRECT
              PduRDestPduHandleId = 0
              PduRTpThreshold = 7
              PduRTransmissionConfirmation = true
              PduRDestPduLength = 8
              PduRDestModule = COM
              PduRDestPduCoreId = 0
              UserDefine = false
              PduRDestPduRef = Cfg_D_Rx_BODY_LE1_CAN_Zone_FL_MCM_01
          Cfg_D_Rx_BODY_LE1_CAN_Zone_FL_MCM_02_CANIF_COM
            Src_Cfg_D_Rx_BODY_LE1_CAN_Zone_FL_MCM_02 (PduRSrcPdu):
              PduRSourcePduHandleId = 5
              PduRSrcModule = CANIF
              PduRSrcPduUpTxConf = true
              PduRSrcPduCoreId = 0
              UserDefine = false
              PduRSrcPduRef = Cfg_D_Rx_BODY_LE1_CAN_Zone_FL_MCM_02
            Dest_Cfg_D_Rx_BODY_LE1_CAN_Zone_FL_MCM_02 (PduRDestPdu):
              PduRDestPduDataProvision = PDUR_DIRECT
              PduRDestPduHandleId = 0
              PduRTpThreshold = 7
              PduRTransmissionConfirmation = true
              PduRDestPduLength = 8
              PduRDestModule = COM
              PduRDestPduCoreId = 0
              UserDefine = false
              PduRDestPduRef = Cfg_D_Rx_BODY_LE1_CAN_Zone_FL_MCM_02
          Cfg_D_Rx_BODY_LE1_CAN_ZONE_2EF_CANIF_COM
            Src_Cfg_D_Rx_BODY_LE1_CAN_ZONE_2EF (PduRSrcPdu):
              PduRSourcePduHandleId = 6
              PduRSrcModule = CANIF
              PduRSrcPduUpTxConf = true
              PduRSrcPduCoreId = 0
              UserDefine = false
              PduRSrcPduRef = Cfg_D_Rx_BODY_LE1_CAN_ZONE_2EF
            Dest_Cfg_D_Rx_BODY_LE1_CAN_ZONE_2EF (PduRDestPdu):
              PduRDestPduDataProvision = PDUR_DIRECT
              PduRDestPduHandleId = 0
              PduRTpThreshold = 7
              PduRTransmissionConfirmation = true
              PduRDestPduLength = 8
              PduRDestModule = COM
              PduRDestPduCoreId = 0
              UserDefine = false
              PduRDestPduRef = Cfg_D_Rx_BODY_LE1_CAN_ZONE_2EF
          Cfg_D_Rx_BODY_LE1_CAN_ZONE_3A9_CANIF_COM
            Src_Cfg_D_Rx_BODY_LE1_CAN_ZONE_3A9 (PduRSrcPdu):
              PduRSourcePduHandleId = 7
              PduRSrcModule = CANIF
              PduRSrcPduUpTxConf = true
              PduRSrcPduCoreId = 0
              UserDefine = false
              PduRSrcPduRef = Cfg_D_Rx_BODY_LE1_CAN_ZONE_3A9
            Dest_Cfg_D_Rx_BODY_LE1_CAN_ZONE_3A9 (PduRDestPdu):
              PduRDestPduDataProvision = PDUR_DIRECT
              PduRDestPduHandleId = 0
              PduRTpThreshold = 7
              PduRTransmissionConfirmation = true
              PduRDestPduLength = 8
              PduRDestModule = COM
              PduRDestPduCoreId = 0
              UserDefine = false
              PduRDestPduRef = Cfg_D_Rx_BODY_LE1_CAN_ZONE_3A9
          Cfg_D_Rx_BODY_LE1_CAN_ZONE_3B2_CANIF_COM
            Src_Cfg_D_Rx_BODY_LE1_CAN_ZONE_3B2 (PduRSrcPdu):
              PduRSourcePduHandleId = 8
              PduRSrcModule = CANIF
              PduRSrcPduUpTxConf = true
              PduRSrcPduCoreId = 0
              UserDefine = false
              PduRSrcPduRef = Cfg_D_Rx_BODY_LE1_CAN_ZONE_3B2
            Dest_Cfg_D_Rx_BODY_LE1_CAN_ZONE_3B2 (PduRDestPdu):
              PduRDestPduDataProvision = PDUR_DIRECT
              PduRDestPduHandleId = 0
              PduRTpThreshold = 7
              PduRTransmissionConfirmation = true
              PduRDestPduLength = 8
              PduRDestModule = COM
              PduRDestPduCoreId = 0
              UserDefine = false
              PduRDestPduRef = Cfg_D_Rx_BODY_LE1_CAN_ZONE_3B2
          Cfg_D_Rx_BODY_LE1_CAN_ZONE_PNC_CANIF_COM
            Src_Cfg_D_Rx_BODY_LE1_CAN_ZONE_PNC (PduRSrcPdu):
              PduRSourcePduHandleId = 9
              PduRSrcModule = CANIF
              PduRSrcPduUpTxConf = true
              PduRSrcPduCoreId = 0
              UserDefine = false
              PduRSrcPduRef = Cfg_D_Rx_BODY_LE1_CAN_ZONE_PNC
            Dest_Cfg_D_Rx_BODY_LE1_CAN_ZONE_PNC (PduRDestPdu):
              PduRDestPduDataProvision = PDUR_DIRECT
              PduRDestPduHandleId = 0
              PduRTpThreshold = 7
              PduRTransmissionConfirmation = true
              PduRDestPduLength = 8
              PduRDestModule = COM
              PduRDestPduCoreId = 0
              UserDefine = false
              PduRDestPduRef = Cfg_D_Rx_BODY_LE1_CAN_ZONE_PNC
          Cfg_D_Rx_BODY_LE1_CAN_VC_Data_5E0_CANIF_COM
            Src_Cfg_D_Rx_BODY_LE1_CAN_VC_Data_5E0 (PduRSrcPdu):
              PduRSourcePduHandleId = 10
              PduRSrcModule = CANIF
              PduRSrcPduUpTxConf = true
              PduRSrcPduCoreId = 0
              UserDefine = false
              PduRSrcPduRef = Cfg_D_Rx_BODY_LE1_CAN_VC_Data_5E0
            Dest_Cfg_D_Rx_BODY_LE1_CAN_VC_Data_5E0 (PduRDestPdu):
              PduRDestPduDataProvision = PDUR_DIRECT
              PduRDestPduHandleId = 0
              PduRTpThreshold = 7
              PduRTransmissionConfirmation = true
              PduRDestPduLength = 8
              PduRDestModule = COM
              PduRDestPduCoreId = 0
              UserDefine = false
              PduRDestPduRef = Cfg_D_Rx_BODY_LE1_CAN_VC_Data_5E0
          Cfg_D_Tx_BODY_LE1_CAN_MCM_D_1B6_COM_CANIF
            Src_Cfg_D_Tx_BODY_LE1_CAN_MCM_D_1B6 (PduRSrcPdu):
              PduRSourcePduHandleId = 11
              PduRSrcModule = COM
              PduRSrcPduUpTxConf = true
              PduRSrcPduCoreId = 0
              UserDefine = false
              PduRSrcPduRef = Cfg_D_Tx_BODY_LE1_CAN_MCM_D_1B6
            Dest_Cfg_D_Tx_BODY_LE1_CAN_MCM_D_1B6 (PduRDestPdu):
              PduRDestPduDataProvision = PDUR_DIRECT
              PduRDestPduHandleId = 0
              PduRTpThreshold = 7
              PduRTransmissionConfirmation = true
              PduRDestPduLength = 8
              PduRDestModule = CANIF
              PduRDestPduCoreId = 0
              UserDefine = false
              PduRDestPduRef = Cfg_D_Tx_BODY_LE1_CAN_MCM_D_1B6
          Cfg_D_Tx_BODY_LE1_CAN_MCM_D_1DF_COM_CANIF
            Src_Cfg_D_Tx_BODY_LE1_CAN_MCM_D_1DF (PduRSrcPdu):
              PduRSourcePduHandleId = 12
              PduRSrcModule = COM
              PduRSrcPduUpTxConf = true
              PduRSrcPduCoreId = 0
              UserDefine = false
              PduRSrcPduRef = Cfg_D_Tx_BODY_LE1_CAN_MCM_D_1DF
            Dest_Cfg_D_Tx_BODY_LE1_CAN_MCM_D_1DF (PduRDestPdu):
              PduRDestPduDataProvision = PDUR_DIRECT
              PduRDestPduHandleId = 0
              PduRTpThreshold = 7
              PduRTransmissionConfirmation = true
              PduRDestPduLength = 8
              PduRDestModule = CANIF
              PduRDestPduCoreId = 0
              UserDefine = false
              PduRDestPduRef = Cfg_D_Tx_BODY_LE1_CAN_MCM_D_1DF
          Cfg_D_Tx_BODY_LE1_CAN_MCM_D_1E0_COM_CANIF
            Src_Cfg_D_Tx_BODY_LE1_CAN_MCM_D_1E0 (PduRSrcPdu):
              PduRSourcePduHandleId = 13
              PduRSrcModule = COM
              PduRSrcPduUpTxConf = true
              PduRSrcPduCoreId = 0
              UserDefine = false
              PduRSrcPduRef = Cfg_D_Tx_BODY_LE1_CAN_MCM_D_1E0
            Dest_Cfg_D_Tx_BODY_LE1_CAN_MCM_D_1E0 (PduRDestPdu):
              PduRDestPduDataProvision = PDUR_DIRECT
              PduRDestPduHandleId = 0
              PduRTpThreshold = 7
              PduRTransmissionConfirmation = true
              PduRDestPduLength = 8
              PduRDestModule = CANIF
              PduRDestPduCoreId = 0
              UserDefine = false
              PduRDestPduRef = Cfg_D_Tx_BODY_LE1_CAN_MCM_D_1E0
          Cfg_D_Tx_BODY_LE1_CAN_MCM_D_1E1_COM_CANIF
            Src_Cfg_D_Tx_BODY_LE1_CAN_MCM_D_1E1 (PduRSrcPdu):
              PduRSourcePduHandleId = 14
              PduRSrcModule = COM
              PduRSrcPduUpTxConf = true
              PduRSrcPduCoreId = 0
              UserDefine = false
              PduRSrcPduRef = Cfg_D_Tx_BODY_LE1_CAN_MCM_D_1E1
            Dest_Cfg_D_Tx_BODY_LE1_CAN_MCM_D_1E1 (PduRDestPdu):
              PduRDestPduDataProvision = PDUR_DIRECT
              PduRDestPduHandleId = 0
              PduRTpThreshold = 7
              PduRTransmissionConfirmation = true
              PduRDestPduLength = 8
              PduRDestModule = CANIF
              PduRDestPduCoreId = 0
              UserDefine = false
              PduRDestPduRef = Cfg_D_Tx_BODY_LE1_CAN_MCM_D_1E1
          Cfg_D_Tx_BODY_LE1_CAN_MCM_D_1E8_COM_CANIF
            Src_Cfg_D_Tx_BODY_LE1_CAN_MCM_D_1E8 (PduRSrcPdu):
              PduRSourcePduHandleId = 15
              PduRSrcModule = COM
              PduRSrcPduUpTxConf = true
              PduRSrcPduCoreId = 0
              UserDefine = false
              PduRSrcPduRef = Cfg_D_Tx_BODY_LE1_CAN_MCM_D_1E8
            Dest_Cfg_D_Tx_BODY_LE1_CAN_MCM_D_1E8 (PduRDestPdu):
              PduRDestPduDataProvision = PDUR_DIRECT
              PduRDestPduHandleId = 0
              PduRTpThreshold = 7
              PduRTransmissionConfirmation = true
              PduRDestPduLength = 8
              PduRDestModule = CANIF
              PduRDestPduCoreId = 0
              UserDefine = false
              PduRDestPduRef = Cfg_D_Tx_BODY_LE1_CAN_MCM_D_1E8
          Cfg_D_Tx_BODY_LE1_CAN_MCM_D_1EC_COM_CANIF
            Src_Cfg_D_Tx_BODY_LE1_CAN_MCM_D_1EC (PduRSrcPdu):
              PduRSourcePduHandleId = 16
              PduRSrcModule = COM
              PduRSrcPduUpTxConf = true
              PduRSrcPduCoreId = 0
              UserDefine = false
              PduRSrcPduRef = Cfg_D_Tx_BODY_LE1_CAN_MCM_D_1EC
            Dest_Cfg_D_Tx_BODY_LE1_CAN_MCM_D_1EC (PduRDestPdu):
              PduRDestPduDataProvision = PDUR_DIRECT
              PduRDestPduHandleId = 0
              PduRTpThreshold = 7
              PduRTransmissionConfirmation = true
              PduRDestPduLength = 8
              PduRDestModule = CANIF
              PduRDestPduCoreId = 0
              UserDefine = false
              PduRDestPduRef = Cfg_D_Tx_BODY_LE1_CAN_MCM_D_1EC
          Cfg_D_Rx_BODY_LE1_CAN_DIAG_REQ_AllECU_CANTP_DCM
            Src_Cfg_D_Rx_BODY_LE1_CAN_DIAG_REQ_AllECU (PduRSrcPdu):
              PduRSourcePduHandleId = 17
              PduRSrcModule = CANTP
              PduRSrcPduUpTxConf = true
              PduRSrcPduCoreId = 0
              UserDefine = false
              PduRSrcPduRef = Cfg_D_Rx_BODY_LE1_CAN_DIAG_REQ_AllECU
            Dest_Cfg_D_Rx_BODY_LE1_CAN_DIAG_REQ_AllECU (PduRDestPdu):
              PduRDestPduDataProvision = PDUR_DIRECT
              PduRDestPduHandleId = 0
              PduRTpThreshold = 7
              PduRTransmissionConfirmation = true
              PduRDestPduLength = 8
              PduRDestModule = DCM
              PduRDestPduCoreId = 0
              UserDefine = false
              PduRDestPduRef = Cfg_D_Rx_BODY_LE1_CAN_DIAG_REQ_AllECU
          Cfg_D_Rx_BODY_LE1_CAN_DIAG_REQ_MCM_D_CANTP_DCM
            Src_Cfg_D_Rx_BODY_LE1_CAN_DIAG_REQ_MCM_D (PduRSrcPdu):
              PduRSourcePduHandleId = 18
              PduRSrcModule = CANTP
              PduRSrcPduUpTxConf = true
              PduRSrcPduCoreId = 0
              UserDefine = false
              PduRSrcPduRef = Cfg_D_Rx_BODY_LE1_CAN_DIAG_REQ_MCM_D
            Dest_Cfg_D_Rx_BODY_LE1_CAN_DIAG_REQ_MCM_D (PduRDestPdu):
              PduRDestPduDataProvision = PDUR_DIRECT
              PduRDestPduHandleId = 0
              PduRTpThreshold = 7
              PduRTransmissionConfirmation = true
              PduRDestPduLength = 8
              PduRDestModule = DCM
              PduRDestPduCoreId = 0
              UserDefine = false
              PduRDestPduRef = Cfg_D_Rx_BODY_LE1_CAN_DIAG_REQ_MCM_D
          Cfg_D_Tx_BODY_LE1_CAN_DIAG_RESP_MCM_D_DCM_CANTP
            Src_Cfg_D_Tx_BODY_LE1_CAN_DIAG_RESP_MCM_D (PduRSrcPdu):
              PduRSourcePduHandleId = 19
              PduRSrcModule = DCM
              PduRSrcPduUpTxConf = true
              PduRSrcPduCoreId = 0
              UserDefine = false
              PduRSrcPduRef = Cfg_D_Tx_BODY_LE1_CAN_DIAG_RESP_MCM_D
            Dest_Cfg_D_Tx_BODY_LE1_CAN_DIAG_RESP_MCM_D (PduRDestPdu):
              PduRDestPduDataProvision = PDUR_DIRECT
              PduRDestPduHandleId = 0
              PduRTpThreshold = 7
              PduRTransmissionConfirmation = true
              PduRDestPduLength = 8
              PduRDestModule = CANTP
              PduRDestPduCoreId = 0
              UserDefine = false
              PduRDestPduRef = Cfg_D_Tx_BODY_LE1_CAN_DIAG_RESP_MCM_D
      PduRBufferTable: PduRMaxTxBufferNumber=0
      PduRBufferPoolTable_Core0 (PduRBufferPoolTable): BufferCoreID=0
    Cfg_P (PduRRoutingTables): PduRConfigurationId=0, UserDefine=false
      PduRRoutingTable: PduRMaxRoutingPathCnt=255, PduRMaxRoutingPathGroupCnt=255, PduRMaxRoutingTableCnt=255
        20 x PduRRoutingPath, all with UserDefine=false:
          Cfg_P_Rx_BODY_LE1_CAN_BCU_11E_CANIF_COM
            Src_Cfg_P_Rx_BODY_LE1_CAN_BCU_11E (PduRSrcPdu):
              PduRSourcePduHandleId = 0
              PduRSrcModule = CANIF
              PduRSrcPduUpTxConf = true
              PduRSrcPduCoreId = 0
              UserDefine = false
              PduRSrcPduRef = Cfg_P_Rx_BODY_LE1_CAN_BCU_11E
            Dest_Cfg_P_Rx_BODY_LE1_CAN_BCU_11E (PduRDestPdu):
              PduRDestPduDataProvision = PDUR_DIRECT
              PduRDestPduHandleId = 0
              PduRTpThreshold = 7
              PduRTransmissionConfirmation = true
              PduRDestPduLength = 8
              PduRDestModule = COM
              PduRDestPduCoreId = 0
              UserDefine = false
              PduRDestPduRef = Cfg_P_Rx_BODY_LE1_CAN_BCU_11E
          Cfg_P_Rx_BODY_LE1_CAN_ZONE_13C_CANIF_COM
            Src_Cfg_P_Rx_BODY_LE1_CAN_ZONE_13C (PduRSrcPdu):
              PduRSourcePduHandleId = 1
              PduRSrcModule = CANIF
              PduRSrcPduUpTxConf = true
              PduRSrcPduCoreId = 0
              UserDefine = false
              PduRSrcPduRef = Cfg_P_Rx_BODY_LE1_CAN_ZONE_13C
            Dest_Cfg_P_Rx_BODY_LE1_CAN_ZONE_13C (PduRDestPdu):
              PduRDestPduDataProvision = PDUR_DIRECT
              PduRDestPduHandleId = 0
              PduRTpThreshold = 7
              PduRTransmissionConfirmation = true
              PduRDestPduLength = 8
              PduRDestModule = COM
              PduRDestPduCoreId = 0
              UserDefine = false
              PduRDestPduRef = Cfg_P_Rx_BODY_LE1_CAN_ZONE_13C
          Cfg_P_Rx_BODY_LE1_CAN_ZONE_MCM_06_CANIF_COM
            Src_Cfg_P_Rx_BODY_LE1_CAN_ZONE_MCM_06 (PduRSrcPdu):
              PduRSourcePduHandleId = 2
              PduRSrcModule = CANIF
              PduRSrcPduUpTxConf = true
              PduRSrcPduCoreId = 0
              UserDefine = false
              PduRSrcPduRef = Cfg_P_Rx_BODY_LE1_CAN_ZONE_MCM_06
            Dest_Cfg_P_Rx_BODY_LE1_CAN_ZONE_MCM_06 (PduRDestPdu):
              PduRDestPduDataProvision = PDUR_DIRECT
              PduRDestPduHandleId = 0
              PduRTpThreshold = 7
              PduRTransmissionConfirmation = true
              PduRDestPduLength = 8
              PduRDestModule = COM
              PduRDestPduCoreId = 0
              UserDefine = false
              PduRDestPduRef = Cfg_P_Rx_BODY_LE1_CAN_ZONE_MCM_06
          Cfg_P_Rx_BODY_LE1_CAN_ZONE_1CF_CANIF_COM
            Src_Cfg_P_Rx_BODY_LE1_CAN_ZONE_1CF (PduRSrcPdu):
              PduRSourcePduHandleId = 3
              PduRSrcModule = CANIF
              PduRSrcPduUpTxConf = true
              PduRSrcPduCoreId = 0
              UserDefine = false
              PduRSrcPduRef = Cfg_P_Rx_BODY_LE1_CAN_ZONE_1CF
            Dest_Cfg_P_Rx_BODY_LE1_CAN_ZONE_1CF (PduRDestPdu):
              PduRDestPduDataProvision = PDUR_DIRECT
              PduRDestPduHandleId = 0
              PduRTpThreshold = 7
              PduRTransmissionConfirmation = true
              PduRDestPduLength = 8
              PduRDestModule = COM
              PduRDestPduCoreId = 0
              UserDefine = false
              PduRDestPduRef = Cfg_P_Rx_BODY_LE1_CAN_ZONE_1CF
          Cfg_P_Rx_BODY_LE1_CAN_Zone_FL_MCM_03_CANIF_COM
            Src_Cfg_P_Rx_BODY_LE1_CAN_Zone_FL_MCM_03 (PduRSrcPdu):
              PduRSourcePduHandleId = 4
              PduRSrcModule = CANIF
              PduRSrcPduUpTxConf = true
              PduRSrcPduCoreId = 0
              UserDefine = false
              PduRSrcPduRef = Cfg_P_Rx_BODY_LE1_CAN_Zone_FL_MCM_03
            Dest_Cfg_P_Rx_BODY_LE1_CAN_Zone_FL_MCM_03 (PduRDestPdu):
              PduRDestPduDataProvision = PDUR_DIRECT
              PduRDestPduHandleId = 0
              PduRTpThreshold = 7
              PduRTransmissionConfirmation = true
              PduRDestPduLength = 8
              PduRDestModule = COM
              PduRDestPduCoreId = 0
              UserDefine = false
              PduRDestPduRef = Cfg_P_Rx_BODY_LE1_CAN_Zone_FL_MCM_03
          Cfg_P_Rx_BODY_LE1_CAN_Zone_FL_MCM_04_CANIF_COM
            Src_Cfg_P_Rx_BODY_LE1_CAN_Zone_FL_MCM_04 (PduRSrcPdu):
              PduRSourcePduHandleId = 5
              PduRSrcModule = CANIF
              PduRSrcPduUpTxConf = true
              PduRSrcPduCoreId = 0
              UserDefine = false
              PduRSrcPduRef = Cfg_P_Rx_BODY_LE1_CAN_Zone_FL_MCM_04
            Dest_Cfg_P_Rx_BODY_LE1_CAN_Zone_FL_MCM_04 (PduRDestPdu):
              PduRDestPduDataProvision = PDUR_DIRECT
              PduRDestPduHandleId = 0
              PduRTpThreshold = 7
              PduRTransmissionConfirmation = true
              PduRDestPduLength = 8
              PduRDestModule = COM
              PduRDestPduCoreId = 0
              UserDefine = false
              PduRDestPduRef = Cfg_P_Rx_BODY_LE1_CAN_Zone_FL_MCM_04
          Cfg_P_Rx_BODY_LE1_CAN_ZONE_2EF_CANIF_COM
            Src_Cfg_P_Rx_BODY_LE1_CAN_ZONE_2EF (PduRSrcPdu):
              PduRSourcePduHandleId = 6
              PduRSrcModule = CANIF
              PduRSrcPduUpTxConf = true
              PduRSrcPduCoreId = 0
              UserDefine = false
              PduRSrcPduRef = Cfg_P_Rx_BODY_LE1_CAN_ZONE_2EF
            Dest_Cfg_P_Rx_BODY_LE1_CAN_ZONE_2EF (PduRDestPdu):
              PduRDestPduDataProvision = PDUR_DIRECT
              PduRDestPduHandleId = 0
              PduRTpThreshold = 7
              PduRTransmissionConfirmation = true
              PduRDestPduLength = 8
              PduRDestModule = COM
              PduRDestPduCoreId = 0
              UserDefine = false
              PduRDestPduRef = Cfg_P_Rx_BODY_LE1_CAN_ZONE_2EF
          Cfg_P_Rx_BODY_LE1_CAN_ZONE_3A9_CANIF_COM
            Src_Cfg_P_Rx_BODY_LE1_CAN_ZONE_3A9 (PduRSrcPdu):
              PduRSourcePduHandleId = 7
              PduRSrcModule = CANIF
              PduRSrcPduUpTxConf = true
              PduRSrcPduCoreId = 0
              UserDefine = false
              PduRSrcPduRef = Cfg_P_Rx_BODY_LE1_CAN_ZONE_3A9
            Dest_Cfg_P_Rx_BODY_LE1_CAN_ZONE_3A9 (PduRDestPdu):
              PduRDestPduDataProvision = PDUR_DIRECT
              PduRDestPduHandleId = 0
              PduRTpThreshold = 7
              PduRTransmissionConfirmation = true
              PduRDestPduLength = 8
              PduRDestModule = COM
              PduRDestPduCoreId = 0
              UserDefine = false
              PduRDestPduRef = Cfg_P_Rx_BODY_LE1_CAN_ZONE_3A9
          Cfg_P_Rx_BODY_LE1_CAN_ZONE_3B2_CANIF_COM
            Src_Cfg_P_Rx_BODY_LE1_CAN_ZONE_3B2 (PduRSrcPdu):
              PduRSourcePduHandleId = 8
              PduRSrcModule = CANIF
              PduRSrcPduUpTxConf = true
              PduRSrcPduCoreId = 0
              UserDefine = false
              PduRSrcPduRef = Cfg_P_Rx_BODY_LE1_CAN_ZONE_3B2
            Dest_Cfg_P_Rx_BODY_LE1_CAN_ZONE_3B2 (PduRDestPdu):
              PduRDestPduDataProvision = PDUR_DIRECT
              PduRDestPduHandleId = 0
              PduRTpThreshold = 7
              PduRTransmissionConfirmation = true
              PduRDestPduLength = 8
              PduRDestModule = COM
              PduRDestPduCoreId = 0
              UserDefine = false
              PduRDestPduRef = Cfg_P_Rx_BODY_LE1_CAN_ZONE_3B2
          Cfg_P_Rx_BODY_LE1_CAN_ZONE_PNC_CANIF_COM
            Src_Cfg_P_Rx_BODY_LE1_CAN_ZONE_PNC (PduRSrcPdu):
              PduRSourcePduHandleId = 9
              PduRSrcModule = CANIF
              PduRSrcPduUpTxConf = true
              PduRSrcPduCoreId = 0
              UserDefine = false
              PduRSrcPduRef = Cfg_P_Rx_BODY_LE1_CAN_ZONE_PNC
            Dest_Cfg_P_Rx_BODY_LE1_CAN_ZONE_PNC (PduRDestPdu):
              PduRDestPduDataProvision = PDUR_DIRECT
              PduRDestPduHandleId = 0
              PduRTpThreshold = 7
              PduRTransmissionConfirmation = true
              PduRDestPduLength = 8
              PduRDestModule = COM
              PduRDestPduCoreId = 0
              UserDefine = false
              PduRDestPduRef = Cfg_P_Rx_BODY_LE1_CAN_ZONE_PNC
          Cfg_P_Rx_BODY_LE1_CAN_VC_Data_5E0_CANIF_COM
            Src_Cfg_P_Rx_BODY_LE1_CAN_VC_Data_5E0 (PduRSrcPdu):
              PduRSourcePduHandleId = 10
              PduRSrcModule = CANIF
              PduRSrcPduUpTxConf = true
              PduRSrcPduCoreId = 0
              UserDefine = false
              PduRSrcPduRef = Cfg_P_Rx_BODY_LE1_CAN_VC_Data_5E0
            Dest_Cfg_P_Rx_BODY_LE1_CAN_VC_Data_5E0 (PduRDestPdu):
              PduRDestPduDataProvision = PDUR_DIRECT
              PduRDestPduHandleId = 0
              PduRTpThreshold = 7
              PduRTransmissionConfirmation = true
              PduRDestPduLength = 8
              PduRDestModule = COM
              PduRDestPduCoreId = 0
              UserDefine = false
              PduRDestPduRef = Cfg_P_Rx_BODY_LE1_CAN_VC_Data_5E0
          Cfg_P_Tx_BODY_LE1_CAN_MCM_P_1B7_COM_CANIF
            Src_Cfg_P_Tx_BODY_LE1_CAN_MCM_P_1B7 (PduRSrcPdu):
              PduRSourcePduHandleId = 11
              PduRSrcModule = COM
              PduRSrcPduUpTxConf = true
              PduRSrcPduCoreId = 0
              UserDefine = false
              PduRSrcPduRef = Cfg_P_Tx_BODY_LE1_CAN_MCM_P_1B7
            Dest_Cfg_P_Tx_BODY_LE1_CAN_MCM_P_1B7 (PduRDestPdu):
              PduRDestPduDataProvision = PDUR_DIRECT
              PduRDestPduHandleId = 0
              PduRTpThreshold = 7
              PduRTransmissionConfirmation = true
              PduRDestPduLength = 8
              PduRDestModule = CANIF
              PduRDestPduCoreId = 0
              UserDefine = false
              PduRDestPduRef = Cfg_P_Tx_BODY_LE1_CAN_MCM_P_1B7
          Cfg_P_Tx_BODY_LE1_CAN_MCM_P_1E2_COM_CANIF
            Src_Cfg_P_Tx_BODY_LE1_CAN_MCM_P_1E2 (PduRSrcPdu):
              PduRSourcePduHandleId = 12
              PduRSrcModule = COM
              PduRSrcPduUpTxConf = true
              PduRSrcPduCoreId = 0
              UserDefine = false
              PduRSrcPduRef = Cfg_P_Tx_BODY_LE1_CAN_MCM_P_1E2
            Dest_Cfg_P_Tx_BODY_LE1_CAN_MCM_P_1E2 (PduRDestPdu):
              PduRDestPduDataProvision = PDUR_DIRECT
              PduRDestPduHandleId = 0
              PduRTpThreshold = 7
              PduRTransmissionConfirmation = true
              PduRDestPduLength = 8
              PduRDestModule = CANIF
              PduRDestPduCoreId = 0
              UserDefine = false
              PduRDestPduRef = Cfg_P_Tx_BODY_LE1_CAN_MCM_P_1E2
          Cfg_P_Tx_BODY_LE1_CAN_MCM_P_1E3_COM_CANIF
            Src_Cfg_P_Tx_BODY_LE1_CAN_MCM_P_1E3 (PduRSrcPdu):
              PduRSourcePduHandleId = 13
              PduRSrcModule = COM
              PduRSrcPduUpTxConf = true
              PduRSrcPduCoreId = 0
              UserDefine = false
              PduRSrcPduRef = Cfg_P_Tx_BODY_LE1_CAN_MCM_P_1E3
            Dest_Cfg_P_Tx_BODY_LE1_CAN_MCM_P_1E3 (PduRDestPdu):
              PduRDestPduDataProvision = PDUR_DIRECT
              PduRDestPduHandleId = 0
              PduRTpThreshold = 7
              PduRTransmissionConfirmation = true
              PduRDestPduLength = 8
              PduRDestModule = CANIF
              PduRDestPduCoreId = 0
              UserDefine = false
              PduRDestPduRef = Cfg_P_Tx_BODY_LE1_CAN_MCM_P_1E3
          Cfg_P_Tx_BODY_LE1_CAN_MCM_P_1E4_COM_CANIF
            Src_Cfg_P_Tx_BODY_LE1_CAN_MCM_P_1E4 (PduRSrcPdu):
              PduRSourcePduHandleId = 14
              PduRSrcModule = COM
              PduRSrcPduUpTxConf = true
              PduRSrcPduCoreId = 0
              UserDefine = false
              PduRSrcPduRef = Cfg_P_Tx_BODY_LE1_CAN_MCM_P_1E4
            Dest_Cfg_P_Tx_BODY_LE1_CAN_MCM_P_1E4 (PduRDestPdu):
              PduRDestPduDataProvision = PDUR_DIRECT
              PduRDestPduHandleId = 0
              PduRTpThreshold = 7
              PduRTransmissionConfirmation = true
              PduRDestPduLength = 8
              PduRDestModule = CANIF
              PduRDestPduCoreId = 0
              UserDefine = false
              PduRDestPduRef = Cfg_P_Tx_BODY_LE1_CAN_MCM_P_1E4
          Cfg_P_Tx_BODY_LE1_CAN_MCM_P_1EB_COM_CANIF
            Src_Cfg_P_Tx_BODY_LE1_CAN_MCM_P_1EB (PduRSrcPdu):
              PduRSourcePduHandleId = 15
              PduRSrcModule = COM
              PduRSrcPduUpTxConf = true
              PduRSrcPduCoreId = 0
              UserDefine = false
              PduRSrcPduRef = Cfg_P_Tx_BODY_LE1_CAN_MCM_P_1EB
            Dest_Cfg_P_Tx_BODY_LE1_CAN_MCM_P_1EB (PduRDestPdu):
              PduRDestPduDataProvision = PDUR_DIRECT
              PduRDestPduHandleId = 0
              PduRTpThreshold = 7
              PduRTransmissionConfirmation = true
              PduRDestPduLength = 8
              PduRDestModule = CANIF
              PduRDestPduCoreId = 0
              UserDefine = false
              PduRDestPduRef = Cfg_P_Tx_BODY_LE1_CAN_MCM_P_1EB
          Cfg_P_Tx_BODY_LE1_CAN_MCM_P_1ED_COM_CANIF
            Src_Cfg_P_Tx_BODY_LE1_CAN_MCM_P_1ED (PduRSrcPdu):
              PduRSourcePduHandleId = 16
              PduRSrcModule = COM
              PduRSrcPduUpTxConf = true
              PduRSrcPduCoreId = 0
              UserDefine = false
              PduRSrcPduRef = Cfg_P_Tx_BODY_LE1_CAN_MCM_P_1ED
            Dest_Cfg_P_Tx_BODY_LE1_CAN_MCM_P_1ED (PduRDestPdu):
              PduRDestPduDataProvision = PDUR_DIRECT
              PduRDestPduHandleId = 0
              PduRTpThreshold = 7
              PduRTransmissionConfirmation = true
              PduRDestPduLength = 8
              PduRDestModule = CANIF
              PduRDestPduCoreId = 0
              UserDefine = false
              PduRDestPduRef = Cfg_P_Tx_BODY_LE1_CAN_MCM_P_1ED
          Cfg_P_Rx_BODY_LE1_CAN_DIAG_REQ_AllECU_CANTP_DCM
            Src_Cfg_P_Rx_BODY_LE1_CAN_DIAG_REQ_AllECU (PduRSrcPdu):
              PduRSourcePduHandleId = 17
              PduRSrcModule = CANTP
              PduRSrcPduUpTxConf = true
              PduRSrcPduCoreId = 0
              UserDefine = false
              PduRSrcPduRef = Cfg_P_Rx_BODY_LE1_CAN_DIAG_REQ_AllECU
            Dest_Cfg_P_Rx_BODY_LE1_CAN_DIAG_REQ_AllECU (PduRDestPdu):
              PduRDestPduDataProvision = PDUR_DIRECT
              PduRDestPduHandleId = 0
              PduRTpThreshold = 7
              PduRTransmissionConfirmation = true
              PduRDestPduLength = 8
              PduRDestModule = DCM
              PduRDestPduCoreId = 0
              UserDefine = false
              PduRDestPduRef = Cfg_P_Rx_BODY_LE1_CAN_DIAG_REQ_AllECU
          Cfg_P_Rx_BODY_LE1_CAN_DIAG_REQ_MCM_P_CANTP_DCM
            Src_Cfg_P_Rx_BODY_LE1_CAN_DIAG_REQ_MCM_P (PduRSrcPdu):
              PduRSourcePduHandleId = 18
              PduRSrcModule = CANTP
              PduRSrcPduUpTxConf = true
              PduRSrcPduCoreId = 0
              UserDefine = false
              PduRSrcPduRef = Cfg_P_Rx_BODY_LE1_CAN_DIAG_REQ_MCM_P
            Dest_Cfg_P_Rx_BODY_LE1_CAN_DIAG_REQ_MCM_P (PduRDestPdu):
              PduRDestPduDataProvision = PDUR_DIRECT
              PduRDestPduHandleId = 0
              PduRTpThreshold = 7
              PduRTransmissionConfirmation = true
              PduRDestPduLength = 8
              PduRDestModule = DCM
              PduRDestPduCoreId = 0
              UserDefine = false
              PduRDestPduRef = Cfg_P_Rx_BODY_LE1_CAN_DIAG_REQ_MCM_P
          Cfg_P_Tx_BODY_LE1_CAN_DIAG_RESP_MCM_P_DCM_CANTP
            Src_Cfg_P_Tx_BODY_LE1_CAN_DIAG_RESP_MCM_P (PduRSrcPdu):
              PduRSourcePduHandleId = 19
              PduRSrcModule = DCM
              PduRSrcPduUpTxConf = true
              PduRSrcPduCoreId = 0
              UserDefine = false
              PduRSrcPduRef = Cfg_P_Tx_BODY_LE1_CAN_DIAG_RESP_MCM_P
            Dest_Cfg_P_Tx_BODY_LE1_CAN_DIAG_RESP_MCM_P (PduRDestPdu):
              PduRDestPduDataProvision = PDUR_DIRECT
              PduRDestPduHandleId = 0
              PduRTpThreshold = 7
              PduRTransmissionConfirmation = true
              PduRDestPduLength = 8
              PduRDestModule = CANTP
              PduRDestPduCoreId = 0
              UserDefine = false
              PduRDestPduRef = Cfg_P_Tx_BODY_LE1_CAN_DIAG_RESP_MCM_P
      PduRBufferTable: PduRMaxTxBufferNumber=0
      PduRBufferPoolTable_Core0 (PduRBufferPoolTable): BufferCoreID=0
    4 x PduRBswModules, all with PduRCancelReceive=false, PduRCancelTransmit=false:
      Com: PduRCommunicationInterface=true, PduRLowerModule=false, PduRRetransmission=false, PduRTransportProtocol=true, PduRTriggertransmit=true, PduRTxConfirmation=true, PduRUpperModule=true, PduRUseTag=true, PduRBswModuleRef=Com
      Dcm: PduRCommunicationInterface=true, PduRLowerModule=false, PduRRetransmission=false, PduRTransportProtocol=true, PduRTriggertransmit=false, PduRTxConfirmation=true, PduRUpperModule=true, PduRUseTag=true, PduRBswModuleRef=Dcm
      CanIf: PduRCommunicationInterface=true, PduRLowerModule=true, PduRRetransmission=false, PduRTransportProtocol=false, PduRTriggertransmit=false, PduRTxConfirmation=false, PduRUpperModule=false, PduRUseTag=false, PduRBswModuleRef=CanIf
      CanTp: PduRCommunicationInterface=false, PduRLowerModule=true, PduRRetransmission=true, PduRTransportProtocol=true, PduRTriggertransmit=false, PduRTxConfirmation=false, PduRUpperModule=false, PduRUseTag=false, PduRBswModuleRef=CanTp
  module config Rte: implementation-config-variant=STD_CONFIG_VARIANTS_PRECOMPILE, module_version_def=4.0.4, module_autosar_version=Ar470
    RteBswGeneral: RteSchMVersionInfoApi=false, RteDevErrorDetect=false, RteUserIncludeFile=, UserDefine=false, isNew=false
    RteGeneration:
      RteCalibrationSupport = NONE
      DataConstrSupport = NONE
      SwcInfoSupport = false
      SupportDefaultCalibrationAddrMethod = false
      SupportDistinguishingSameNameSignal = false
      GenerateCompuMethodEnumInfo = false
      DataConsistencyProtection = ALL_INTERRUPT_BLOCKING
      SWCFileOrganizationMethod = All_IN_RTE.C
      SignalConversionEnabled = false
      CreateADTPerSignal = true
      ComMultiCoreSupport = false
      CrossCoreEventAsyn = true
      GenerateHookFunction = false
      SRBufferPolicy = SenderReceiverInterfaceName
      UserDefine = false
      isNew = false
    15 x RteBswModuleInstance, all with UserDefine=false, isNew=false:
      BswM
        BswM_MainFunction (RteBswEventToTaskMapping):
          RteBswPositionInTask = 0
          RteBswActivationOffset = 1
          UserDefine = false
          isNew = true
          RteBswEventPeriod = 5
          RteBswEventRef = BswM_MainFunction
          RteBswUsedOsSchTblExpiryPointRef = /
        3 x RteBswExclusiveAreaImpl, all with RteExclusiveAreaImplMechanism=NONE, UserDefine=false, isNew=false:
          BSWM_EXCLUSIVE_AREA_{0..2}
      CanIf
        10 x RteBswExclusiveAreaImpl, all with RteExclusiveAreaImplMechanism=NONE, UserDefine=false, isNew=false:
          CANIF_EXCLUSIVE_AREA_{0..9}
      CanSM
        CanSM_MainFunction (RteBswEventToTaskMapping):
          RteBswPositionInTask = 0
          RteBswActivationOffset = 1
          UserDefine = false
          isNew = true
          RteBswEventPeriod = 5
          RteBswEventRef = CanSM_MainFunction
          RteBswUsedOsSchTblExpiryPointRef = /
        5 x RteBswExclusiveAreaImpl, all with RteExclusiveAreaImplMechanism=NONE, UserDefine=false, isNew=false:
          CANSM_EXCLUSIVE_AREA_{0..4}
      CanTp
        CanTp_MainFunction (RteBswEventToTaskMapping):
          RteBswPositionInTask = 0
          RteBswActivationOffset = 1
          UserDefine = false
          isNew = true
          RteBswEventPeriod = 10
          RteBswEventRef = CanTp_MainFunction
          RteBswUsedOsSchTblExpiryPointRef = /
        CANTP_EXCLUSIVE_AREA_0 (RteBswExclusiveAreaImpl): RteExclusiveAreaImplMechanism=NONE, UserDefine=false, isNew=false
        CANTP_EXCLUSIVE_AREA_1 (RteBswExclusiveAreaImpl): RteExclusiveAreaImplMechanism=NONE, UserDefine=false, isNew=false
      Com
        6 x RteBswEventToTaskMapping, all with RteBswPositionInTask=0, RteBswActivationOffset=1, UserDefine=false, isNew=false, RteBswEventPeriod=10, RteBswUsedOsSchTblExpiryPointRef=/:
          Com_ComMainFunctionRx10ms_R: RteBswEventRef=Com_ComMainFunctionRx10ms_R
          Com_ComMainFunctionTx10ms_T: RteBswEventRef=Com_ComMainFunctionTx10ms_T
          Com_ComMainFunctionRx10msD_R: RteBswEventRef=Com_ComMainFunctionRx10msD_R
          Com_ComMainFunctionTx10msD_T: RteBswEventRef=Com_ComMainFunctionTx10msD_T
          Com_ComMainFunction0_R: RteBswEventRef=Com_ComMainFunction0_R
          Com_ComMainFunction1_T: RteBswEventRef=Com_ComMainFunction1_T
        14 x RteBswExclusiveAreaImpl, all with RteExclusiveAreaImplMechanism=NONE, UserDefine=false, isNew=false:
          COM_EXCLUSIVE_AREA_{0..13}
      ComM
        ComM_ComM_BODY_LE1_CAN (RteBswEventToTaskMapping):
          RteBswPositionInTask = 0
          RteBswActivationOffset = 1
          UserDefine = false
          isNew = true
          RteBswEventPeriod = 5
          RteBswEventRef = ComM_ComM_BODY_LE1_CAN
          RteBswUsedOsSchTblExpiryPointRef = /
        ComM_ComM_SZQ_EAS_CAN0 (RteBswEventToTaskMapping):
          RteBswPositionInTask = 0
          RteBswActivationOffset = 1
          UserDefine = false
          isNew = false
          RteBswEventPeriod = 10
          RteBswEventRef = ComM_ComM_SZQ_EAS_CAN0
          RteBswUsedOsSchTblExpiryPointRef = /
        10 x RteBswExclusiveAreaImpl, all with RteExclusiveAreaImplMechanism=NONE, UserDefine=false, isNew=false:
          COMM_EXCLUSIVE_AREA_{0..9}
      Dcm
        Dcm_MainFunction (RteBswEventToTaskMapping):
          RteBswPositionInTask = 0
          RteBswActivationOffset = 1
          UserDefine = false
          isNew = true
          RteBswEventPeriod = 10
          RteBswEventRef = Dcm_MainFunction
          RteBswUsedOsSchTblExpiryPointRef = /
        3 x RteBswExclusiveAreaImpl, all with RteExclusiveAreaImplMechanism=NONE, UserDefine=false, isNew=false:
          DCM_EXCLUSIVE_AREA_{0..2}
      Dem
        Dem_MainFunction (RteBswEventToTaskMapping):
          RteBswPositionInTask = 0
          RteBswActivationOffset = 1
          UserDefine = false
          isNew = true
          RteBswEventPeriod = 10
          RteBswEventRef = Dem_MainFunction
          RteBswUsedOsSchTblExpiryPointRef = /
        DEM_EXCLUSIVE_AREA_0 (RteBswExclusiveAreaImpl): RteExclusiveAreaImplMechanism=NONE, UserDefine=false, isNew=false
        DEM_EXCLUSIVE_AREA_1 (RteBswExclusiveAreaImpl): RteExclusiveAreaImplMechanism=NONE, UserDefine=false, isNew=false
      Det
      EcuC
        ECUC_EXCLUSIVE_AREA_0 (RteBswExclusiveAreaImpl): RteExclusiveAreaImplMechanism=NONE, UserDefine=false, isNew=false
      EcuM
        EcuM_MainFunction (RteBswEventToTaskMapping):
          RteBswPositionInTask = 0
          RteBswActivationOffset = 1
          UserDefine = false
          isNew = true
          RteBswEventPeriod = 5
          RteBswEventRef = EcuM_MainFunction
          RteBswUsedOsSchTblExpiryPointRef = /
        EcuM_StartupTwo (RteBswEventToTaskMapping):
          RteBswPositionInTask = 0
          RteBswActivationOffset = 1
          UserDefine = false
          isNew = true
          RteBswEventPeriod = 5
          RteBswEventRef = EcuM_StartupTwo
          RteBswUsedOsSchTblExpiryPointRef = /
        5 x RteBswExclusiveAreaImpl, all with RteExclusiveAreaImplMechanism=NONE, UserDefine=false, isNew=false:
          ECUM_EXCLUSIVE_AREA_{0..4}
      MemIf
      NvM
        NvM_MainFunction (RteBswEventToTaskMapping):
          RteBswPositionInTask = 0
          RteBswActivationOffset = 1
          UserDefine = false
          isNew = true
          RteBswEventPeriod = 10
          RteBswEventRef = NvM_MainFunction
          RteBswUsedOsSchTblExpiryPointRef = /
        NVM_EXCLUSIVE_AREA_0 (RteBswExclusiveAreaImpl): RteExclusiveAreaImplMechanism=NONE, UserDefine=false, isNew=false
      PduR
        3 x RteBswExclusiveAreaImpl, all with RteExclusiveAreaImplMechanism=NONE, UserDefine=false, isNew=false:
          PDUR_EXCLUSIVE_AREA_{0..2}
      Rte
