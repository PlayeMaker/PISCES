AUTOSAR XML (schema 00046)
package /EAS
  ecuc definition collection AUTOSARParameterDefinition: module=EcuM
  module config EcuM: implementation-config-variant=STD_CONFIG_VARIANTS_POSTBUILD, module_version_def=4.0.4, module_autosar_version=Ar470
    EcuMGeneral:
      VersionCheck = true
      EcuMDevErrorDetect = false
      EcuMVersionInfoApi = true
      EcuMIncludeDet = true
      EcuMMainFunctionPeriod = 5
      EcuMCoreNumber = 1
      EcuMCoreMasterId = 0
    EcuMFlexGeneral: EcuMAlarmClockPresent=false, EcuMResetLoopDetection=false, EcuMModeHandling=true, EcuMSetProgrammableInterrupts=true
    EcuMCfgSet0 (EcuMConfiguration)
      EcuMCommonConfiguration: EcuMConfigConsistencyHash=0xd051109b, InterruptsBlockMechanism=NONE, EcuMIgnoreWakeupEvValOffPreOS=false, EcuMDefaultAppMode=0
        EcuMDefaultShutdownTarget: EcuMDefaultState=EcuMShutDownOff
        5 x EcuMWakeupSource, all with EcuMValidationTimeout=0, EcuMCheckWakeupTimeout=0, EcuMWakeupSourcePolling=false:
          WkSource_Power: EcuMWakeupSourceId=0
          WkSource_Reset: EcuMWakeupSourceId=1
          WkSource_Internal_Reset: EcuMWakeupSourceId=2
          WkSource_Internal_Wdg: EcuMWakeupSourceId=3
          WkSource_External_Wdg: EcuMWakeupSourceId=4
      EcuMFlexConfiguration: EcuMNormalMcuModeRef=0
        3 x EcuMResetMode:
          Reset_Mcu: EcuMResetModeId=0
          Reset_Wdg: EcuMResetModeId=1
          Reset_IO: EcuMResetModeId=2
        4 x EcuMShutdownCause:
          Cause_Unknown: EcuMShutdownCauseId=0
          Cause_Ecu_State: EcuMShutdownCauseId=1
          Cause_WdgM: EcuMShutdownCauseId=2
          Cause_Dcm: EcuMShutdownCauseId=3
        User0 (EcuMFlexUserConfig): EcuMFlexUser=0x0
        CoreConfig_0 (EcuMCoreConfig): OsCore=Core0, EcuMSleepEventRef=/EAS/Os/OsEvent/, EcuMShutdownEventRef=/EAS/Os/OsEvent/
