AUTOSAR XML (schema 00046)
package /EAS
  ecuc definition collection AUTOSARParameterDefinition: module=CanSM
  module config CanSM: implementation-config-variant=STD_CONFIG_VARIANTS_POSTBUILD, module_version_def=4.1.0, module_autosar_version=Ar470
    CanSMGeneral:
      VersionCheck = true
      CanSMDevErrorDetect = true
      CanSMMainFunctionTimePeriod = 5
      CanSMVersionInfoApi = false
      CanSMTxOfflineActiveSupport = false
      CanSMEnableBusOffDelay = false
      CanSMSetBaudrateApi = false
      CanSMPncSupport = false
      CanSMNoReqInWait = false
      CanSMLightNmSupport = false
      CanSMBswMSupport = true
      CanSMCtrlOptSupport = false
      CanSMComMNwOptSupport = false
      CanSMMultiCoreSupport = false
      CanSMCarPlatform = CANSM_NONE_PLATFORM
      CanSMCanControllerSleepModeSupport = true
    Cfg_D (CanSMConfiguration): CanSMModeRequestRepetitionMax=1, CanSMModeRequestRepetitionTime=10, UserDefine=false
      CanSM_BODY_LE1_CAN (CanSMManagerNetwork):
        CanSMBorCounterL1ToL2 = 5
        CanSMBorTimeL1 = 50
        CanSMBorTimeL2 = 1000
        CanSMBorTimeTxEnsured = 100
        CanSMBorTxConfirmationPolling = true
        FilePath = BODY_LE1_CAN
        UserDefine = false
        CanSMComMNetworkHandleRef = ComM_BODY_LE1_CAN
        CanSMController: CanSMControllerId=CanIf_BODY_LE1_CAN
    Cfg_P (CanSMConfiguration): CanSMModeRequestRepetitionMax=1, CanSMModeRequestRepetitionTime=10, UserDefine=false
      CanSM_BODY_LE1_CAN (CanSMManagerNetwork):
        CanSMBorCounterL1ToL2 = 5
        CanSMBorTimeL1 = 50
        CanSMBorTimeL2 = 1000
        CanSMBorTimeTxEnsured = 100
        CanSMBorTxConfirmationPolling = true
        FilePath = BODY_LE1_CAN
        UserDefine = false
        CanSMComMNetworkHandleRef = ComM_BODY_LE1_CAN
        CanSMController: CanSMControllerId=CanIf_BODY_LE1_CAN
