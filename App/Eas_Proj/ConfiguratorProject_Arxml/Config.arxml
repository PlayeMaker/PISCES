AUTOSAR XML (schema 00046)
package /EcucDefs
  ecuc definition collection AUTOSARParameterDefinition: module=[Base, BswM, CanIf, CanSM, CanTp, Com, ComM, Dcm, Dem, Det, EcuC, EcuM, MemIf, MemMap, NvM, PduR, Rte]
  eas_extmodule_def eas_extmodule_type=Can, eas_extmodule_name=/YTM32MX_0_9_1_Can/Can:
    CAN0 (CanController): CanWakeUpSourceFilter=, CanControllerId=0
    CanConfigSet
      20 x CanHardwareObject, all with CanIdType=STANDARD, CanControllerRef=CAN0:
        HOH0_BCU_11E: CanObjectType=RECEIVE, CanObjectId=0
        HOH2_DIAG_REQ_AllECU: CanObjectType=RECEIVE, CanObjectId=1
        HOH3_DIAG_REQ_MCMD_623_MCMP_624: CanObjectType=RECEIVE, CanObjectId=2
        HOH4_VC_Data_5E0: CanObjectType=RECEIVE, CanObjectId=3
        HOH5_ZONE_13C: CanObjectType=RECEIVE, CanObjectId=4
        HOH6_ZONE_MCMD_1C9_MCMP_1CF: CanObjectType=RECEIVE, CanObjectId=5
        HOH7_ZONE_2EF: CanObjectType=RECEIVE, CanObjectId=6
        HOH8_ZONE_3A9: CanObjectType=RECEIVE, CanObjectId=7
        HOH9_ZONE_3B2: CanObjectType=RECEIVE, CanObjectId=8
        HOH10_MCMD_Zone_FL_MCM_01_1D1_MCMP_Zone_FL_MCM_03_1D3: CanObjectType=RECEIVE, CanObjectId=9
        HOH11_MCMD_Zone_FL_MCM_02_1D2_MCMP_Zone_FL_MCM_04_1D4: CanObjectType=RECEIVE, CanObjectId=10
        HOH12_MCMD_ZONE_MCM_05_1B4_MCMP_ZONE_MCM_06_1B5: CanObjectType=RECEIVE, CanObjectId=11
        HOH13_ZONE_PNC: CanObjectType=RECEIVE, CanObjectId=12
        HOH15_DIAG_RESP_MCM_D_6A3_MCMP_6A4: CanObjectType=TRANSMIT, CanObjectId=13
        HOH16_MCM_D_1B6_MCM_P_1B7: CanObjectType=TRANSMIT, CanObjectId=14
        HOH17_MCM_D_1DF_MCM_P_1E2: CanObjectType=TRANSMIT, CanObjectId=15
        HOH18_MCM_D_1E0_MCM_P_1E3: CanObjectType=TRANSMIT, CanObjectId=16
        HOH19_MCM_D_1E1_MCM_P_1E4: CanObjectType=TRANSMIT, CanObjectId=17
        HOH20_MCM_D_1E8_MCM_P_1EB: CanObjectType=TRANSMIT, CanObjectId=18
        HOH21_MCM_D_1EC_MCM_P_1ED: CanObjectType=TRANSMIT, CanObjectId=19
