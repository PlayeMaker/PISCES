AUTOSAR XML (schema 00046)
package /EAS
  ecuc definition collection AUTOSARParameterDefinition: module=CanIf
  module config CanIf: implementation-config-variant=STD_CONFIG_VARIANTS_POSTBUILD, module_version_def=4.2.0, module_autosar_version=Ar470
    CanIfPublicCfg:
      CanIfSetBaudrateApi = false
      CanIfPublicDevErrorDetect = false
      CanIfPublicMultipleDrvSupport = false
      CanIfPublicPnSupport = false
      CanIfPublicTxBuffering = false
      CanIfPublicSetDynamicTxIdApi = false
      CanIfPublicReadTxPduNotifyStatusApi = false
      CanIfPublicReadRxPduNotifyStatusApi = false
      CanIfPublicReadRxPduDataApi = false
      CanIfPublicVersionInfoApi = true
      CanIfPublicTxConfirmPollingSupport = true
      CanIfPublicWakeupCheckValidByNM = false
      CanIfPublicWakeupCheckValidByOsekNM = false
      CanIfPublicWakeupCheckValidSupport = false
      CanIfPublicWakeupCheckValidByCallout = false
      CanIfPublicIcomSupport = false
      CanIfMetaDataSupport = false
      CanIfTriggerTransmitSupport = false
      CanIfTxOfflineActiveSupport = false
      CanIfWakeupSupport = false
      CanIfPublicCddHeaderFile = 
      CanIfGenerate32BitsCanId = true
      BusMirroring = false
      CanIfPublicWakeupCheckValidByPnNm = false
      CanIfCanVersionNewerThan422 = true
    CanIfDispatchCfg:
      CanIfDispatchUserCheckTrcvWakeFlagIndicationUL = CANIF_DISPATCH_UL_CDD
      CanIfDispatchUserCheckTrcvWakeFlagIndicationName = 
      CanIfDispatchUserClearTrcvWufFlagIndicationUL = CANIF_DISPATCH_UL_CDD
      CanIfDispatchUserClearTrcvWufFlagIndicationName = 
      CanIfDispatchUserConfirmPnAvailabilityUL = CANIF_DISPATCH_UL_CDD
      CanIfDispatchUserConfirmPnAvailabilityName = 
      CanIfDispatchUserCtrlBusOffUL = CANIF_DISPATCH_UL_CAN_SM
      CanIfDispatchUserCtrlBusOffName = CanSM_ControllerBusOff
      CanIfDispatchUserCtrlModeIndicationUL = CANIF_DISPATCH_UL_CAN_SM
      CanIfDispatchUserCtrlModeIndicationName = CanSM_ControllerModeIndication
      CanIfDispatchUserTrcvModeIndicationUL = CANIF_DISPATCH_UL_CAN_SM
      CanIfDispatchUserTrcvModeIndicationName = CanSM_TransceiverModeIndication
      CanIfDispatchUserValidateWakeupEventUL = CANIF_DISPATCH_UL_CAN_ECUM
      CanIfDispatchUserValidateWakeupEventName = EcuM_ValidateWakeupEvent
      CanIfDispatchUserCurrentIComUL = CANIF_DISPATCH_UL_CAN_SM
      CanIfDispatchUserCurrentIComName = CanSM_CurrentIcomConfiguration
    CanIfPrivateCfg:
      VersionCheck = true
      CanIfPrivateDataLengthCheck = true
      CanIfDlcCheckType = CANIF_DLC_CHECK_AUTOSAR
      CanIfPrivateSoftwareFilterType = CANIF_FILTER_TYPE_INDEX
      CanIfHohOptimze = false
      CanIfSupportTTCAN = false
      CanIfSupportCanIDExtension = true
      CanIfFixedBuffer = true
      CanIfCanFdSupport = true
      CanIfPrivateTxSwFifoSupport = false
      CanIfPrivateTxSwFifoDebug = false
      CanIfPrivateTxSwFifoMainFunction = false
      CanIfPrivateRxPnSupport = false
      CanIfPrivateTxSwFifoTimeout = 20
      CanIfPrivateTxSwFifoMainFunctionPeriodTime = 10
    Cfg_D (CanIfInitCfg): UserDefine=false
      InitHohCfg (CanIfInitHohCfg): CanIfInitRefCfgSet=CanConfigSet
        7 x CanIfHthCfg, all with CanIfHthCanCtrlIdRef=CanIf_BODY_LE1_CAN, CanIfHthFifoDepth=0, CanIfHthMaxdlc=8:
          HOH15_DIAG_RESP_MCM_D_6A3_MCMP_6A4: CanIfHthIdSymRef=HOH15_DIAG_RESP_MCM_D_6A3_MCMP_6A4
          HOH16_MCM_D_1B6_MCM_P_1B7: CanIfHthIdSymRef=HOH16_MCM_D_1B6_MCM_P_1B7
          HOH17_MCM_D_1DF_MCM_P_1E2: CanIfHthIdSymRef=HOH17_MCM_D_1DF_MCM_P_1E2
          HOH18_MCM_D_1E0_MCM_P_1E3: CanIfHthIdSymRef=HOH18_MCM_D_1E0_MCM_P_1E3
          HOH19_MCM_D_1E1_MCM_P_1E4: CanIfHthIdSymRef=HOH19_MCM_D_1E1_MCM_P_1E4
          HOH20_MCM_D_1E8_MCM_P_1EB: CanIfHthIdSymRef=HOH20_MCM_D_1E8_MCM_P_1EB
          HOH21_MCM_D_1EC_MCM_P_1ED: CanIfHthIdSymRef=HOH21_MCM_D_1EC_MCM_P_1ED
        13 x CanIfHrhCfg, all with CanIfHohCanCtrlIdRef=CanIf_BODY_LE1_CAN:
          HOH0_BCU_11E: CanIfHrhIdSymRef=HOH0_BCU_11E
          HOH2_DIAG_REQ_AllECU: CanIfHrhIdSymRef=HOH2_DIAG_REQ_AllECU
          HOH3_DIAG_REQ_MCMD_623_MCMP_624: CanIfHrhIdSymRef=HOH3_DIAG_REQ_MCMD_623_MCMP_624
          HOH4_VC_Data_5E0: CanIfHrhIdSymRef=HOH4_VC_Data_5E0
          HOH5_ZONE_13C: CanIfHrhIdSymRef=HOH5_ZONE_13C
          HOH6_ZONE_MCMD_1C9_MCMP_1CF: CanIfHrhIdSymRef=HOH6_ZONE_MCMD_1C9_MCMP_1CF
          HOH7_ZONE_2EF: CanIfHrhIdSymRef=HOH7_ZONE_2EF
          HOH8_ZONE_3A9: CanIfHrhIdSymRef=HOH8_ZONE_3A9
          HOH9_ZONE_3B2: CanIfHrhIdSymRef=HOH9_ZONE_3B2
          HOH10_MCMD_Zone_FL_MCM_01_1D1_MCMP_Zone_FL_MCM_03_1D3: CanIfHrhIdSymRef=HOH10_MCMD_Zone_FL_MCM_01_1D1_MCMP_Zone_FL_MCM_03_1D3
          HOH11_MCMD_Zone_FL_MCM_02_1D2_MCMP_Zone_FL_MCM_04_1D4: CanIfHrhIdSymRef=HOH11_MCMD_Zone_FL_MCM_02_1D2_MCMP_Zone_FL_MCM_04_1D4
          HOH12_MCMD_ZONE_MCM_05_1B4_MCMP_ZONE_MCM_06_1B5: CanIfHrhIdSymRef=HOH12_MCMD_ZONE_MCM_05_1B4_MCMP_ZONE_MCM_06_1B5
          HOH13_ZONE_PNC: CanIfHrhIdSymRef=HOH13_ZONE_PNC
      7 x CanIfTxPduCfg, all with CanIfTxPduCanIdType=STANDARD_NO_FD_CAN, CanIfPduDlc=8, CanIfTxPduPnFilterPdu=false, CanIfTxPduReadNotifyStatus=false, CanIfTxPduType=STATIC, CanIfTxPduTriggerTransmit=false, CanIfTxPduUserTriggerTransmitName=NULL_PTR, CanIfTxPduCanIdMask=0x1FFFFFFF, CanIfTxPduTruncation=true, UserDefine=false, NetworkName=BODY_LE1_CAN:
        Cfg_D_Tx_BODY_LE1_CAN_MCM_D_1B6: CanIfPduCanId=0x1b6, CanIfTxPduUserTxConfirmationUL=PDUR, CanIfTxPduUserTxConfirmationName=PduR_LoIfTxConfirmation, uplayerPduRef=Cfg_D_Tx_BODY_LE1_CAN_MCM_D_1B6, CanIfTxPduBufferRef=Cfg_D/Buffer_HOH16_MCM_D_1B6_MCM_P_1B7
        Cfg_D_Tx_BODY_LE1_CAN_MCM_D_1DF: CanIfPduCanId=0x1df, CanIfTxPduUserTxConfirmationUL=PDUR, CanIfTxPduUserTxConfirmationName=PduR_LoIfTxConfirmation, uplayerPduRef=Cfg_D_Tx_BODY_LE1_CAN_MCM_D_1DF, CanIfTxPduBufferRef=Cfg_D/Buffer_HOH17_MCM_D_1DF_MCM_P_1E2
        Cfg_D_Tx_BODY_LE1_CAN_MCM_D_1E0: CanIfPduCanId=0x1e0, CanIfTxPduUserTxConfirmationUL=PDUR, CanIfTxPduUserTxConfirmationName=PduR_LoIfTxConfirmation, uplayerPduRef=Cfg_D_Tx_BODY_LE1_CAN_MCM_D_1E0, CanIfTxPduBufferRef=Cfg_D/Buffer_HOH18_MCM_D_1E0_MCM_P_1E3
        Cfg_D_Tx_BODY_LE1_CAN_MCM_D_1E1: CanIfPduCanId=0x1e1, CanIfTxPduUserTxConfirmationUL=PDUR, CanIfTxPduUserTxConfirmationName=PduR_LoIfTxConfirmation, uplayerPduRef=Cfg_D_Tx_BODY_LE1_CAN_MCM_D_1E1, CanIfTxPduBufferRef=Cfg_D/Buffer_HOH19_MCM_D_1E1_MCM_P_1E4
        Cfg_D_Tx_BODY_LE1_CAN_MCM_D_1E8: CanIfPduCanId=0x1e8, CanIfTxPduUserTxConfirmationUL=PDUR, CanIfTxPduUserTxConfirmationName=PduR_LoIfTxConfirmation, uplayerPduRef=Cfg_D_Tx_BODY_LE1_CAN_MCM_D_1E8, CanIfTxPduBufferRef=Cfg_D/Buffer_HOH20_MCM_D_1E8_MCM_P_1EB
        Cfg_D_Tx_BODY_LE1_CAN_MCM_D_1EC: CanIfPduCanId=0x1ec, CanIfTxPduUserTxConfirmationUL=PDUR, CanIfTxPduUserTxConfirmationName=PduR_LoIfTxConfirmation, uplayerPduRef=Cfg_D_Tx_BODY_LE1_CAN_MCM_D_1EC, CanIfTxPduBufferRef=Cfg_D/Buffer_HOH21_MCM_D_1EC_MCM_P_1ED
        Cfg_D_Tx_BODY_LE1_CAN_DIAG_RESP_MCM_D: CanIfPduCanId=0x6a3, CanIfTxPduUserTxConfirmationUL=CAN_TP, CanIfTxPduUserTxConfirmationName=CanTp_TxConfirmation, uplayerPduRef=Cfg_D_Tx_BODY_LE1_CAN_DIAG_RESP_MCM_D, CanIfTxPduBufferRef=Cfg_D/Buffer_HOH15_DIAG_RESP_MCM_D_6A3_MCMP_6A4
      13 x CanIfRxPduCfg, all with CanIfRxPduCanIdType=STANDARD_NO_FD_CAN, CanIfPduDlc=8, CanIfRxPduReadData=false, CanIfRxPduDataLengthCheck=false, CanIfRxPduReadNotifyStatus=false, CanIfRxPduCanIdMask=0x1FFFFFFF, UserDefine=false, NetworkName=BODY_LE1_CAN:
        Cfg_D_Rx_BODY_LE1_CAN_BCU_11E: CanIfPduCanId=0x11e, CanIfRxPduUserRxIndicationUL=PDUR, CanIfRxPduUserRxIndicationName=PduR_LoIfRxIndication, uplayerPduRef=Cfg_D_Rx_BODY_LE1_CAN_BCU_11E, CanIfRxPduHrhIdRef=InitHohCfg/HOH0_BCU_11E
        Cfg_D_Rx_BODY_LE1_CAN_ZONE_13C: CanIfPduCanId=0x13c, CanIfRxPduUserRxIndicationUL=PDUR, CanIfRxPduUserRxIndicationName=PduR_LoIfRxIndication, uplayerPduRef=Cfg_D_Rx_BODY_LE1_CAN_ZONE_13C, CanIfRxPduHrhIdRef=InitHohCfg/HOH5_ZONE_13C
        Cfg_D_Rx_BODY_LE1_CAN_ZONE_MCM_05: CanIfPduCanId=0x1b4, CanIfRxPduUserRxIndicationUL=PDUR, CanIfRxPduUserRxIndicationName=PduR_LoIfRxIndication, uplayerPduRef=Cfg_D_Rx_BODY_LE1_CAN_ZONE_MCM_05, CanIfRxPduHrhIdRef=InitHohCfg/HOH12_MCMD_ZONE_MCM_05_1B4_MCMP_ZONE_MCM_06_1B5
        Cfg_D_Rx_BODY_LE1_CAN_ZONE_1C9: CanIfPduCanId=0x1c9, CanIfRxPduUserRxIndicationUL=PDUR, CanIfRxPduUserRxIndicationName=PduR_LoIfRxIndication, uplayerPduRef=Cfg_D_Rx_BODY_LE1_CAN_ZONE_1C9, CanIfRxPduHrhIdRef=InitHohCfg/HOH6_ZONE_MCMD_1C9_MCMP_1CF
        Cfg_D_Rx_BODY_LE1_CAN_Zone_FL_MCM_01: CanIfPduCanId=0x1d1, CanIfRxPduUserRxIndicationUL=PDUR, CanIfRxPduUserRxIndicationName=PduR_LoIfRxIndication, uplayerPduRef=Cfg_D_Rx_BODY_LE1_CAN_Zone_FL_MCM_01, CanIfRxPduHrhIdRef=InitHohCfg/HOH10_MCMD_Zone_FL_MCM_01_1D1_MCMP_Zone_FL_MCM_03_1D3
        Cfg_D_Rx_BODY_LE1_CAN_Zone_FL_MCM_02: CanIfPduCanId=0x1d2, CanIfRxPduUserRxIndicationUL=PDUR, CanIfRxPduUserRxIndicationName=PduR_LoIfRxIndication, uplayerPduRef=Cfg_D_Rx_BODY_LE1_CAN_Zone_FL_MCM_02, CanIfRxPduHrhIdRef=InitHohCfg/HOH11_MCMD_Zone_FL_MCM_02_1D2_MCMP_Zone_FL_MCM_04_1D4
        Cfg_D_Rx_BODY_LE1_CAN_ZONE_2EF: CanIfPduCanId=0x2ef, CanIfRxPduUserRxIndicationUL=PDUR, CanIfRxPduUserRxIndicationName=PduR_LoIfRxIndication, uplayerPduRef=Cfg_D_Rx_BODY_LE1_CAN_ZONE_2EF, CanIfRxPduHrhIdRef=InitHohCfg/HOH7_ZONE_2EF
        Cfg_D_Rx_BODY_LE1_CAN_ZONE_3A9: CanIfPduCanId=0x3a9, CanIfRxPduUserRxIndicationUL=PDUR, CanIfRxPduUserRxIndicationName=PduR_LoIfRxIndication, uplayerPduRef=Cfg_D_Rx_BODY_LE1_CAN_ZONE_3A9, CanIfRxPduHrhIdRef=InitHohCfg/HOH8_ZONE_3A9
        Cfg_D_Rx_BODY_LE1_CAN_ZONE_3B2: CanIfPduCanId=0x3b2, CanIfRxPduUserRxIndicationUL=PDUR, CanIfRxPduUserRxIndicationName=PduR_LoIfRxIndication, uplayerPduRef=Cfg_D_Rx_BODY_LE1_CAN_ZONE_3B2, CanIfRxPduHrhIdRef=InitHohCfg/HOH9_ZONE_3B2
        Cfg_D_Rx_BODY_LE1_CAN_ZONE_PNC: CanIfPduCanId=0x4f7, CanIfRxPduUserRxIndicationUL=PDUR, CanIfRxPduUserRxIndicationName=PduR_LoIfRxIndication, uplayerPduRef=Cfg_D_Rx_BODY_LE1_CAN_ZONE_PNC, CanIfRxPduHrhIdRef=InitHohCfg/HOH13_ZONE_PNC
        Cfg_D_Rx_BODY_LE1_CAN_VC_Data_5E0: CanIfPduCanId=0x5e0, CanIfRxPduUserRxIndicationUL=PDUR, CanIfRxPduUserRxIndicationName=PduR_LoIfRxIndication, uplayerPduRef=Cfg_D_Rx_BODY_LE1_CAN_VC_Data_5E0, CanIfRxPduHrhIdRef=InitHohCfg/HOH4_VC_Data_5E0
        Cfg_D_Rx_BODY_LE1_CAN_DIAG_REQ_AllECU: CanIfPduCanId=0x601, CanIfRxPduUserRxIndicationUL=CAN_TP, CanIfRxPduUserRxIndicationName=CanTp_RxIndication, uplayerPduRef=Cfg_D_Rx_BODY_LE1_CAN_DIAG_REQ_AllECU, CanIfRxPduHrhIdRef=InitHohCfg/HOH2_DIAG_REQ_AllECU
        Cfg_D_Rx_BODY_LE1_CAN_DIAG_REQ_MCM_D: CanIfPduCanId=0x623, CanIfRxPduUserRxIndicationUL=CAN_TP, CanIfRxPduUserRxIndicationName=CanTp_RxIndication, uplayerPduRef=Cfg_D_Rx_BODY_LE1_CAN_DIAG_REQ_MCM_D, CanIfRxPduHrhIdRef=InitHohCfg/HOH3_DIAG_REQ_MCMD_623_MCMP_624
      7 x CanIfBufferCfg, all with CanIfBufferSize=Auto:
        Buffer_HOH15_DIAG_RESP_MCM_D_6A3_MCMP_6A4: CanIfHohIdSymRef=InitHohCfg/HOH15_DIAG_RESP_MCM_D_6A3_MCMP_6A4
        Buffer_HOH16_MCM_D_1B6_MCM_P_1B7: CanIfHohIdSymRef=InitHohCfg/HOH16_MCM_D_1B6_MCM_P_1B7
        Buffer_HOH17_MCM_D_1DF_MCM_P_1E2: CanIfHohIdSymRef=InitHohCfg/HOH17_MCM_D_1DF_MCM_P_1E2
        Buffer_HOH18_MCM_D_1E0_MCM_P_1E3: CanIfHohIdSymRef=InitHohCfg/HOH18_MCM_D_1E0_MCM_P_1E3
        Buffer_HOH19_MCM_D_1E1_MCM_P_1E4: CanIfHohIdSymRef=InitHohCfg/HOH19_MCM_D_1E1_MCM_P_1E4
        Buffer_HOH20_MCM_D_1E8_MCM_P_1EB: CanIfHohIdSymRef=InitHohCfg/HOH20_MCM_D_1E8_MCM_P_1EB
        Buffer_HOH21_MCM_D_1EC_MCM_P_1ED: CanIfHohIdSymRef=InitHohCfg/HOH21_MCM_D_1EC_MCM_P_1ED
    Cfg_P (CanIfInitCfg): UserDefine=false
      InitHohCfg (CanIfInitHohCfg): CanIfInitRefCfgSet=CanConfigSet
        7 x CanIfHthCfg, all with CanIfHthCanCtrlIdRef=CanIf_BODY_LE1_CAN, CanIfHthFifoDepth=0, CanIfHthMaxdlc=8:
          HOH15_DIAG_RESP_MCM_D_6A3_MCMP_6A4: CanIfHthIdSymRef=HOH15_DIAG_RESP_MCM_D_6A3_MCMP_6A4
          HOH16_MCM_D_1B6_MCM_P_1B7: CanIfHthIdSymRef=HOH16_MCM_D_1B6_MCM_P_1B7
          HOH17_MCM_D_1DF_MCM_P_1E2: CanIfHthIdSymRef=HOH17_MCM_D_1DF_MCM_P_1E2
          HOH18_MCM_D_1E0_MCM_P_1E3: CanIfHthIdSymRef=HOH18_MCM_D_1E0_MCM_P_1E3
          HOH19_MCM_D_1E1_MCM_P_1E4: CanIfHthIdSymRef=HOH19_MCM_D_1E1_MCM_P_1E4
          HOH20_MCM_D_1E8_MCM_P_1EB: CanIfHthIdSymRef=HOH20_MCM_D_1E8_MCM_P_1EB
          HOH21_MCM_D_1EC_MCM_P_1ED: CanIfHthIdSymRef=HOH21_MCM_D_1EC_MCM_P_1ED
        13 x CanIfHrhCfg, all with CanIfHohCanCtrlIdRef=CanIf_BODY_LE1_CAN:
          HOH0_BCU_11E: CanIfHrhIdSymRef=HOH0_BCU_11E
          HOH2_DIAG_REQ_AllECU: CanIfHrhIdSymRef=HOH2_DIAG_REQ_AllECU
          HOH3_DIAG_REQ_MCMD_623_MCMP_624: CanIfHrhIdSymRef=HOH3_DIAG_REQ_MCMD_623_MCMP_624
          HOH4_VC_Data_5E0: CanIfHrhIdSymRef=HOH4_VC_Data_5E0
          HOH5_ZONE_13C: CanIfHrhIdSymRef=HOH5_ZONE_13C
          HOH6_ZONE_MCMD_1C9_MCMP_1CF: CanIfHrhIdSymRef=HOH6_ZONE_MCMD_1C9_MCMP_1CF
          HOH7_ZONE_2EF: CanIfHrhIdSymRef=HOH7_ZONE_2EF
          HOH8_ZONE_3A9: CanIfHrhIdSymRef=HOH8_ZONE_3A9
          HOH9_ZONE_3B2: CanIfHrhIdSymRef=HOH9_ZONE_3B2
          HOH10_MCMD_Zone_FL_MCM_01_1D1_MCMP_Zone_FL_MCM_03_1D3: CanIfHrhIdSymRef=HOH10_MCMD_Zone_FL_MCM_01_1D1_MCMP_Zone_FL_MCM_03_1D3
          HOH11_MCMD_Zone_FL_MCM_02_1D2_MCMP_Zone_FL_MCM_04_1D4: CanIfHrhIdSymRef=HOH11_MCMD_Zone_FL_MCM_02_1D2_MCMP_Zone_FL_MCM_04_1D4
          HOH12_MCMD_ZONE_MCM_05_1B4_MCMP_ZONE_MCM_06_1B5: CanIfHrhIdSymRef=HOH12_MCMD_ZONE_MCM_05_1B4_MCMP_ZONE_MCM_06_1B5
          HOH13_ZONE_PNC: CanIfHrhIdSymRef=HOH13_ZONE_PNC
      7 x CanIfTxPduCfg, all with CanIfTxPduCanIdType=STANDARD_NO_FD_CAN, CanIfPduDlc=8, CanIfTxPduPnFilterPdu=false, CanIfTxPduReadNotifyStatus=false, CanIfTxPduType=STATIC, CanIfTxPduTriggerTransmit=false, CanIfTxPduUserTriggerTransmitName=NULL_PTR, CanIfTxPduCanIdMask=0x1FFFFFFF, CanIfTxPduTruncation=true, UserDefine=false, NetworkName=BODY_LE1_CAN:
        Cfg_P_Tx_BODY_LE1_CAN_MCM_P_1B7: CanIfPduCanId=0x1b7, CanIfTxPduUserTxConfirmationUL=PDUR, CanIfTxPduUserTxConfirmationName=PduR_LoIfTxConfirmation, uplayerPduRef=Cfg_P_Tx_BODY_LE1_CAN_MCM_P_1B7, CanIfTxPduBufferRef=Cfg_P/Buffer_HOH16_MCM_D_1B6_MCM_P_1B7
        Cfg_P_Tx_BODY_LE1_CAN_MCM_P_1E2: CanIfPduCanId=0x1e2, CanIfTxPduUserTxConfirmationUL=PDUR, CanIfTxPduUserTxConfirmationName=PduR_LoIfTxConfirmation, uplayerPduRef=Cfg_P_Tx_BODY_LE1_CAN_MCM_P_1E2, CanIfTxPduBufferRef=Cfg_P/Buffer_HOH17_MCM_D_1DF_MCM_P_1E2
        Cfg_P_Tx_BODY_LE1_CAN_MCM_P_1E3: CanIfPduCanId=0x1e3, CanIfTxPduUserTxConfirmationUL=PDUR, CanIfTxPduUserTxConfirmationName=PduR_LoIfTxConfirmation, uplayerPduRef=Cfg_P_Tx_BODY_LE1_CAN_MCM_P_1E3, CanIfTxPduBufferRef=Cfg_P/Buffer_HOH18_MCM_D_1E0_MCM_P_1E3
        Cfg_P_Tx_BODY_LE1_CAN_MCM_P_1E4: CanIfPduCanId=0x1e4, CanIfTxPduUserTxConfirmationUL=PDUR, CanIfTxPduUserTxConfirmationName=PduR_LoIfTxConfirmation, uplayerPduRef=Cfg_P_Tx_BODY_LE1_CAN_MCM_P_1E4, CanIfTxPduBufferRef=Cfg_P/Buffer_HOH19_MCM_D_1E1_MCM_P_1E4
        Cfg_P_Tx_BODY_LE1_CAN_MCM_P_1EB: CanIfPduCanId=0x1eb, CanIfTxPduUserTxConfirmationUL=PDUR, CanIfTxPduUserTxConfirmationName=PduR_LoIfTxConfirmation, uplayerPduRef=Cfg_P_Tx_BODY_LE1_CAN_MCM_P_1EB, CanIfTxPduBufferRef=Cfg_P/Buffer_HOH20_MCM_D_1E8_MCM_P_1EB
        Cfg_P_Tx_BODY_LE1_CAN_MCM_P_1ED: CanIfPduCanId=0x1ed, CanIfTxPduUserTxConfirmationUL=PDUR, CanIfTxPduUserTxConfirmationName=PduR_LoIfTxConfirmation, uplayerPduRef=Cfg_P_Tx_BODY_LE1_CAN_MCM_P_1ED, CanIfTxPduBufferRef=Cfg_P/Buffer_HOH21_MCM_D_1EC_MCM_P_1ED
        Cfg_P_Tx_BODY_LE1_CAN_DIAG_RESP_MCM_P: CanIfPduCanId=0x6a4, CanIfTxPduUserTxConfirmationUL=CAN_TP, CanIfTxPduUserTxConfirmationName=CanTp_TxConfirmation, uplayerPduRef=Cfg_P_Tx_BODY_LE1_CAN_DIAG_RESP_MCM_P, CanIfTxPduBufferRef=Cfg_P/Buffer_HOH15_DIAG_RESP_MCM_D_6A3_MCMP_6A4
      13 x CanIfRxPduCfg, all with CanIfRxPduCanIdType=STANDARD_NO_FD_CAN, CanIfPduDlc=8, CanIfRxPduReadData=false, CanIfRxPduDataLengthCheck=false, CanIfRxPduReadNotifyStatus=false, CanIfRxPduCanIdMask=0x1FFFFFFF, UserDefine=false, NetworkName=BODY_LE1_CAN:
        Cfg_P_Rx_BODY_LE1_CAN_BCU_11E: CanIfPduCanId=0x11e, CanIfRxPduUserRxIndicationUL=PDUR, CanIfRxPduUserRxIndicationName=PduR_LoIfRxIndication, uplayerPduRef=Cfg_P_Rx_BODY_LE1_CAN_BCU_11E, CanIfRxPduHrhIdRef=InitHohCfg/HOH0_BCU_11E
        Cfg_P_Rx_BODY_LE1_CAN_ZONE_13C: CanIfPduCanId=0x13c, CanIfRxPduUserRxIndicationUL=PDUR, CanIfRxPduUserRxIndicationName=PduR_LoIfRxIndication, uplayerPduRef=Cfg_P_Rx_BODY_LE1_CAN_ZONE_13C, CanIfRxPduHrhIdRef=InitHohCfg/HOH5_ZONE_13C
        Cfg_P_Rx_BODY_LE1_CAN_ZONE_MCM_06: CanIfPduCanId=0x1b5, CanIfRxPduUserRxIndicationUL=PDUR, CanIfRxPduUserRxIndicationName=PduR_LoIfRxIndication, uplayerPduRef=Cfg_P_Rx_BODY_LE1_CAN_ZONE_MCM_06, CanIfRxPduHrhIdRef=InitHohCfg/HOH12_MCMD_ZONE_MCM_05_1B4_MCMP_ZONE_MCM_06_1B5
        Cfg_P_Rx_BODY_LE1_CAN_ZONE_1CF: CanIfPduCanId=0x1cf, CanIfRxPduUserRxIndicationUL=PDUR, CanIfRxPduUserRxIndicationName=PduR_LoIfRxIndication, uplayerPduRef=Cfg_P_Rx_BODY_LE1_CAN_ZONE_1CF, CanIfRxPduHrhIdRef=InitHohCfg/HOH6_ZONE_MCMD_1C9_MCMP_1CF
        Cfg_P_Rx_BODY_LE1_CAN_Zone_FL_MCM_03: CanIfPduCanId=0x1d3, CanIfRxPduUserRxIndicationUL=PDUR, CanIfRxPduUserRxIndicationName=PduR_LoIfRxIndication, uplayerPduRef=Cfg_P_Rx_BODY_LE1_CAN_Zone_FL_MCM_03, CanIfRxPduHrhIdRef=InitHohCfg/HOH10_MCMD_Zone_FL_MCM_01_1D1_MCMP_Zone_FL_MCM_03_1D3
        Cfg_P_Rx_BODY_LE1_CAN_Zone_FL_MCM_04: CanIfPduCanId=0x1d4, CanIfRxPduUserRxIndicationUL=PDUR, CanIfRxPduUserRxIndicationName=PduR_LoIfRxIndication, uplayerPduRef=Cfg_P_Rx_BODY_LE1_CAN_Zone_FL_MCM_04, CanIfRxPduHrhIdRef=InitHohCfg/HOH11_MCMD_Zone_FL_MCM_02_1D2_MCMP_Zone_FL_MCM_04_1D4
        Cfg_P_Rx_BODY_LE1_CAN_ZONE_2EF: CanIfPduCanId=0x2ef, CanIfRxPduUserRxIndicationUL=PDUR, CanIfRxPduUserRxIndicationName=PduR_LoIfRxIndication, uplayerPduRef=Cfg_P_Rx_BODY_LE1_CAN_ZONE_2EF, CanIfRxPduHrhIdRef=InitHohCfg/HOH7_ZONE_2EF
        Cfg_P_Rx_BODY_LE1_CAN_ZONE_3A9: CanIfPduCanId=0x3a9, CanIfRxPduUserRxIndicationUL=PDUR, CanIfRxPduUserRxIndicationName=PduR_LoIfRxIndication, uplayerPduRef=Cfg_P_Rx_BODY_LE1_CAN_ZONE_3A9, CanIfRxPduHrhIdRef=InitHohCfg/HOH8_ZONE_3A9
        Cfg_P_Rx_BODY_LE1_CAN_ZONE_3B2: CanIfPduCanId=0x3b2, CanIfRxPduUserRxIndicationUL=PDUR, CanIfRxPduUserRxIndicationName=PduR_LoIfRxIndication, uplayerPduRef=Cfg_P_Rx_BODY_LE1_CAN_ZONE_3B2, CanIfRxPduHrhIdRef=InitHohCfg/HOH9_ZONE_3B2
        Cfg_P_Rx_BODY_LE1_CAN_ZONE_PNC: CanIfPduCanId=0x4f7, CanIfRxPduUserRxIndicationUL=PDUR, CanIfRxPduUserRxIndicationName=PduR_LoIfRxIndication, uplayerPduRef=Cfg_P_Rx_BODY_LE1_CAN_ZONE_PNC, CanIfRxPduHrhIdRef=InitHohCfg/HOH13_ZONE_PNC
        Cfg_P_Rx_BODY_LE1_CAN_VC_Data_5E0: CanIfPduCanId=0x5e0, CanIfRxPduUserRxIndicationUL=PDUR, CanIfRxPduUserRxIndicationName=PduR_LoIfRxIndication, uplayerPduRef=Cfg_P_Rx_BODY_LE1_CAN_VC_Data_5E0, CanIfRxPduHrhIdRef=InitHohCfg/HOH4_VC_Data_5E0
        Cfg_P_Rx_BODY_LE1_CAN_DIAG_REQ_AllECU: CanIfPduCanId=0x601, CanIfRxPduUserRxIndicationUL=CAN_TP, CanIfRxPduUserRxIndicationName=CanTp_RxIndication, uplayerPduRef=Cfg_P_Rx_BODY_LE1_CAN_DIAG_REQ_AllECU, CanIfRxPduHrhIdRef=InitHohCfg/HOH2_DIAG_REQ_AllECU
        Cfg_P_Rx_BODY_LE1_CAN_DIAG_REQ_MCM_P: CanIfPduCanId=0x624, CanIfRxPduUserRxIndicationUL=CAN_TP, CanIfRxPduUserRxIndicationName=CanTp_RxIndication, uplayerPduRef=Cfg_P_Rx_BODY_LE1_CAN_DIAG_REQ_MCM_P, CanIfRxPduHrhIdRef=InitHohCfg/HOH3_DIAG_REQ_MCMD_623_MCMP_624
      7 x CanIfBufferCfg, all with CanIfBufferSize=Auto:
        Buffer_HOH15_DIAG_RESP_MCM_D_6A3_MCMP_6A4: CanIfHohIdSymRef=InitHohCfg/HOH15_DIAG_RESP_MCM_D_6A3_MCMP_6A4
        Buffer_HOH16_MCM_D_1B6_MCM_P_1B7: CanIfHohIdSymRef=InitHohCfg/HOH16_MCM_D_1B6_MCM_P_1B7
        Buffer_HOH17_MCM_D_1DF_MCM_P_1E2: CanIfHohIdSymRef=InitHohCfg/HOH17_MCM_D_1DF_MCM_P_1E2
        Buffer_HOH18_MCM_D_1E0_MCM_P_1E3: CanIfHohIdSymRef=InitHohCfg/HOH18_MCM_D_1E0_MCM_P_1E3
        Buffer_HOH19_MCM_D_1E1_MCM_P_1E4: CanIfHohIdSymRef=InitHohCfg/HOH19_MCM_D_1E1_MCM_P_1E4
        Buffer_HOH20_MCM_D_1E8_MCM_P_1EB: CanIfHohIdSymRef=InitHohCfg/HOH20_MCM_D_1E8_MCM_P_1EB
        Buffer_HOH21_MCM_D_1EC_MCM_P_1ED: CanIfHohIdSymRef=InitHohCfg/HOH21_MCM_D_1EC_MCM_P_1ED
    DefaultCanDrv (CanIfCtrlDrvCfg):
      CanIfCtrlDrvHeaderFile = Can
      CanIfCanWriteAPI = Can_Write
      CanIfCanSetControllerModeAPI = Can_SetControllerMode
      CanIfCanGetControllerErrorStateAPI = Can_GetControllerErrorState
      CanIfCanGetControllerTxErrorCounterAPI = Can_GetControllerTxErrorCounter
      CanIfCanGetControllerRxErrorCounterAPI = Can_GetControllerRxErrorCounter
      CanIfCanCheckWakeupAPI = 
      CanIfCanSetBaudrateAPI = 
      CanIf_BODY_LE1_CAN (CanIfCtrlCfg): CanIfCtrlWakeupSupport=false, FilePath=BODY_LE1_CAN, UserDefine=false, CanIfCtrlCanCtrlRef=CAN0
