AUTOSAR XML (schema 00046)
package /EAS
  ecuc definition collection AUTOSARParameterDefinition: module=ComM
  module config ComM: implementation-config-variant=STD_CONFIG_VARIANTS_POSTBUILD, module_version_def=4.0.4, module_autosar_version=Ar470
    ComMGeneral:
      VersionCheck = true
      ComMDevErrorDetect = true
      ComMVersionInfoApi = true
      ComMDirectUserMapping = false
      ComMSynchronousWakeUp = false
      ComMTMinFullComModeDuration = 5000
      ComMEcuGroupClassification = 0x3
      ComMModeLimitationEnabled = false
      ComMPncGatewayEnabled = false
      ComMPncPrepareSleepTimer = 0
      ComMPncSupport = false
      ComMWakeupInhibitionEnabled = false
      ComMResetAfterForcingNoComm = false
      ComMMultiCoreSupport = false
      ComM0PncVectorAvoidance = false
      ComMDynamicPncToChannelMappingSupport = false
      ComMSynchronizedPncShutdownEnabled = false
    Cfg_D (ComMConfigSet): ComMPncEnabled=false
      ComM_BODY_LE1_CAN (ComMChannel):
        FilePath = BODY_LE1_CAN
        UserDefine = false
        sourceType = ImportDBC
        ComMBusType = COMM_BUS_TYPE_CAN
        ComMChannelId = 0
        ComMFullCommRequestNotificationEnabled = false
        ComMNoWakeUpInhibitionNvmStorage = false
        ComMMainFunctionPeriod = 5
        ComMNoCom = false
        ComMNoWakeup = false
        ComMPncGatewayType = COMM_GATEWAY_TYPE_NONE
        ComMCDDBusPrefix = 
        ComMDynamicPncToChannelMappingEnabled = false
        ComMWakeupSleepRequestEnabled = false
        ComMNetworkManagement: ComMNmVariant=LIGHT, ComMNmLightTimeout=1000, ComMPncNmRequest=false
        ComMUserPerChannel1 (ComMUserPerChannel): ComMUserChannel=Cfg_D/User0
      User0 (ComMUser): ComMUserIdentifier=0
    Cfg_P (ComMConfigSet): ComMPncEnabled=false
      ComM_BODY_LE1_CAN (ComMChannel):
        FilePath = BODY_LE1_CAN
        UserDefine = false
        sourceType = ImportDBC
        ComMBusType = COMM_BUS_TYPE_CAN
        ComMChannelId = 0
        ComMFullCommRequestNotificationEnabled = false
        ComMNoWakeUpInhibitionNvmStorage = false
        ComMMainFunctionPeriod = 5
        ComMNoCom = false
        ComMNoWakeup = false
        ComMPncGatewayType = COMM_GATEWAY_TYPE_NONE
        ComMCDDBusPrefix = 
        ComMDynamicPncToChannelMappingEnabled = false
        ComMWakeupSleepRequestEnabled = false
        ComMNetworkManagement: ComMNmVariant=LIGHT, ComMNmLightTimeout=1000, ComMPncNmRequest=false
        ComMUserPerChannel1 (ComMUserPerChannel): ComMUserChannel=Cfg_P/User0
      User0 (ComMUser): ComMUserIdentifier=0
