AUTOSAR XML (schema 00046)
package /EAS
  ecuc definition collection AUTOSARParameterDefinition: module=PduR
  module config PduR: implementation-config-variant=STD_CONFIG_VARIANTS_POSTBUILD, module_version_def=4.0.3, module_autosar_version=Ar470
    PduRGeneral:
      VersionCheck = true
      PduRDevErrorDetect = false
      PduRVersionInfoApi = false
      PduRZeroCostOperation = false
      CanIfModuleSupport = true
      CanTpModuleSupport = true
      ComModuleSupport = true
      DcmModuleSupport = true
      LinIfModuleSupport = false
      LinTpModuleSupport = false
      DoIPIfModuleSupport = false
      DoIPTpModuleSupport = false
      SoAdIfModuleSupport = false
      SoAdTpModuleSupport = false
      CddModuleSupport = false
      J1939DcmModuleSupport = false
      J1939TpModuleSupport = false
      CanNmModuleSupport = false
      J1939RmModuleSupport = false
      FrIfModuleSupport = false
      FrTpModuleSupport = false
      SecOcModuleSupport = false
      UdpNmModuleSupport = false
      IpduMModuleSupport = false
      IpduMIfModuleSupport = false
      SecOcIfModuleSupport = false
      SecOcTpModuleSupport = false
      LdComModuleSupport = false
      SomeIpTpModuleSupport = false
      SomeIpModuleSupport = false
      DltModuleSupport = false
      IdsMModuleSupport = false
      DoIPGWModuleSupport = false
      MirrorModuleSupport = false
      MulticoreSupport = false
    Cfg_D (PduRRoutingTables): PduRConfigurationId=0, UserDefine=false
      PduRRoutingTable: PduRMaxRoutingPathCnt=255, PduRMaxRoutingPathGroupCnt=255, PduRMaxRoutingTableCnt=255
        20 x PduRRoutingPath, all with UserDefine=false:
          Cfg_D_Rx_BODY_LE1_CAN_BCU_11E_CANIF_COM
            Src_Cfg_D_Rx_BODY_LE1_CAN_BCU_11E (PduRSrcPdu):
              PduRSourcePduHandleId = 0
              PduRSrcModule = CANIF
              PduRSrcPduUpTxConf = true
              PduRSrcPduCoreId = 0
              UserDefine = false
              PduRSrcPduRef = Cfg_D_Rx_BODY_LE1_CAN_BCU_11E
            Dest_Cfg_D_Rx_BODY_LE1_CAN_BCU_11E (PduRDestPdu):
              PduRDestPduDataProvision = PDUR_DIRECT
              PduRDestPduHandleId = 0
              PduRTpThreshold = 7
              PduRTransmissionConfirmation = true
              PduRDestPduLength = 8
              PduRDestModule = COM
              PduRDestPduCoreId = 0
              UserDefine = false
              PduRDestPduRef = Cfg_D_Rx_BODY_LE1_CAN_BCU_11E
          Cfg_D_Rx_BODY_LE1_CAN_ZONE_13C_CANIF_COM
            Src_Cfg_D_Rx_BODY_LE1_CAN_ZONE_13C (PduRSrcPdu):
              PduRSourcePduHandleId = 1
              PduRSrcModule = CANIF
              PduRSrcPduUpTxConf = true
              PduRSrcPduCoreId = 0
              UserDefine = false
              PduRSrcPduRef = Cfg_D_Rx_BODY_LE1_CAN_ZONE_13C
            Dest_Cfg_D_Rx_BODY_LE1_CAN_ZONE_13C (PduRDestPdu):
              PduRDestPduDataProvision = PDUR_DIRECT
              PduRDestPduHandleId = 0
              PduRTpThreshold = 7
              PduRTransmissionConfirmation = true
              PduRDestPduLength = 8
              PduRDestModule = COM
              PduRDestPduCoreId = 0
              UserDefine = false
              PduRDestPduRef = Cfg_D_Rx_BODY_LE1_CAN_ZONE_13C
          Cfg_D_Rx_BODY_LE1_CAN_ZONE_MCM_05_CANIF_COM
            Src_Cfg_D_Rx_BODY_LE1_CAN_ZONE_MCM_05 (PduRSrcPdu):
              PduRSourcePduHandleId = 2
              PduRSrcModule = CANIF
              PduRSrcPduUpTxConf = true
              PduRSrcPduCoreId = 0
              UserDefine = false
              PduRSrcPduRef = Cfg_D_Rx_BODY_LE1_CAN_ZONE_MCM_05
            Dest_Cfg_D_Rx_BODY_LE1_CAN_ZONE_MCM_05 (PduRDestPdu):
              PduRDestPduDataProvision = PDUR_DIRECT
              PduRDestPduHandleId = 0
              PduRTpThreshold = 7
              PduRTransmissionConfirmation = true
              PduRDestPduLength = 8
              PduRDestModule = COM
              PduRDestPduCoreId = 0
              UserDefine = false
              PduRDestPduRef = Cfg_D_Rx_BODY_LE1_CAN_ZONE_MCM_05
          Cfg_D_Rx_BODY_LE1_CAN_ZONE_1C9_CANIF_COM
            Src_Cfg_D_Rx_BODY_LE1_CAN_ZONE_1C9 (PduRSrcPdu):
              PduRSourcePduHandleId = 3
              PduRSrcModule = CANIF
              PduRSrcPduUpTxConf = true
              PduRSrcPduCoreId = 0
              UserDefine = false
              PduRSrcPduRef = Cfg_D_Rx_BODY_LE1_CAN_ZONE_1C9
            Dest_Cfg_D_Rx_BODY_LE1_CAN_ZONE_1C9 (PduRDestPdu):
              PduRDestPduDataProvision = PDUR_DIRECT
              PduRDestPduHandleId = 0
              PduRTpThreshold = 7
              PduRTransmissionConfirmation = true
              PduRDestPduLength = 8
              PduRDestModule = COM
              PduRDestPduCoreId = 0
              UserDefine = false
              PduRDestPduRef = Cfg_D_Rx_BODY_LE1_CAN_ZONE_1C9
          Cfg_D_Rx_BODY_LE1_CAN_Zone_FL_MCM_01_CANIF_COM
            Src_Cfg_D_Rx_BODY_LE1_CAN_Zone_FL_MCM_01 (PduRSrcPdu):
              PduRSourcePduHandleId = 4
              PduRSrcModule = CANIF
              PduRSrcPduUpTxConf = true
              PduRSrcPduCoreId = 0
              UserDefine = false
              PduRSrcPduRef = Cfg_D_Rx_BODY_LE1_CAN_Zone_FL_MCM_01
            Dest_Cfg_D_Rx_BODY_LE1_CAN_Zone_FL_MCM_01 (PduRDestPdu):
              PduRDestPduDataProvision = PDUR_DIRECT
              PduRDestPduHandleId = 0
              PduRTpThreshold = 7
              PduRTransmissionConfirmation = true
              PduRDestPduLength = 8
              PduRDestModule = COM
              PduRDestPduCoreId = 0
              UserDefine = false
              PduRDestPduRef = Cfg_D_Rx_BODY_LE1_CAN_Zone_FL_MCM_01
          Cfg_D_Rx_BODY_LE1_CAN_Zone_FL_MCM_02_CANIF_COM
            Src_Cfg_D_Rx_BODY_LE1_CAN_Zone_FL_MCM_02 (PduRSrcPdu):
              PduRSourcePduHandleId = 5
              PduRSrcModule = CANIF
              PduRSrcPduUpTxConf = true
              PduRSrcPduCoreId = 0
              UserDefine = false
              PduRSrcPduRef = Cfg_D_Rx_BODY_LE1_CAN_Zone_FL_MCM_02
            Dest_Cfg_D_Rx_BODY_LE1_CAN_Zone_FL_MCM_02 (PduRDestPdu):
              PduRDestPduDataProvision = PDUR_DIRECT
              PduRDestPduHandleId = 0
              PduRTpThreshold = 7
              PduRTransmissionConfirmation = true
              PduRDestPduLength = 8
              PduRDestModule = COM
              PduRDestPduCoreId = 0
              UserDefine = false
              PduRDestPduRef = Cfg_D_Rx_BODY_LE1_CAN_Zone_FL_MCM_02
          Cfg_D_Rx_BODY_LE1_CAN_ZONE_2EF_CANIF_COM
            Src_Cfg_D_Rx_BODY_LE1_CAN_ZONE_2EF (PduRSrcPdu):
              PduRSourcePduHandleId = 6
              PduRSrcModule = CANIF
              PduRSrcPduUpTxConf = true
              PduRSrcPduCoreId = 0
              UserDefine = false
              PduRSrcPduRef = Cfg_D_Rx_BODY_LE1_CAN_ZONE_2EF
            Dest_Cfg_D_Rx_BODY_LE1_CAN_ZONE_2EF (PduRDestPdu):
              PduRDestPduDataProvision = PDUR_DIRECT
              PduRDestPduHandleId = 0
              PduRTpThreshold = 7
              PduRTransmissionConfirmation = true
              PduRDestPduLength = 8
              PduRDestModule = COM
              PduRDestPduCoreId = 0
              UserDefine = false
              PduRDestPduRef = Cfg_D_Rx_BODY_LE1_CAN_ZONE_2EF
          Cfg_D_Rx_BODY_LE1_CAN_ZONE_3A9_CANIF_COM
            Src_Cfg_D_Rx_BODY_LE1_CAN_ZONE_3A9 (PduRSrcPdu):
              PduRSourcePduHandleId = 7
              PduRSrcModule = CANIF
              PduRSrcPduUpTxConf = true
              PduRSrcPduCoreId = 0
              UserDefine = false
              PduRSrcPduRef = Cfg_D_Rx_BODY_LE1_CAN_ZONE_3A9
            Dest_Cfg_D_Rx_BODY_LE1_CAN_ZONE_3A9 (PduRDestPdu):
              PduRDestPduDataProvision = PDUR_DIRECT
              PduRDestPduHandleId = 0
              PduRTpThreshold = 7
              PduRTransmissionConfirmation = true
              PduRDestPduLength = 8
              PduRDestModule = COM
              PduRDestPduCoreId = 0
              UserDefine = false
              PduRDestPduRef = Cfg_D_Rx_BODY_LE1_CAN_ZONE_3A9
          Cfg_D_Rx_BODY_LE1_CAN_ZONE_3B2_CANIF_COM
            Src_Cfg_D_Rx_BODY_LE1_CAN_ZONE_3B2 (PduRSrcPdu):
              PduRSourcePduHandleId = 8
              PduRSrcModule = CANIF
              PduRSrcPduUpTxConf = true
              PduRSrcPduCoreId = 0
              UserDefine = false
              PduRSrcPduRef = Cfg_D_Rx_BODY_LE1_CAN_ZONE_3B2
            Dest_Cfg_D_Rx_BODY_LE1_CAN_ZONE_3B2 (PduRDestPdu):
              PduRDestPduDataProvision = PDUR_DIRECT
              PduRDestPduHandleId = 0
              PduRTpThreshold = 7
              PduRTransmissionConfirmation = true
              PduRDestPduLength = 8
              PduRDestModule = COM
              PduRDestPduCoreId = 0
              UserDefine = false
              PduRDestPduRef = Cfg_D_Rx_BODY_LE1_CAN_ZONE_3B2
          Cfg_D_Rx_BODY_LE1_CAN_ZONE_PNC_CANIF_COM
            Src_Cfg_D_Rx_BODY_LE1_CAN_ZONE_PNC (PduRSrcPdu):
              PduRSourcePduHandleId = 9
              PduRSrcModule = CANIF
              PduRSrcPduUpTxConf = true
              PduRSrcPduCoreId = 0
              UserDefine = false
              PduRSrcPduRef = Cfg_D_Rx_BODY_LE1_CAN_ZONE_PNC
            Dest_Cfg_D_Rx_BODY_LE1_CAN_ZONE_PNC (PduRDestPdu):
              PduRDestPduDataProvision = PDUR_DIRECT
              PduRDestPduHandleId = 0
              PduRTpThreshold = 7
              PduRTransmissionConfirmation = true
              PduRDestPduLength = 8
              PduRDestModule = COM
              PduRDestPduCoreId = 0
              UserDefine = false
              PduRDestPduRef = Cfg_D_Rx_BODY_LE1_CAN_ZONE_PNC
          Cfg_D_Rx_BODY_LE1_CAN_VC_Data_5E0_CANIF_COM
            Src_Cfg_D_Rx_BODY_LE1_CAN_VC_Data_5E0 (PduRSrcPdu):
              PduRSourcePduHandleId = 10
              PduRSrcModule = CANIF
              PduRSrcPduUpTxConf = true
              PduRSrcPduCoreId = 0
              UserDefine = false
              PduRSrcPduRef = Cfg_D_Rx_BODY_LE1_CAN_VC_Data_5E0
            Dest_Cfg_D_Rx_BODY_LE1_CAN_VC_Data_5E0 (PduRDestPdu):
              PduRDestPduDataProvision = PDUR_DIRECT
              PduRDestPduHandleId = 0
              PduRTpThreshold = 7
              PduRTransmissionConfirmation = true
              PduRDestPduLength = 8
              PduRDestModule = COM
              PduRDestPduCoreId = 0
              UserDefine = false
              PduRDestPduRef = Cfg_D_Rx_BODY_LE1_CAN_VC_Data_5E0
          Cfg_D_Tx_BODY_LE1_CAN_MCM_D_1B6_COM_CANIF
            Src_Cfg_D_Tx_BODY_LE1_CAN_MCM_D_1B6 (PduRSrcPdu):
              PduRSourcePduHandleId = 11
              PduRSrcModule = COM
              PduRSrcPduUpTxConf = true
              PduRSrcPduCoreId = 0
              UserDefine = false
              PduRSrcPduRef = Cfg_D_Tx_BODY_LE1_CAN_MCM_D_1B6
            Dest_Cfg_D_Tx_BODY_LE1_CAN_MCM_D_1B6 (PduRDestPdu):
              PduRDestPduDataProvision = PDUR_DIRECT
              PduRDestPduHandleId = 0
              PduRTpThreshold = 7
              PduRTransmissionConfirmation = true
              PduRDestPduLength = 8
              PduRDestModule = CANIF
              PduRDestPduCoreId = 0
              UserDefine = false
              PduRDestPduRef = Cfg_D_Tx_BODY_LE1_CAN_MCM_D_1B6
          Cfg_D_Tx_BODY_LE1_CAN_MCM_D_1DF_COM_CANIF
            Src_Cfg_D_Tx_BODY_LE1_CAN_MCM_D_1DF (PduRSrcPdu):
              PduRSourcePduHandleId = 12
              PduRSrcModule = COM
              PduRSrcPduUpTxConf = true
              PduRSrcPduCoreId = 0
              UserDefine = false
              PduRSrcPduRef = Cfg_D_Tx_BODY_LE1_CAN_MCM_D_1DF
            Dest_Cfg_D_Tx_BODY_LE1_CAN_MCM_D_1DF (PduRDestPdu):
              PduRDestPduDataProvision = PDUR_DIRECT
              PduRDestPduHandleId = 0
              PduRTpThreshold = 7
              PduRTransmissionConfirmation = true
              PduRDestPduLength = 8
              PduRDestModule = CANIF
              PduRDestPduCoreId = 0
              UserDefine = false
              PduRDestPduRef = Cfg_D_Tx_BODY_LE1_CAN_MCM_D_1DF
          Cfg_D_Tx_BODY_LE1_CAN_MCM_D_1E0_COM_CANIF
            Src_Cfg_D_Tx_BODY_LE1_CAN_MCM_D_1E0 (PduRSrcPdu):
              PduRSourcePduHandleId = 13
              PduRSrcModule = COM
              PduRSrcPduUpTxConf = true
              PduRSrcPduCoreId = 0
              UserDefine = false
              PduRSrcPduRef = Cfg_D_Tx_BODY_LE1_CAN_MCM_D_1E0
            Dest_Cfg_D_Tx_BODY_LE1_CAN_MCM_D_1E0 (PduRDestPdu):
              PduRDestPduDataProvision = PDUR_DIRECT
              PduRDestPduHandleId = 0
              PduRTpThreshold = 7
              PduRTransmissionConfirmation = true
              PduRDestPduLength = 8
              PduRDestModule = CANIF
              PduRDestPduCoreId = 0
              UserDefine = false
              PduRDestPduRef = Cfg_D_Tx_BODY_LE1_CAN_MCM_D_1E0
          Cfg_D_Tx_BODY_LE1_CAN_MCM_D_1E1_COM_CANIF
            Src_Cfg_D_Tx_BODY_LE1_CAN_MCM_D_1E1 (PduRSrcPdu):
              PduRSourcePduHandleId = 14
              PduRSrcModule = COM
              PduRSrcPduUpTxConf = true
              PduRSrcPduCoreId = 0
              UserDefine = false
              PduRSrcPduRef = Cfg_D_Tx_BODY_LE1_CAN_MCM_D_1E1
            Dest_Cfg_D_Tx_BODY_LE1_CAN_MCM_D_1E1 (PduRDestPdu):
              PduRDestPduDataProvision = PDUR_DIRECT
              PduRDestPduHandleId = 0
              PduRTpThreshold = 7
              PduRTransmissionConfirmation = true
              PduRDestPduLength = 8
              PduRDestModule = CANIF
              PduRDestPduCoreId = 0
              UserDefine = false
              PduRDestPduRef = Cfg_D_Tx_BODY_LE1_CAN_MCM_D_1E1
          Cfg_D_Tx_BODY_LE1_CAN_MCM_D_1E8_COM_CANIF
            Src_Cfg_D_Tx_BODY_LE1_CAN_MCM_D_1E8 (PduRSrcPdu):
              PduRSourcePduHandleId = 15
              PduRSrcModule = COM
              PduRSrcPduUpTxConf = true
              PduRSrcPduCoreId = 0
              UserDefine = false
              PduRSrcPduRef = Cfg_D_Tx_BODY_LE1_CAN_MCM_D_1E8
            Dest_Cfg_D_Tx_BODY_LE1_CAN_MCM_D_1E8 (PduRDestPdu):
              PduRDestPduDataProvision = PDUR_DIRECT
              PduRDestPduHandleId = 0
              PduRTpThreshold = 7
              PduRTransmissionConfirmation = true
              PduRDestPduLength = 8
              PduRDestModule = CANIF
              PduRDestPduCoreId = 0
              UserDefine = false
              PduRDestPduRef = Cfg_D_Tx_BODY_LE1_CAN_MCM_D_1E8
          Cfg_D_Tx_BODY_LE1_CAN_MCM_D_1EC_COM_CANIF
            Src_Cfg_D_Tx_BODY_LE1_CAN_MCM_D_1EC (PduRSrcPdu):
              PduRSourcePduHandleId = 16
              PduRSrcModule = COM
              PduRSrcPduUpTxConf = true
              PduRSrcPduCoreId = 0
              UserDefine = false
              PduRSrcPduRef = Cfg_D_Tx_BODY_LE1_CAN_MCM_D_1EC
            Dest_Cfg_D_Tx_BODY_LE1_CAN_MCM_D_1EC (PduRDestPdu):
              PduRDestPduDataProvision = PDUR_DIRECT
              PduRDestPduHandleId = 0
              PduRTpThreshold = 7
              PduRTransmissionConfirmation = true
              PduRDestPduLength = 8
              PduRDestModule = CANIF
              PduRDestPduCoreId = 0
              UserDefine = false
              PduRDestPduRef = Cfg_D_Tx_BODY_LE1_CAN_MCM_D_1EC
          Cfg_D_Rx_BODY_LE1_CAN_DIAG_REQ_AllECU_CANTP_DCM
            Src_Cfg_D_Rx_BODY_LE1_CAN_DIAG_REQ_AllECU (PduRSrcPdu):
              PduRSourcePduHandleId = 17
              PduRSrcModule = CANTP
              PduRSrcPduUpTxConf = true
              PduRSrcPduCoreId = 0
              UserDefine = false
              PduRSrcPduRef = Cfg_D_Rx_BODY_LE1_CAN_DIAG_REQ_AllECU
            Dest_Cfg_D_Rx_BODY_LE1_CAN_DIAG_REQ_AllECU (PduRDestPdu):
              PduRDestPduDataProvision = PDUR_DIRECT
              PduRDestPduHandleId = 0
              PduRTpThreshold = 7
              PduRTransmissionConfirmation = true
              PduRDestPduLength = 8
              PduRDestModule = DCM
              PduRDestPduCoreId = 0
              UserDefine = false
              PduRDestPduRef = Cfg_D_Rx_BODY_LE1_CAN_DIAG_REQ_AllECU
          Cfg_D_Rx_BODY_LE1_CAN_DIAG_REQ_MCM_D_CANTP_DCM
            Src_Cfg_D_Rx_BODY_LE1_CAN_DIAG_REQ_MCM_D (PduRSrcPdu):
              PduRSourcePduHandleId = 18
              PduRSrcModule = CANTP
              PduRSrcPduUpTxConf = true
              PduRSrcPduCoreId = 0
              UserDefine = false
              PduRSrcPduRef = Cfg_D_Rx_BODY_LE1_CAN_DIAG_REQ_MCM_D
            Dest_Cfg_D_Rx_BODY_LE1_CAN_DIAG_REQ_MCM_D (PduRDestPdu):
              PduRDestPduDataProvision = PDUR_DIRECT
              PduRDestPduHandleId = 0
              PduRTpThreshold = 7
              PduRTransmissionConfirmation = true
              PduRDestPduLength = 8
              PduRDestModule = DCM
              PduRDestPduCoreId = 0
              UserDefine = false
              PduRDestPduRef = Cfg_D_Rx_BODY_LE1_CAN_DIAG_REQ_MCM_D
          Cfg_D_Tx_BODY_LE1_CAN_DIAG_RESP_MCM_D_DCM_CANTP
            Src_Cfg_D_Tx_BODY_LE1_CAN_DIAG_RESP_MCM_D (PduRSrcPdu):
              PduRSourcePduHandleId = 19
              PduRSrcModule = DCM
              PduRSrcPduUpTxConf = true
              PduRSrcPduCoreId = 0
              UserDefine = false
              PduRSrcPduRef = Cfg_D_Tx_BODY_LE1_CAN_DIAG_RESP_MCM_D
            Dest_Cfg_D_Tx_BODY_LE1_CAN_DIAG_RESP_MCM_D (PduRDestPdu):
              PduRDestPduDataProvision = PDUR_DIRECT
              PduRDestPduHandleId = 0
              PduRTpThreshold = 7
              PduRTransmissionConfirmation = true
              PduRDestPduLength = 8
              PduRDestModule = CANTP
              PduRDestPduCoreId = 0
              UserDefine = false
              PduRDestPduRef = Cfg_D_Tx_BODY_LE1_CAN_DIAG_RESP_MCM_D
      PduRBufferTable: PduRMaxTxBufferNumber=0
      PduRBufferPoolTable_Core0 (PduRBufferPoolTable): BufferCoreID=0
    Cfg_P (PduRRoutingTables): PduRConfigurationId=0, UserDefine=false
      PduRRoutingTable: PduRMaxRoutingPathCnt=255, PduRMaxRoutingPathGroupCnt=255, PduRMaxRoutingTableCnt=255
        20 x PduRRoutingPath, all with UserDefine=false:
          Cfg_P_Rx_BODY_LE1_CAN_BCU_11E_CANIF_COM
            Src_Cfg_P_Rx_BODY_LE1_CAN_BCU_11E (PduRSrcPdu):
              PduRSourcePduHandleId = 0
              PduRSrcModule = CANIF
              PduRSrcPduUpTxConf = true
              PduRSrcPduCoreId = 0
              UserDefine = false
              PduRSrcPduRef = Cfg_P_Rx_BODY_LE1_CAN_BCU_11E
            Dest_Cfg_P_Rx_BODY_LE1_CAN_BCU_11E (PduRDestPdu):
              PduRDestPduDataProvision = PDUR_DIRECT
              PduRDestPduHandleId = 0
              PduRTpThreshold = 7
              PduRTransmissionConfirmation = true
              PduRDestPduLength = 8
              PduRDestModule = COM
              PduRDestPduCoreId = 0
              UserDefine = false
              PduRDestPduRef = Cfg_P_Rx_BODY_LE1_CAN_BCU_11E
          Cfg_P_Rx_BODY_LE1_CAN_ZONE_13C_CANIF_COM
            Src_Cfg_P_Rx_BODY_LE1_CAN_ZONE_13C (PduRSrcPdu):
              PduRSourcePduHandleId = 1
              PduRSrcModule = CANIF
              PduRSrcPduUpTxConf = true
              PduRSrcPduCoreId = 0
              UserDefine = false
              PduRSrcPduRef = Cfg_P_Rx_BODY_LE1_CAN_ZONE_13C
            Dest_Cfg_P_Rx_BODY_LE1_CAN_ZONE_13C (PduRDestPdu):
              PduRDestPduDataProvision = PDUR_DIRECT
              PduRDestPduHandleId = 0
              PduRTpThreshold = 7
              PduRTransmissionConfirmation = true
              PduRDestPduLength = 8
              PduRDestModule = COM
              PduRDestPduCoreId = 0
              UserDefine = false
              PduRDestPduRef = Cfg_P_Rx_BODY_LE1_CAN_ZONE_13C
          Cfg_P_Rx_BODY_LE1_CAN_ZONE_MCM_06_CANIF_COM
            Src_Cfg_P_Rx_BODY_LE1_CAN_ZONE_MCM_06 (PduRSrcPdu):
              PduRSourcePduHandleId = 2
              PduRSrcModule = CANIF
              PduRSrcPduUpTxConf = true
              PduRSrcPduCoreId = 0
              UserDefine = false
              PduRSrcPduRef = Cfg_P_Rx_BODY_LE1_CAN_ZONE_MCM_06
            Dest_Cfg_P_Rx_BODY_LE1_CAN_ZONE_MCM_06 (PduRDestPdu):
              PduRDestPduDataProvision = PDUR_DIRECT
              PduRDestPduHandleId = 0
              PduRTpThreshold = 7
              PduRTransmissionConfirmation = true
              PduRDestPduLength = 8
              PduRDestModule = COM
              PduRDestPduCoreId = 0
              UserDefine = false
              PduRDestPduRef = Cfg_P_Rx_BODY_LE1_CAN_ZONE_MCM_06
          Cfg_P_Rx_BODY_LE1_CAN_ZONE_1CF_CANIF_COM
            Src_Cfg_P_Rx_BODY_LE1_CAN_ZONE_1CF (PduRSrcPdu):
              PduRSourcePduHandleId = 3
              PduRSrcModule = CANIF
              PduRSrcPduUpTxConf = true
              PduRSrcPduCoreId = 0
              UserDefine = false
              PduRSrcPduRef = Cfg_P_Rx_BODY_LE1_CAN_ZONE_1CF
            Dest_Cfg_P_Rx_BODY_LE1_CAN_ZONE_1CF (PduRDestPdu):
              PduRDestPduDataProvision = PDUR_DIRECT
              PduRDestPduHandleId = 0
              PduRTpThreshold = 7
              PduRTransmissionConfirmation = true
              PduRDestPduLength = 8
              PduRDestModule = COM
              PduRDestPduCoreId = 0
              UserDefine = false
              PduRDestPduRef = Cfg_P_Rx_BODY_LE1_CAN_ZONE_1CF
          Cfg_P_Rx_BODY_LE1_CAN_Zone_FL_MCM_03_CANIF_COM
            Src_Cfg_P_Rx_BODY_LE1_CAN_Zone_FL_MCM_03 (PduRSrcPdu):
              PduRSourcePduHandleId = 4
              PduRSrcModule = CANIF
              PduRSrcPduUpTxConf = true
              PduRSrcPduCoreId = 0
              UserDefine = false
              PduRSrcPduRef = Cfg_P_Rx_BODY_LE1_CAN_Zone_FL_MCM_03
            Dest_Cfg_P_Rx_BODY_LE1_CAN_Zone_FL_MCM_03 (PduRDestPdu):
              PduRDestPduDataProvision = PDUR_DIRECT
              PduRDestPduHandleId = 0
              PduRTpThreshold = 7
              PduRTransmissionConfirmation = true
              PduRDestPduLength = 8
              PduRDestModule = COM
              PduRDestPduCoreId = 0
              UserDefine = false
              PduRDestPduRef = Cfg_P_Rx_BODY_LE1_CAN_Zone_FL_MCM_03
          Cfg_P_Rx_BODY_LE1_CAN_Zone_FL_MCM_04_CANIF_COM
            Src_Cfg_P_Rx_BODY_LE1_CAN_Zone_FL_MCM_04 (PduRSrcPdu):
              PduRSourcePduHandleId = 5
              PduRSrcModule = CANIF
              PduRSrcPduUpTxConf = true
              PduRSrcPduCoreId = 0
              UserDefine = false
              PduRSrcPduRef = Cfg_P_Rx_BODY_LE1_CAN_Zone_FL_MCM_04
            Dest_Cfg_P_Rx_BODY_LE1_CAN_Zone_FL_MCM_04 (PduRDestPdu):
              PduRDestPduDataProvision = PDUR_DIRECT
              PduRDestPduHandleId = 0
              PduRTpThreshold = 7
              PduRTransmissionConfirmation = true
              PduRDestPduLength = 8
              PduRDestModule = COM
              PduRDestPduCoreId = 0
              UserDefine = false
              PduRDestPduRef = Cfg_P_Rx_BODY_LE1_CAN_Zone_FL_MCM_04
          Cfg_P_Rx_BODY_LE1_CAN_ZONE_2EF_CANIF_COM
            Src_Cfg_P_Rx_BODY_LE1_CAN_ZONE_2EF (PduRSrcPdu):
              PduRSourcePduHandleId = 6
              PduRSrcModule = CANIF
              PduRSrcPduUpTxConf = true
              PduRSrcPduCoreId = 0
              UserDefine = false
              PduRSrcPduRef = Cfg_P_Rx_BODY_LE1_CAN_ZONE_2EF
            Dest_Cfg_P_Rx_BODY_LE1_CAN_ZONE_2EF (PduRDestPdu):
              PduRDestPduDataProvision = PDUR_DIRECT
              PduRDestPduHandleId = 0
              PduRTpThreshold = 7
              PduRTransmissionConfirmation = true
              PduRDestPduLength = 8
              PduRDestModule = COM
              PduRDestPduCoreId = 0
              UserDefine = false
              PduRDestPduRef = Cfg_P_Rx_BODY_LE1_CAN_ZONE_2EF
          Cfg_P_Rx_BODY_LE1_CAN_ZONE_3A9_CANIF_COM
            Src_Cfg_P_Rx_BODY_LE1_CAN_ZONE_3A9 (PduRSrcPdu):
              PduRSourcePduHandleId = 7
              PduRSrcModule = CANIF
              PduRSrcPduUpTxConf = true
              PduRSrcPduCoreId = 0
              UserDefine = false
              PduRSrcPduRef = Cfg_P_Rx_BODY_LE1_CAN_ZONE_3A9
            Dest_Cfg_P_Rx_BODY_LE1_CAN_ZONE_3A9 (PduRDestPdu):
              PduRDestPduDataProvision = PDUR_DIRECT
              PduRDestPduHandleId = 0
              PduRTpThreshold = 7
              PduRTransmissionConfirmation = true
              PduRDestPduLength = 8
              PduRDestModule = COM
              PduRDestPduCoreId = 0
              UserDefine = false
              PduRDestPduRef = Cfg_P_Rx_BODY_LE1_CAN_ZONE_3A9
          Cfg_P_Rx_BODY_LE1_CAN_ZONE_3B2_CANIF_COM
            Src_Cfg_P_Rx_BODY_LE1_CAN_ZONE_3B2 (PduRSrcPdu):
              PduRSourcePduHandleId = 8
              PduRSrcModule = CANIF
              PduRSrcPduUpTxConf = true
              PduRSrcPduCoreId = 0
              UserDefine = false
              PduRSrcPduRef = Cfg_P_Rx_BODY_LE1_CAN_ZONE_3B2
            Dest_Cfg_P_Rx_BODY_LE1_CAN_ZONE_3B2 (PduRDestPdu):
              PduRDestPduDataProvision = PDUR_DIRECT
              PduRDestPduHandleId = 0
              PduRTpThreshold = 7
              PduRTransmissionConfirmation = true
              PduRDestPduLength = 8
              PduRDestModule = COM
              PduRDestPduCoreId = 0
              UserDefine = false
              PduRDestPduRef = Cfg_P_Rx_BODY_LE1_CAN_ZONE_3B2
          Cfg_P_Rx_BODY_LE1_CAN_ZONE_PNC_CANIF_COM
            Src_Cfg_P_Rx_BODY_LE1_CAN_ZONE_PNC (PduRSrcPdu):
              PduRSourcePduHandleId = 9
              PduRSrcModule = CANIF
              PduRSrcPduUpTxConf = true
              PduRSrcPduCoreId = 0
              UserDefine = false
              PduRSrcPduRef = Cfg_P_Rx_BODY_LE1_CAN_ZONE_PNC
            Dest_Cfg_P_Rx_BODY_LE1_CAN_ZONE_PNC (PduRDestPdu):
              PduRDestPduDataProvision = PDUR_DIRECT
              PduRDestPduHandleId = 0
              PduRTpThreshold = 7
              PduRTransmissionConfirmation = true
              PduRDestPduLength = 8
              PduRDestModule = COM
              PduRDestPduCoreId = 0
              UserDefine = false
              PduRDestPduRef = Cfg_P_Rx_BODY_LE1_CAN_ZONE_PNC
          Cfg_P_Rx_BODY_LE1_CAN_VC_Data_5E0_CANIF_COM
            Src_Cfg_P_Rx_BODY_LE1_CAN_VC_Data_5E0 (PduRSrcPdu):
              PduRSourcePduHandleId = 10
              PduRSrcModule = CANIF
              PduRSrcPduUpTxConf = true
              PduRSrcPduCoreId = 0
              UserDefine = false
              PduRSrcPduRef = Cfg_P_Rx_BODY_LE1_CAN_VC_Data_5E0
            Dest_Cfg_P_Rx_BODY_LE1_CAN_VC_Data_5E0 (PduRDestPdu):
              PduRDestPduDataProvision = PDUR_DIRECT
              PduRDestPduHandleId = 0
              PduRTpThreshold = 7
              PduRTransmissionConfirmation = true
              PduRDestPduLength = 8
              PduRDestModule = COM
              PduRDestPduCoreId = 0
              UserDefine = false
              PduRDestPduRef = Cfg_P_Rx_BODY_LE1_CAN_VC_Data_5E0
          Cfg_P_Tx_BODY_LE1_CAN_MCM_P_1B7_COM_CANIF
            Src_Cfg_P_Tx_BODY_LE1_CAN_MCM_P_1B7 (PduRSrcPdu):
              PduRSourcePduHandleId = 11
              PduRSrcModule = COM
              PduRSrcPduUpTxConf = true
              PduRSrcPduCoreId = 0
              UserDefine = false
              PduRSrcPduRef = Cfg_P_Tx_BODY_LE1_CAN_MCM_P_1B7
            Dest_Cfg_P_Tx_BODY_LE1_CAN_MCM_P_1B7 (PduRDestPdu):
              PduRDestPduDataProvision = PDUR_DIRECT
              PduRDestPduHandleId = 0
              PduRTpThreshold = 7
              PduRTransmissionConfirmation = true
              PduRDestPduLength = 8
              PduRDestModule = CANIF
              PduRDestPduCoreId = 0
              UserDefine = false
              PduRDestPduRef = Cfg_P_Tx_BODY_LE1_CAN_MCM_P_1B7
          Cfg_P_Tx_BODY_LE1_CAN_MCM_P_1E2_COM_CANIF
            Src_Cfg_P_Tx_BODY_LE1_CAN_MCM_P_1E2 (PduRSrcPdu):
              PduRSourcePduHandleId = 12
              PduRSrcModule = COM
              PduRSrcPduUpTxConf = true
              PduRSrcPduCoreId = 0
              UserDefine = false
              PduRSrcPduRef = Cfg_P_Tx_BODY_LE1_CAN_MCM_P_1E2
            Dest_Cfg_P_Tx_BODY_LE1_CAN_MCM_P_1E2 (PduRDestPdu):
              PduRDestPduDataProvision = PDUR_DIRECT
              PduRDestPduHandleId = 0
              PduRTpThreshold = 7
              PduRTransmissionConfirmation = true
              PduRDestPduLength = 8
              PduRDestModule = CANIF
              PduRDestPduCoreId = 0
              UserDefine = false
              PduRDestPduRef = Cfg_P_Tx_BODY_LE1_CAN_MCM_P_1E2
          Cfg_P_Tx_BODY_LE1_CAN_MCM_P_1E3_COM_CANIF
            Src_Cfg_P_Tx_BODY_LE1_CAN_MCM_P_1E3 (PduRSrcPdu):
              PduRSourcePduHandleId = 13
              PduRSrcModule = COM
              PduRSrcPduUpTxConf = true
              PduRSrcPduCoreId = 0
              UserDefine = false
              PduRSrcPduRef = Cfg_P_Tx_BODY_LE1_CAN_MCM_P_1E3
            Dest_Cfg_P_Tx_BODY_LE1_CAN_MCM_P_1E3 (PduRDestPdu):
              PduRDestPduDataProvision = PDUR_DIRECT
              PduRDestPduHandleId = 0
              PduRTpThreshold = 7
              PduRTransmissionConfirmation = true
              PduRDestPduLength = 8
              PduRDestModule = CANIF
              PduRDestPduCoreId = 0
              UserDefine = false
              PduRDestPduRef = Cfg_P_Tx_BODY_LE1_CAN_MCM_P_1E3
          Cfg_P_Tx_BODY_LE1_CAN_MCM_P_1E4_COM_CANIF
            Src_Cfg_P_Tx_BODY_LE1_CAN_MCM_P_1E4 (PduRSrcPdu):
              PduRSourcePduHandleId = 14
              PduRSrcModule = COM
              PduRSrcPduUpTxConf = true
              PduRSrcPduCoreId = 0
              UserDefine = false
              PduRSrcPduRef = Cfg_P_Tx_BODY_LE1_CAN_MCM_P_1E4
            Dest_Cfg_P_Tx_BODY_LE1_CAN_MCM_P_1E4 (PduRDestPdu):
              PduRDestPduDataProvision = PDUR_DIRECT
              PduRDestPduHandleId = 0
              PduRTpThreshold = 7
              PduRTransmissionConfirmation = true
              PduRDestPduLength = 8
              PduRDestModule = CANIF
              PduRDestPduCoreId = 0
              UserDefine = false
              PduRDestPduRef = Cfg_P_Tx_BODY_LE1_CAN_MCM_P_1E4
          Cfg_P_Tx_BODY_LE1_CAN_MCM_P_1EB_COM_CANIF
            Src_Cfg_P_Tx_BODY_LE1_CAN_MCM_P_1EB (PduRSrcPdu):
              PduRSourcePduHandleId = 15
              PduRSrcModule = COM
              PduRSrcPduUpTxConf = true
              PduRSrcPduCoreId = 0
              UserDefine = false
              PduRSrcPduRef = Cfg_P_Tx_BODY_LE1_CAN_MCM_P_1EB
            Dest_Cfg_P_Tx_BODY_LE1_CAN_MCM_P_1EB (PduRDestPdu):
              PduRDestPduDataProvision = PDUR_DIRECT
              PduRDestPduHandleId = 0
              PduRTpThreshold = 7
              PduRTransmissionConfirmation = true
              PduRDestPduLength = 8
              PduRDestModule = CANIF
              PduRDestPduCoreId = 0
              UserDefine = false
              PduRDestPduRef = Cfg_P_Tx_BODY_LE1_CAN_MCM_P_1EB
          Cfg_P_Tx_BODY_LE1_CAN_MCM_P_1ED_COM_CANIF
            Src_Cfg_P_Tx_BODY_LE1_CAN_MCM_P_1ED (PduRSrcPdu):
              PduRSourcePduHandleId = 16
              PduRSrcModule = COM
              PduRSrcPduUpTxConf = true
              PduRSrcPduCoreId = 0
              UserDefine = false
              PduRSrcPduRef = Cfg_P_Tx_BODY_LE1_CAN_MCM_P_1ED
            Dest_Cfg_P_Tx_BODY_LE1_CAN_MCM_P_1ED (PduRDestPdu):
              PduRDestPduDataProvision = PDUR_DIRECT
              PduRDestPduHandleId = 0
              PduRTpThreshold = 7
              PduRTransmissionConfirmation = true
              PduRDestPduLength = 8
              PduRDestModule = CANIF
              PduRDestPduCoreId = 0
              UserDefine = false
              PduRDestPduRef = Cfg_P_Tx_BODY_LE1_CAN_MCM_P_1ED
          Cfg_P_Rx_BODY_LE1_CAN_DIAG_REQ_AllECU_CANTP_DCM
            Src_Cfg_P_Rx_BODY_LE1_CAN_DIAG_REQ_AllECU (PduRSrcPdu):
              PduRSourcePduHandleId = 17
              PduRSrcModule = CANTP
              PduRSrcPduUpTxConf = true
              PduRSrcPduCoreId = 0
              UserDefine = false
              PduRSrcPduRef = Cfg_P_Rx_BODY_LE1_CAN_DIAG_REQ_AllECU
            Dest_Cfg_P_Rx_BODY_LE1_CAN_DIAG_REQ_AllECU (PduRDestPdu):
              PduRDestPduDataProvision = PDUR_DIRECT
              PduRDestPduHandleId = 0
              PduRTpThreshold = 7
              PduRTransmissionConfirmation = true
              PduRDestPduLength = 8
              PduRDestModule = DCM
              PduRDestPduCoreId = 0
              UserDefine = false
              PduRDestPduRef = Cfg_P_Rx_BODY_LE1_CAN_DIAG_REQ_AllECU
          Cfg_P_Rx_BODY_LE1_CAN_DIAG_REQ_MCM_P_CANTP_DCM
            Src_Cfg_P_Rx_BODY_LE1_CAN_DIAG_REQ_MCM_P (PduRSrcPdu):
              PduRSourcePduHandleId = 18
              PduRSrcModule = CANTP
              PduRSrcPduUpTxConf = true
              PduRSrcPduCoreId = 0
              UserDefine = false
              PduRSrcPduRef = Cfg_P_Rx_BODY_LE1_CAN_DIAG_REQ_MCM_P
            Dest_Cfg_P_Rx_BODY_LE1_CAN_DIAG_REQ_MCM_P (PduRDestPdu):
              PduRDestPduDataProvision = PDUR_DIRECT
              PduRDestPduHandleId = 0
              PduRTpThreshold = 7
              PduRTransmissionConfirmation = true
              PduRDestPduLength = 8
              PduRDestModule = DCM
              PduRDestPduCoreId = 0
              UserDefine = false
              PduRDestPduRef = Cfg_P_Rx_BODY_LE1_CAN_DIAG_REQ_MCM_P
          Cfg_P_Tx_BODY_LE1_CAN_DIAG_RESP_MCM_P_DCM_CANTP
            Src_Cfg_P_Tx_BODY_LE1_CAN_DIAG_RESP_MCM_P (PduRSrcPdu):
              PduRSourcePduHandleId = 19
              PduRSrcModule = DCM
              PduRSrcPduUpTxConf = true
              PduRSrcPduCoreId = 0
              UserDefine = false
              PduRSrcPduRef = Cfg_P_Tx_BODY_LE1_CAN_DIAG_RESP_MCM_P
            Dest_Cfg_P_Tx_BODY_LE1_CAN_DIAG_RESP_MCM_P (PduRDestPdu):
              PduRDestPduDataProvision = PDUR_DIRECT
              PduRDestPduHandleId = 0
              PduRTpThreshold = 7
              PduRTransmissionConfirmation = true
              PduRDestPduLength = 8
              PduRDestModule = CANTP
              PduRDestPduCoreId = 0
              UserDefine = false
              PduRDestPduRef = Cfg_P_Tx_BODY_LE1_CAN_DIAG_RESP_MCM_P
      PduRBufferTable: PduRMaxTxBufferNumber=0
      PduRBufferPoolTable_Core0 (PduRBufferPoolTable): BufferCoreID=0
    4 x PduRBswModules, all with PduRCancelReceive=false, PduRCancelTransmit=false:
      Com: PduRCommunicationInterface=true, PduRLowerModule=false, PduRRetransmission=false, PduRTransportProtocol=true, PduRTriggertransmit=true, PduRTxConfirmation=true, PduRUpperModule=true, PduRUseTag=true, PduRBswModuleRef=Com
      Dcm: PduRCommunicationInterface=true, PduRLowerModule=false, PduRRetransmission=false, PduRTransportProtocol=true, PduRTriggertransmit=false, PduRTxConfirmation=true, PduRUpperModule=true, PduRUseTag=true, PduRBswModuleRef=Dcm
      CanIf: PduRCommunicationInterface=true, PduRLowerModule=true, PduRRetransmission=false, PduRTransportProtocol=false, PduRTriggertransmit=false, PduRTxConfirmation=false, PduRUpperModule=false, PduRUseTag=false, PduRBswModuleRef=CanIf
      CanTp: PduRCommunicationInterface=false, PduRLowerModule=true, PduRRetransmission=true, PduRTransportProtocol=true, PduRTriggertransmit=false, PduRTxConfirmation=false, PduRUpperModule=false, PduRUseTag=false, PduRBswModuleRef=CanTp
