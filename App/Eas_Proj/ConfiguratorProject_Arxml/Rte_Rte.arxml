AUTOSAR XML (schema 00046)
package /EAS
  ecuc definition collection AUTOSARParameterDefinition: module=Rte
  module config Rte: implementation-config-variant=STD_CONFIG_VARIANTS_PRECOMPILE, module_version_def=4.0.4, module_autosar_version=Ar470
    RteBswGeneral: RteSchMVersionInfoApi=false, RteDevErrorDetect=false, RteUserIncludeFile=, UserDefine=false, isNew=false
    RteGeneration:
      RteCalibrationSupport = NONE
      DataConstrSupport = NONE
      SwcInfoSupport = false
      SupportDefaultCalibrationAddrMethod = false
      SupportDistinguishingSameNameSignal = false
      GenerateCompuMethodEnumInfo = false
      DataConsistencyProtection = ALL_INTERRUPT_BLOCKING
      SWCFileOrganizationMethod = All_IN_RTE.C
      SignalConversionEnabled = false
      CreateADTPerSignal = true
      ComMultiCoreSupport = false
      CrossCoreEventAsyn = true
      GenerateHookFunction = false
      SRBufferPolicy = SenderReceiverInterfaceName
      UserDefine = false
      isNew = false
    15 x RteBswModuleInstance, all with UserDefine=false, isNew=false:
      BswM
        BswM_MainFunction (RteBswEventToTaskMapping):
          RteBswPositionInTask = 0
          RteBswActivationOffset = 1
          UserDefine = false
          isNew = true
          RteBswEventPeriod = 5
          RteBswEventRef = BswM_MainFunction
          RteBswUsedOsSchTblExpiryPointRef = /
        3 x RteBswExclusiveAreaImpl, all with RteExclusiveAreaImplMechanism=NONE, UserDefine=false, isNew=false:
          BSWM_EXCLUSIVE_AREA_{0..2}
      CanIf
        10 x RteBswExclusiveAreaImpl, all with RteExclusiveAreaImplMechanism=NONE, UserDefine=false, isNew=false:
          CANIF_EXCLUSIVE_AREA_{0..9}
      CanSM
        CanSM_MainFunction (RteBswEventToTaskMapping):
          RteBswPositionInTask = 0
          RteBswActivationOffset = 1
          UserDefine = false
          isNew = true
          RteBswEventPeriod = 5
          RteBswEventRef = CanSM_MainFunction
          RteBswUsedOsSchTblExpiryPointRef = /
        5 x RteBswExclusiveAreaImpl, all with RteExclusiveAreaImplMechanism=NONE, UserDefine=false, isNew=false:
          CANSM_EXCLUSIVE_AREA_{0..4}
      CanTp
        CanTp_MainFunction (RteBswEventToTaskMapping):
          RteBswPositionInTask = 0
          RteBswActivationOffset = 1
          UserDefine = false
          isNew = true
          RteBswEventPeriod = 10
          RteBswEventRef = CanTp_MainFunction
          RteBswUsedOsSchTblExpiryPointRef = /
        CANTP_EXCLUSIVE_AREA_0 (RteBswExclusiveAreaImpl): RteExclusiveAreaImplMechanism=NONE, UserDefine=false, isNew=false
        CANTP_EXCLUSIVE_AREA_1 (RteBswExclusiveAreaImpl): RteExclusiveAreaImplMechanism=NONE, UserDefine=false, isNew=false
      Com
        6 x RteBswEventToTaskMapping, all with RteBswPositionInTask=0, RteBswActivationOffset=1, UserDefine=false, isNew=false, RteBswEventPeriod=10, RteBswUsedOsSchTblExpiryPointRef=/:
          Com_ComMainFunctionRx10ms_R: RteBswEventRef=Com_ComMainFunctionRx10ms_R
          Com_ComMainFunctionTx10ms_T: RteBswEventRef=Com_ComMainFunctionTx10ms_T
          Com_ComMainFunctionRx10msD_R: RteBswEventRef=Com_ComMainFunctionRx10msD_R
          Com_ComMainFunctionTx10msD_T: RteBswEventRef=Com_ComMainFunctionTx10msD_T
          Com_ComMainFunction0_R: RteBswEventRef=Com_ComMainFunction0_R
          Com_ComMainFunction1_T: RteBswEventRef=Com_ComMainFunction1_T
        14 x RteBswExclusiveAreaImpl, all with RteExclusiveAreaImplMechanism=NONE, UserDefine=false, isNew=false:
          COM_EXCLUSIVE_AREA_{0..13}
      ComM
        ComM_ComM_BODY_LE1_CAN (RteBswEventToTaskMapping):
          RteBswPositionInTask = 0
          RteBswActivationOffset = 1
          UserDefine = false
          isNew = true
          RteBswEventPeriod = 5
          RteBswEventRef = ComM_ComM_BODY_LE1_CAN
          RteBswUsedOsSchTblExpiryPointRef = /
        ComM_ComM_SZQ_EAS_CAN0 (RteBswEventToTaskMapping):
          RteBswPositionInTask = 0
          RteBswActivationOffset = 1
          UserDefine = false
          isNew = false
          RteBswEventPeriod = 10
          RteBswEventRef = ComM_ComM_SZQ_EAS_CAN0
          RteBswUsedOsSchTblExpiryPointRef = /
        10 x RteBswExclusiveAreaImpl, all with RteExclusiveAreaImplMechanism=NONE, UserDefine=false, isNew=false:
          COMM_EXCLUSIVE_AREA_{0..9}
      Dcm
        Dcm_MainFunction (RteBswEventToTaskMapping):
          RteBswPositionInTask = 0
          RteBswActivationOffset = 1
          UserDefine = false
          isNew = true
          RteBswEventPeriod = 10
          RteBswEventRef = Dcm_MainFunction
          RteBswUsedOsSchTblExpiryPointRef = /
        3 x RteBswExclusiveAreaImpl, all with RteExclusiveAreaImplMechanism=NONE, UserDefine=false, isNew=false:
          DCM_EXCLUSIVE_AREA_{0..2}
      Dem
        Dem_MainFunction (RteBswEventToTaskMapping):
          RteBswPositionInTask = 0
          RteBswActivationOffset = 1
          UserDefine = false
          isNew = true
          RteBswEventPeriod = 10
          RteBswEventRef = Dem_MainFunction
          RteBswUsedOsSchTblExpiryPointRef = /
        DEM_EXCLUSIVE_AREA_0 (RteBswExclusiveAreaImpl): RteExclusiveAreaImplMechanism=NONE, UserDefine=false, isNew=false
        DEM_EXCLUSIVE_AREA_1 (RteBswExclusiveAreaImpl): RteExclusiveAreaImplMechanism=NONE, UserDefine=false, isNew=false
      Det
      EcuC
        ECUC_EXCLUSIVE_AREA_0 (RteBswExclusiveAreaImpl): RteExclusiveAreaImplMechanism=NONE, UserDefine=false, isNew=false
      EcuM
        EcuM_MainFunction (RteBswEventToTaskMapping):
          RteBswPositionInTask = 0
          RteBswActivationOffset = 1
          UserDefine = false
          isNew = true
          RteBswEventPeriod = 5
          RteBswEventRef = EcuM_MainFunction
          RteBswUsedOsSchTblExpiryPointRef = /
        EcuM_StartupTwo (RteBswEventToTaskMapping):
          RteBswPositionInTask = 0
          RteBswActivationOffset = 1
          UserDefine = false
          isNew = true
          RteBswEventPeriod = 5
          RteBswEventRef = EcuM_StartupTwo
          RteBswUsedOsSchTblExpiryPointRef = /
        5 x RteBswExclusiveAreaImpl, all with RteExclusiveAreaImplMechanism=NONE, UserDefine=false, isNew=false:
          ECUM_EXCLUSIVE_AREA_{0..4}
      MemIf
      NvM
        NvM_MainFunction (RteBswEventToTaskMapping):
          RteBswPositionInTask = 0
          RteBswActivationOffset = 1
          UserDefine = false
          isNew = true
          RteBswEventPeriod = 10
          RteBswEventRef = NvM_MainFunction
          RteBswUsedOsSchTblExpiryPointRef = /
        NVM_EXCLUSIVE_AREA_0 (RteBswExclusiveAreaImpl): RteExclusiveAreaImplMechanism=NONE, UserDefine=false, isNew=false
      PduR
        3 x RteBswExclusiveAreaImpl, all with RteExclusiveAreaImplMechanism=NONE, UserDefine=false, isNew=false:
          PDUR_EXCLUSIVE_AREA_{0..2}
      Rte
