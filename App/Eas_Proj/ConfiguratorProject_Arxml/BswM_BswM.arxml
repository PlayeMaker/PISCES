AUTOSAR XML (schema 00046)
package /EAS
  ecuc definition collection AUTOSARParameterDefinition: module=BswM
  module config BswM: implementation-config-variant=STD_CONFIG_VARIANTS_POSTBUILD, module_version_def=4.1.0, module_autosar_version=Ar470
    BswMGeneral:
      VersionCheck = true
      BswMCanSMEnabled = true
      BswMComMEnabled = true
      BswMDcmEnabled = true
      BswMDevErrorDetect = true
      BswMEcuMEnabled = true
      BswMEthSMEnabled = false
      BswMEthIfEnabled = false
      BswMFrSMEnabled = false
      BswMGenericRequestEnabled = true
      BswMLinSMEnabled = false
      BswMLinTpEnabled = false
      BswMNvMEnabled = true
      BswMSchMEnabled = false
      BswMSoAdEnabled = false
      BswMVersionInfoApi = true
      BswMJ1939DcmEnabled = false
      BswMJ1939NmEnabled = false
      BswMSdEnabled = false
      BswMNmEnabled = false
      BswMMainFunctionPeriod = 5
      BswMUserIncludeFile = 
      BswMDefaultModeCfg = true
      SleepWithNormalWakeup = false
      AutoRestoreNvM = true
      AutoSaveNvM = true
      SupportBootloader = false
      PNCAutoConfigWithCommunicationControl = false
      CommunicationControl = true
      PncAutoConfig = false
      BswMChangeEnabled = false
      VoltageCheckEnable = false
      BswMLinScheduleReport = false
      SleepWithResetWakeup = true
      BswMMultiCoreSupport = false
      BODY_LE1_CANTx (IpduGroup): Direction=Tx, ComMChannel=ComM_BODY_LE1_CAN
      BODY_LE1_CANRx (IpduGroup): Direction=Rx, ComMChannel=ComM_BODY_LE1_CAN
    Cfg_D (BswMConfig): UserDefine=false
      BswMArbitration
        29 x BswMLogicalExpression, all with UserDefine=false:
          ExpInitBlockII_Core0: BswMLogicalOperator=BSWM_OR, direction=, BswMArgumentRef=SysStateInit_Core0
          ExpWkupToReadNvM_Core0: BswMLogicalOperator=BSWM_AND, direction=, BswMArgumentRef=SysStateWakeup_Core0, BswMArgumentRef=ExpReqToRun
          ExpReadNvMToRun_Core0: BswMLogicalOperator=BSWM_AND, direction=, BswMArgumentRef=SysStateReadNvM_Core0, BswMArgumentRef=ExpNvMReadAllFinished
          ExpReqToRun: BswMLogicalOperator=BSWM_OR, direction=, BswMArgumentRef=EcuMRequestRun, BswMArgumentRef=ComM0FullCom
          ExpPrepToRun_Core0: BswMLogicalOperator=BSWM_AND, direction=, BswMArgumentRef=ExpReqToRun, BswMArgumentRef=SysStatePrepareShutdown_Core0
          ExpWriteNvMToRun_Core0: BswMLogicalOperator=BSWM_AND, direction=, BswMArgumentRef=ExpReqToRun, BswMArgumentRef=SysStateWriteNvM_Core0
          ExpPostRunToRun_Core0: BswMLogicalOperator=BSWM_AND, direction=, BswMArgumentRef=EcuMRequestRun, BswMArgumentRef=SysStateAppPostRun_Core0
          ExpRunToPostRun_Core0: BswMLogicalOperator=BSWM_AND, direction=, BswMArgumentRef=EcuMRequestPostRun, BswMArgumentRef=ComM0NoCom, BswMArgumentRef=SysStateAppRun_Core0, BswMArgumentRef=TimerExpired0
          ExpPostRunToPrep_Core0: BswMLogicalOperator=BSWM_AND, direction=, BswMArgumentRef=EcuMRequestShutdown, BswMArgumentRef=ComM0NoCom, BswMArgumentRef=SysStateAppPostRun_Core0
          ExpRunToPrep_Core0: BswMLogicalOperator=BSWM_AND, direction=, BswMArgumentRef=EcuMRequestShutdown, BswMArgumentRef=ComM0NoCom, BswMArgumentRef=SysStateAppRun_Core0, BswMArgumentRef=TimerExpired0
          ExpPrepToWriteNvM_Core0: BswMLogicalOperator=BSWM_AND, direction=, BswMArgumentRef=EcuMRequestShutdown, BswMArgumentRef=ComM0NoCom, BswMArgumentRef=SysStatePrepareShutdown_Core0
          ExpWriteNvMToSleep_Core0: BswMLogicalOperator=BSWM_AND, direction=, BswMArgumentRef=EcuMRequestShutdown, BswMArgumentRef=ComM0NoCom, BswMArgumentRef=SysStateWriteNvM_Core0, BswMArgumentRef=ExpNvMWriteAllFinished
          ExpWkupToSleep_Core0: BswMLogicalOperator=BSWM_AND, direction=, BswMArgumentRef=EcuMRequestShutdown, BswMArgumentRef=ComM0NoCom, BswMArgumentRef=SysStateWakeup_Core0, BswMArgumentRef=TimerExpired0
          ExpCanSM0AllowRx: BswMLogicalOperator=BSWM_NOT, direction=, BswMArgumentRef=CanSM0NoCom
          ExpCanSM0StopTx: BswMLogicalOperator=BSWM_NOT, direction=, BswMArgumentRef=CanSM0FullCom
          ExpDcmReqComNoRxTx0: BswMLogicalOperator=BSWM_OR, direction=, BswMArgumentRef=DcmReqComNoRxTx0, BswMArgumentRef=DcmReqComNmNoRxTx0
          ExpDcmReqComNoRx0: BswMLogicalOperator=BSWM_OR, direction=, BswMArgumentRef=DcmReqComNoRxTx0, BswMArgumentRef=DcmReqComTxNoRx0, BswMArgumentRef=DcmReqComNmNoRxTx0, BswMArgumentRef=DcmReqComNmTxNoRx0
          ExpDcmReqComNoTx0: BswMLogicalOperator=BSWM_OR, direction=, BswMArgumentRef=DcmReqComNoRxTx0, BswMArgumentRef=DcmReqComRxNoTx0, BswMArgumentRef=DcmReqComNmNoRxTx0, BswMArgumentRef=DcmReqComNmRxNoTx0
          ExpDcmReqComRxTx0: BswMLogicalOperator=BSWM_OR, direction=, BswMArgumentRef=DcmReqComRxTx0, BswMArgumentRef=DcmReqComNmRxTx0
          ExpDcmReqComRx0: BswMLogicalOperator=BSWM_OR, direction=, BswMArgumentRef=DcmReqComRxTx0, BswMArgumentRef=DcmReqComRxNoTx0, BswMArgumentRef=DcmReqComNmRxTx0, BswMArgumentRef=DcmReqComNmRxNoTx0
          ExpDcmReqComTx0: BswMLogicalOperator=BSWM_OR, direction=, BswMArgumentRef=DcmReqComRxTx0, BswMArgumentRef=DcmReqComTxNoRx0, BswMArgumentRef=DcmReqComNmRxTx0, BswMArgumentRef=DcmReqComNmTxNoRx0
          ExpDcmReqComTxNoRx0: BswMLogicalOperator=BSWM_OR, direction=, BswMArgumentRef=DcmReqComTxNoRx0, BswMArgumentRef=DcmReqComNmTxNoRx0
          ExpDcmReqComRxNoTx0: BswMLogicalOperator=BSWM_OR, direction=, BswMArgumentRef=DcmReqComRxNoTx0, BswMArgumentRef=DcmReqComNmRxNoTx0
          ExpBODY_LE1_CANTxOn: BswMLogicalOperator=BSWM_AND, direction=Tx, BswMArgumentRef=ComM0FullCom, BswMArgumentRef=CanSM0FullCom, BswMArgumentRef=ExpDcmReqComTx0
          ExpBODY_LE1_CANTxOff: BswMLogicalOperator=BSWM_OR, direction=Tx, BswMArgumentRef=ComM0NoCom, BswMArgumentRef=ExpCanSM0StopTx, BswMArgumentRef=ExpDcmReqComNoTx0
          ExpBODY_LE1_CANRxOn: BswMLogicalOperator=BSWM_AND, direction=Rx, BswMArgumentRef=ComM0FullCom, BswMArgumentRef=ExpCanSM0AllowRx, BswMArgumentRef=ExpDcmReqComRx0
          ExpBODY_LE1_CANRxOff: BswMLogicalOperator=BSWM_OR, direction=Rx, BswMArgumentRef=ComM0NoCom, BswMArgumentRef=CanSM0NoCom, BswMArgumentRef=ExpDcmReqComNoRx0
          ExpNvMReadAllFinished: BswMLogicalOperator=BSWM_OR, direction=, BswMArgumentRef=NvMReadAllOK, BswMArgumentRef=NvMReadAllNotOK
          ExpNvMWriteAllFinished: BswMLogicalOperator=BSWM_OR, direction=, BswMArgumentRef=NvMWriteAllOK, BswMArgumentRef=NvMWriteAllNotOK
        28 x BswMModeCondition, all with BswMConditionType=BSWM_EQUALS, UserDefine=false:
          SysStateInit_Core0: BswMConditionMode=BswMArbitration/SysState_Core0
            BswMConditionValue
              BswMBswMode: RequestedModeSelect=, BswMBswRequestedMode=BSWM_GENERIC_MODE_INIT
          SysStateWakeup_Core0: BswMConditionMode=BswMArbitration/SysState_Core0
            BswMConditionValue
              BswMBswMode: RequestedModeSelect=, BswMBswRequestedMode=BSWM_GENERIC_MODE_WAKEUP
          SysStateReadNvM_Core0: BswMConditionMode=BswMArbitration/SysState_Core0
            BswMConditionValue
              BswMBswMode: RequestedModeSelect=, BswMBswRequestedMode=BSWM_GENERIC_MODE_READ_NVM
          SysStateAppRun_Core0: BswMConditionMode=BswMArbitration/SysState_Core0
            BswMConditionValue
              BswMBswMode: RequestedModeSelect=, BswMBswRequestedMode=BSWM_GENERIC_MODE_APP_RUN
          EcuMRequestRun: BswMConditionMode=BswMArbitration/EcuMRunRequest
            BswMConditionValue
              BswMBswMode: RequestedModeSelect=ECUM_STATE_APP_RUN, BswMBswRequestedMode=
          EcuMRequestPostRun: BswMConditionMode=BswMArbitration/EcuMRunRequest
            BswMConditionValue
              BswMBswMode: RequestedModeSelect=ECUM_STATE_APP_POST_RUN, BswMBswRequestedMode=
          EcuMRequestShutdown: BswMConditionMode=BswMArbitration/EcuMRunRequest
            BswMConditionValue
              BswMBswMode: RequestedModeSelect=ECUM_STATE_SHUTDOWN, BswMBswRequestedMode=
          CanSM0NoCom: BswMConditionMode=BswMArbitration/CanSM0Mode
            BswMConditionValue
              BswMBswMode: RequestedModeSelect=CANSM_BSWM_NO_COMMUNICATION, BswMBswRequestedMode=
          CanSM0FullCom: BswMConditionMode=BswMArbitration/CanSM0Mode
            BswMConditionValue
              BswMBswMode: RequestedModeSelect=CANSM_BSWM_FULL_COMMUNICATION, BswMBswRequestedMode=
          ComM0NoCom: BswMConditionMode=BswMArbitration/ComM0Mode
            BswMConditionValue
              BswMBswMode: RequestedModeSelect=COMM_NO_COMMUNICATION, BswMBswRequestedMode=
          ComM0FullCom: BswMConditionMode=BswMArbitration/ComM0Mode
            BswMConditionValue
              BswMBswMode: RequestedModeSelect=COMM_FULL_COMMUNICATION, BswMBswRequestedMode=
          SysStateAppPostRun_Core0: BswMConditionMode=BswMArbitration/SysState_Core0
            BswMConditionValue
              BswMBswMode: RequestedModeSelect=, BswMBswRequestedMode=BSWM_GENERIC_MODE_POST_RUN
          SysStatePrepareShutdown_Core0: BswMConditionMode=BswMArbitration/SysState_Core0
            BswMConditionValue
              BswMBswMode: RequestedModeSelect=, BswMBswRequestedMode=BSWM_GENERIC_MODE_PREP_SHUTDOWN
          SysStateWriteNvM_Core0: BswMConditionMode=BswMArbitration/SysState_Core0
            BswMConditionValue
              BswMBswMode: RequestedModeSelect=, BswMBswRequestedMode=BSWM_GENERIC_MODE_WRITE_NVM
          SysStateSleep_Core0: BswMConditionMode=BswMArbitration/SysState_Core0
            BswMConditionValue
              BswMBswMode: RequestedModeSelect=, BswMBswRequestedMode=BSWM_GENERIC_MODE_SLEEP
          TimerExpired0: BswMConditionMode=BswMArbitration/BswMTimer0
            BswMConditionValue
              BswMBswMode: RequestedModeSelect=BSWM_TIMER_EXPIRED, BswMBswRequestedMode=
          DcmReqComNoRxTx0: BswMConditionMode=BswMArbitration/DcmRequestCommunicationMode0
            BswMConditionValue
              BswMBswMode: RequestedModeSelect=DCM_DISABLE_RX_TX_NORMAL, BswMBswRequestedMode=
          DcmReqComRxTx0: BswMConditionMode=BswMArbitration/DcmRequestCommunicationMode0
            BswMConditionValue
              BswMBswMode: RequestedModeSelect=DCM_ENABLE_RX_TX_NORM, BswMBswRequestedMode=
          DcmReqComTxNoRx0: BswMConditionMode=BswMArbitration/DcmRequestCommunicationMode0
            BswMConditionValue
              BswMBswMode: RequestedModeSelect=DCM_DISABLE_RX_ENABLE_TX_NORM, BswMBswRequestedMode=
          DcmReqComRxNoTx0: BswMConditionMode=BswMArbitration/DcmRequestCommunicationMode0
            BswMConditionValue
              BswMBswMode: RequestedModeSelect=DCM_ENABLE_RX_DISABLE_TX_NORM, BswMBswRequestedMode=
          DcmReqComNmNoRxTx0: BswMConditionMode=BswMArbitration/DcmRequestCommunicationMode0
            BswMConditionValue
              BswMBswMode: RequestedModeSelect=DCM_DISABLE_RX_TX_NORM_NM, BswMBswRequestedMode=
          DcmReqComNmRxTx0: BswMConditionMode=BswMArbitration/DcmRequestCommunicationMode0
            BswMConditionValue
              BswMBswMode: RequestedModeSelect=DCM_ENABLE_RX_TX_NORM_NM, BswMBswRequestedMode=
          DcmReqComNmTxNoRx0: BswMConditionMode=BswMArbitration/DcmRequestCommunicationMode0
            BswMConditionValue
              BswMBswMode: RequestedModeSelect=DCM_DISABLE_RX_ENABLE_TX_NORM_NM, BswMBswRequestedMode=
          DcmReqComNmRxNoTx0: BswMConditionMode=BswMArbitration/DcmRequestCommunicationMode0
            BswMConditionValue
              BswMBswMode: RequestedModeSelect=DCM_ENABLE_RX_DISABLE_TX_NORM_NM, BswMBswRequestedMode=
          NvMReadAllOK: BswMConditionMode=BswMArbitration/NvMReadAllMode
            BswMConditionValue
              BswMBswMode: RequestedModeSelect=NVM_REQ_OK, BswMBswRequestedMode=
          NvMReadAllNotOK: BswMConditionMode=BswMArbitration/NvMReadAllMode
            BswMConditionValue
              BswMBswMode: RequestedModeSelect=NVM_REQ_NOT_OK, BswMBswRequestedMode=
          NvMWriteAllOK: BswMConditionMode=BswMArbitration/NvMWriteAllMode
            BswMConditionValue
              BswMBswMode: RequestedModeSelect=NVM_REQ_OK, BswMBswRequestedMode=
          NvMWriteAllNotOK: BswMConditionMode=BswMArbitration/NvMWriteAllMode
            BswMConditionValue
              BswMBswMode: RequestedModeSelect=NVM_REQ_NOT_OK, BswMBswRequestedMode=
        8 x BswMModeRequestPort, all with UserDefine=false:
          SysState_Core0: BswMRequestProcessing=BSWM_IMMEDIATE
            BswMModeRequestSource
              SysState_Core0 (BswMGenericRequest): BswMModeRequesterId=0, BswMModeRequesterLocatedInCoreID=0
            BswMModeInitValue
              BswMSwcModeInitValue: BswMSwcModeInitValueRef=BSWM_GENERIC_MODE_INIT
          EcuMRunRequest: BswMRequestProcessing=BSWM_DEFERRED
            BswMModeRequestSource
              EcuMRunRequest (BswMEcuMRUNRequestIndication): BswMEcuMRUNRequestProtocolPort=POST_RUN
            BswMModeInitValue
              BswMBswModeInitValue: InitValueSelect=ECUM_STATE_SHUTDOWN, BswMBswModeInitValueMode=
          CanSM0Mode: BswMRequestProcessing=BSWM_DEFERRED
            BswMModeRequestSource
              CanSM0Mode (BswMCanSMIndication): BswMCanSMChannelRef=CanSM_BODY_LE1_CAN
            BswMModeInitValue
              BswMBswModeInitValue: InitValueSelect=CANSM_BSWM_NO_COMMUNICATION, BswMBswModeInitValueMode=
          ComM0Mode: BswMRequestProcessing=BSWM_DEFERRED
            BswMModeRequestSource
              ComM0Mode (BswMComMIndication): BswMComMChannelRef=ComM_BODY_LE1_CAN
            BswMModeInitValue
              BswMBswModeInitValue: InitValueSelect=COMM_NO_COMMUNICATION, BswMBswModeInitValueMode=
          BswMTimer0: BswMRequestProcessing=BSWM_DEFERRED
            BswMModeRequestSource
              BswMTimer0 (BswMTimer): BswMTimerLocatedInCoreID=0
            BswMModeInitValue
              BswMBswModeInitValue: InitValueSelect=BSWM_TIMER_STOPPED, BswMBswModeInitValueMode=
          DcmRequestCommunicationMode0: BswMRequestProcessing=BSWM_DEFERRED
            BswMModeRequestSource
              DcmRequestCommunicationMode0 (BswMDcmComModeRequest): BswMDcmComMChannelRef=ComM_BODY_LE1_CAN
            BswMModeInitValue
              BswMBswModeInitValue: InitValueSelect=DCM_ENABLE_RX_TX_NORM_NM, BswMBswModeInitValueMode=
          NvMReadAllMode: BswMRequestProcessing=BSWM_IMMEDIATE
            BswMModeRequestSource
              NvMReadAllMode (BswMNvMJobModeIndication): BswMNvmService=NvmReadAll
            BswMModeInitValue
              BswMBswModeInitValue: InitValueSelect=NVM_REQ_PENDING, BswMBswModeInitValueMode=
          NvMWriteAllMode: BswMRequestProcessing=BSWM_IMMEDIATE
            BswMModeRequestSource
              NvMWriteAllMode (BswMNvMJobModeIndication): BswMNvmService=NvmWriteAll
            BswMModeInitValue
              BswMBswModeInitValue: InitValueSelect=NVM_REQ_PENDING, BswMBswModeInitValueMode=
        16 x BswMRule, all with BswMNestedExecutionOnly=false, BswMRuleInitState=BSWM_FALSE, BswMRuleLocatedInCoreID=BSWM_CORE_0, UserDefine=false:
          BswM_RuleInitBlockII_Core0: BswMRuleExpressionRef=BswMArbitration/ExpInitBlockII_Core0, BswMRuleTrueActionList=BswMModeControl/BswM_ALInitBlockII_Core0
          BswM_RuleWkupToReadNvM_Core0: BswMRuleExpressionRef=BswMArbitration/ExpWkupToReadNvM_Core0, BswMRuleTrueActionList=BswMModeControl/BswM_ALWkupToReadNvM_Core0
          BswM_RuleReadNvMToRun_Core0: BswMRuleExpressionRef=BswMArbitration/ExpReadNvMToRun_Core0, BswMRuleTrueActionList=BswMModeControl/BswM_ALReadNvMToRun_Core0
          BswM_RuleRunToPostRun_Core0: BswMRuleExpressionRef=BswMArbitration/ExpRunToPostRun_Core0, BswMRuleTrueActionList=BswMModeControl/BswM_ALRunToPostRun_Core0
          BswM_RulePostRunToRun_Core0: BswMRuleExpressionRef=BswMArbitration/ExpPostRunToRun_Core0, BswMRuleTrueActionList=BswMModeControl/BswM_ALPostRunToRun_Core0
          BswM_RulePostRunToPrep_Core0: BswMRuleExpressionRef=BswMArbitration/ExpPostRunToPrep_Core0, BswMRuleTrueActionList=BswMModeControl/BswM_ALPostRunToPrep_Core0
          BswM_RuleRunToPrep_Core0: BswMRuleExpressionRef=BswMArbitration/ExpRunToPrep_Core0, BswMRuleTrueActionList=BswMModeControl/BswM_ALRunToPrep_Core0
          BswM_RulePrepToRun_Core0: BswMRuleExpressionRef=BswMArbitration/ExpPrepToRun_Core0, BswMRuleTrueActionList=BswMModeControl/BswM_ALPrepToRun_Core0
          BswM_RulePrepToWriteNvM_Core0: BswMRuleExpressionRef=BswMArbitration/ExpPrepToWriteNvM_Core0, BswMRuleTrueActionList=BswMModeControl/BswM_ALPrepToWriteNvM_Core0
          BswM_RuleWriteNvMToRun_Core0: BswMRuleExpressionRef=BswMArbitration/ExpWriteNvMToRun_Core0, BswMRuleTrueActionList=BswMModeControl/BswM_ALPrepToRun_Core0
          BswM_RuleWriteNvMToSleep_Core0: BswMRuleExpressionRef=BswMArbitration/ExpWriteNvMToSleep_Core0, BswMRuleTrueActionList=BswMModeControl/BswM_ALWriteNvMToSleep_Core0
          BswM_RuleWkupToSleep_Core0: BswMRuleExpressionRef=BswMArbitration/ExpWkupToSleep_Core0, BswMRuleTrueActionList=BswMModeControl/BswM_ALWkupToSleep_Core0
          BswM_RuleBODY_LE1_CANTxOn: BswMRuleExpressionRef=BswMArbitration/ExpBODY_LE1_CANTxOn, BswMRuleTrueActionList=BswMModeControl/BswM_ALBODY_LE1_CANTxOn
          BswM_RuleBODY_LE1_CANTxOff: BswMRuleExpressionRef=BswMArbitration/ExpBODY_LE1_CANTxOff, BswMRuleTrueActionList=BswMModeControl/BswM_ALBODY_LE1_CANTxOff
          BswM_RuleBODY_LE1_CANRxOn: BswMRuleExpressionRef=BswMArbitration/ExpBODY_LE1_CANRxOn, BswMRuleTrueActionList=BswMModeControl/BswM_ALBODY_LE1_CANRxOn
          BswM_RuleBODY_LE1_CANRxOff: BswMRuleExpressionRef=BswMArbitration/ExpBODY_LE1_CANRxOff, BswMRuleTrueActionList=BswMModeControl/BswM_ALBODY_LE1_CANRxOff
      BswMModeControl
        30 x BswMAction, all with UserDefine=false:
          ActionInitBlockII_Core0
            BswMAvailableActions
              ActionInitBlockII_Core0 (BswMUserCallout): BswMUserCalloutFunction=BswM_InitBlockIICallout_Core0()
          ActionStartBswTask_Core0
            BswMAvailableActions
              ActionStartBswTask_Core0 (BswMUserCallout): BswMUserCalloutFunction=BswM_StartBswTaskCallout_Core0()
          ActionPostReadAll_Core0
            BswMAvailableActions
              ActionPostReadAll_Core0 (BswMUserCallout): BswMUserCalloutFunction=BswM_PostReadAllCallout_Core0()
          ActionCom0Allow
            BswMAvailableActions
              ActionCom0Allow (BswMComMAllowCom): BswMComAllowed=true, BswMComMAllowChannelRef=ComM_BODY_LE1_CAN
          ActionRteStart_Core0
            BswMAvailableActions
              ActionRteStart_Core0 (BswMRteStart)
          ActionRequestWakeup_Core0
            BswMAvailableActions
              ActionRequestWakeup_Core0 (BswMGenericRequest): BswMRequestedMode=BSWM_GENERIC_MODE_WAKEUP, BswMModeRequestPort=BswMArbitration/SysState_Core0
          ActionRequestReadNvM_Core0
            BswMAvailableActions
              ActionRequestReadNvM_Core0 (BswMGenericRequest): BswMRequestedMode=BSWM_GENERIC_MODE_READ_NVM, BswMModeRequestPort=BswMArbitration/SysState_Core0
          ActionRequestAppRun_Core0
            BswMAvailableActions
              ActionRequestAppRun_Core0 (BswMGenericRequest): BswMRequestedMode=BSWM_GENERIC_MODE_APP_RUN, BswMModeRequestPort=BswMArbitration/SysState_Core0
          ActionSetEcuMRun
            BswMAvailableActions
              ActionSetEcuMRun (BswMEcuMStateSwitch): BswMEcuMState=RUN
          ActionSetEcuMAppRun
            BswMAvailableActions
              ActionSetEcuMAppRun (BswMEcuMStateSwitch): BswMEcuMState=APP_RUN
          ActionPreShutdown_Core0
            BswMAvailableActions
              ActionPreShutdown_Core0 (BswMUserCallout): BswMUserCalloutFunction=BswM_PreShutdownCallout_Core0()
          ActionWakeupToSleep_Core0
            BswMAvailableActions
              ActionWakeupToSleep_Core0 (BswMUserCallout): BswMUserCalloutFunction=BswM_WakeupToSleepCallout_Core0()
          ActionWriteNvMToSleep_Core0
            BswMAvailableActions
              ActionWriteNvMToSleep_Core0 (BswMUserCallout): BswMUserCalloutFunction=BswM_WriteNvMToSleepCallout_Core0()
          ActionClearWakeupEvent_Core0
            BswMAvailableActions
              ActionClearWakeupEvent_Core0 (BswMUserCallout): BswMUserCalloutFunction=BswM_ClearWakeupEventCallout_Core0()
          ActionRteStop_Core0
            BswMAvailableActions
              ActionRteStop_Core0 (BswMRteStop)
          ActionRequestAppPostRun_Core0
            BswMAvailableActions
              ActionRequestAppPostRun_Core0 (BswMGenericRequest): BswMRequestedMode=BSWM_GENERIC_MODE_POST_RUN, BswMModeRequestPort=BswMArbitration/SysState_Core0
          ActionRequestPrepareShutdown_Core0
            BswMAvailableActions
              ActionRequestPrepareShutdown_Core0 (BswMGenericRequest): BswMRequestedMode=BSWM_GENERIC_MODE_PREP_SHUTDOWN, BswMModeRequestPort=BswMArbitration/SysState_Core0
          ActionRequestWriteNvM_Core0
            BswMAvailableActions
              ActionRequestWriteNvM_Core0 (BswMGenericRequest): BswMRequestedMode=BSWM_GENERIC_MODE_WRITE_NVM, BswMModeRequestPort=BswMArbitration/SysState_Core0
          ActionRequestSleep_Core0
            BswMAvailableActions
              ActionRequestSleep_Core0 (BswMGenericRequest): BswMRequestedMode=BSWM_GENERIC_MODE_SLEEP, BswMModeRequestPort=BswMArbitration/SysState_Core0
          ActionSetTimerAppRunDelay_Core0
            BswMAvailableActions
              ActionSetTimerAppRunDelay_Core0 (BswMSetTimer): BswMTimerAction=BSWM_TIMER_START, BswMTimerValue=10, BswMTimerRef=BswMModeRequestSource/BswMTimer0
          ActionSetTimerWakeUpDelay_Core0
            BswMAvailableActions
              ActionSetTimerWakeUpDelay_Core0 (BswMSetTimer): BswMTimerAction=BSWM_TIMER_START, BswMTimerValue=0, BswMTimerRef=BswMModeRequestSource/BswMTimer0
          ActionStopTimer_Core0
            BswMAvailableActions
              ActionStopTimer_Core0 (BswMSetTimer): BswMTimerAction=BSWM_TIMER_STOP, BswMTimerValue=0, BswMTimerRef=BswMModeRequestSource/BswMTimer0
          ActionSetEcuMAppPostRun
            BswMAvailableActions
              ActionSetEcuMAppPostRun (BswMEcuMStateSwitch): BswMEcuMState=APP_POST_RUN
          ActionSetEcuMSleep
            BswMAvailableActions
              ActionSetEcuMSleep (BswMEcuMStateSwitch): BswMEcuMState=SLEEP
          ActionBODY_LE1_CANTxOn
            BswMAvailableActions
              ActionBODY_LE1_CANTxOn (BswMPduGroupSwitch): BswMPduGroupSwitchReinit=false, BswMEnabledPduGroupRef=BODY_LE1_CANTx
          ActionBODY_LE1_CANTxOff
            BswMAvailableActions
              ActionBODY_LE1_CANTxOff (BswMPduGroupSwitch): BswMPduGroupSwitchReinit=false, BswMDisabledPduGroupRef=BODY_LE1_CANTx
          ActionBODY_LE1_CANRxOn
            BswMAvailableActions
              ActionBODY_LE1_CANRxOn (BswMPduGroupSwitch): BswMPduGroupSwitchReinit=false, BswMEnabledPduGroupRef=BODY_LE1_CANRx
          ActionBODY_LE1_CANRxOff
            BswMAvailableActions
              ActionBODY_LE1_CANRxOff (BswMPduGroupSwitch): BswMPduGroupSwitchReinit=false, BswMDisabledPduGroupRef=BODY_LE1_CANRx
          ActionReadAll_Core0
            BswMAvailableActions
              ActionReadAll_Core0 (BswMUserCallout): BswMUserCalloutFunction=BswM_NvMReadAllCallout_Core0()
          ActionWriteAll_Core0
            BswMAvailableActions
              ActionWriteAll_Core0 (BswMUserCallout): BswMUserCalloutFunction=BswM_NvMWriteAllCallout_Core0()
        15 x BswMActionList, all with BswMActionListPriority=0, UserDefine=false:
          BswM_ALInitBlockII_Core0: BswMActionListExecution=BSWM_CONDITION
            6 x BswMActionListItem, all with BswMAbortOnFail=false, BswMErrorIdEnable=false, UserDefine=false:
              ActionInitBlockII_Core0: BswMActionListItemIndex=0, BswMActionListItemRef=BswMModeControl/ActionInitBlockII_Core0
              ActionSetTimerWakeUpDelay_Core0: BswMActionListItemIndex=1, BswMActionListItemRef=BswMModeControl/ActionSetTimerWakeUpDelay_Core0
              ActionRequestWakeup_Core0: BswMActionListItemIndex=2, BswMActionListItemRef=BswMModeControl/ActionRequestWakeup_Core0
              ActionSetEcuMRun: BswMActionListItemIndex=3, BswMActionListItemRef=BswMModeControl/ActionSetEcuMRun
              ActionCom0Allow: BswMActionListItemIndex=4, BswMActionListItemRef=BswMModeControl/ActionCom0Allow
              ActionStartBswTask_Core0: BswMActionListItemIndex=5, BswMActionListItemRef=BswMModeControl/ActionStartBswTask_Core0
          BswM_ALWkupToReadNvM_Core0: BswMActionListExecution=BSWM_TRIGGER
            3 x BswMActionListItem, all with BswMAbortOnFail=false, BswMErrorIdEnable=false, UserDefine=false:
              ActionStopTimer_Core0: BswMActionListItemIndex=0, BswMActionListItemRef=BswMModeControl/ActionStopTimer_Core0
              ActionRequestReadNvM_Core0: BswMActionListItemIndex=1, BswMActionListItemRef=BswMModeControl/ActionRequestReadNvM_Core0
              ActionReadAll_Core0: BswMActionListItemIndex=2, BswMActionListItemRef=BswMModeControl/ActionReadAll_Core0
          BswM_ALReadNvMToRun_Core0: BswMActionListExecution=BSWM_TRIGGER
            5 x BswMActionListItem, all with BswMAbortOnFail=false, BswMErrorIdEnable=false, UserDefine=false:
              ActionPostReadAll_Core0: BswMActionListItemIndex=0, BswMActionListItemRef=BswMModeControl/ActionPostReadAll_Core0
              ActionSetTimerAppRunDelay_Core0: BswMActionListItemIndex=1, BswMActionListItemRef=BswMModeControl/ActionSetTimerAppRunDelay_Core0
              ActionRequestAppRun_Core0: BswMActionListItemIndex=2, BswMActionListItemRef=BswMModeControl/ActionRequestAppRun_Core0
              ActionSetEcuMAppRun: BswMActionListItemIndex=3, BswMActionListItemRef=BswMModeControl/ActionSetEcuMAppRun
              ActionRteStart_Core0: BswMActionListItemIndex=4, BswMActionListItemRef=BswMModeControl/ActionRteStart_Core0
          BswM_ALRunToPostRun_Core0: BswMActionListExecution=BSWM_TRIGGER
            ActionRequestAppPostRun_Core0 (BswMActionListItem):
              BswMAbortOnFail = false
              BswMActionListItemIndex = 0
              BswMErrorIdEnable = false
              UserDefine = false
              BswMActionListItemRef = BswMModeControl/ActionRequestAppPostRun_Core0
            ActionSetEcuMAppPostRun (BswMActionListItem):
              BswMAbortOnFail = false
              BswMActionListItemIndex = 1
              BswMErrorIdEnable = false
              UserDefine = false
              BswMActionListItemRef = BswMModeControl/ActionSetEcuMAppPostRun
          BswM_ALPostRunToRun_Core0: BswMActionListExecution=BSWM_TRIGGER
            3 x BswMActionListItem, all with BswMAbortOnFail=false, BswMErrorIdEnable=false, UserDefine=false:
              ActionSetTimerAppRunDelay_Core0: BswMActionListItemIndex=0, BswMActionListItemRef=BswMModeControl/ActionSetTimerAppRunDelay_Core0
              ActionSetEcuMAppRun: BswMActionListItemIndex=1, BswMActionListItemRef=BswMModeControl/ActionSetEcuMAppRun
              ActionRequestAppRun_Core0: BswMActionListItemIndex=2, BswMActionListItemRef=BswMModeControl/ActionRequestAppRun_Core0
          BswM_ALPrepToRun_Core0: BswMActionListExecution=BSWM_TRIGGER
            4 x BswMActionListItem, all with BswMAbortOnFail=false, BswMErrorIdEnable=false, UserDefine=false:
              ActionSetTimerAppRunDelay_Core0: BswMActionListItemIndex=0, BswMActionListItemRef=BswMModeControl/ActionSetTimerAppRunDelay_Core0
              ActionSetEcuMAppRun: BswMActionListItemIndex=1, BswMActionListItemRef=BswMModeControl/ActionSetEcuMAppRun
              ActionRequestAppRun_Core0: BswMActionListItemIndex=2, BswMActionListItemRef=BswMModeControl/ActionRequestAppRun_Core0
              ActionRteStart_Core0: BswMActionListItemIndex=3, BswMActionListItemRef=BswMModeControl/ActionRteStart_Core0
          BswM_ALPostRunToPrep_Core0: BswMActionListExecution=BSWM_TRIGGER
            3 x BswMActionListItem, all with BswMAbortOnFail=false, BswMErrorIdEnable=false, UserDefine=false:
              ActionRequestPrepareShutdown_Core0: BswMActionListItemIndex=0, BswMActionListItemRef=BswMModeControl/ActionRequestPrepareShutdown_Core0
              ActionPreShutdown_Core0: BswMActionListItemIndex=1, BswMActionListItemRef=BswMModeControl/ActionPreShutdown_Core0
              ActionRteStop_Core0: BswMActionListItemIndex=2, BswMActionListItemRef=BswMModeControl/ActionRteStop_Core0
          BswM_ALRunToPrep_Core0: BswMActionListExecution=BSWM_TRIGGER
            3 x BswMActionListItem, all with BswMAbortOnFail=false, BswMErrorIdEnable=false, UserDefine=false:
              ActionRequestPrepareShutdown_Core0: BswMActionListItemIndex=0, BswMActionListItemRef=BswMModeControl/ActionRequestPrepareShutdown_Core0
              ActionPreShutdown_Core0: BswMActionListItemIndex=1, BswMActionListItemRef=BswMModeControl/ActionPreShutdown_Core0
              ActionRteStop_Core0: BswMActionListItemIndex=2, BswMActionListItemRef=BswMModeControl/ActionRteStop_Core0
          BswM_ALPrepToWriteNvM_Core0: BswMActionListExecution=BSWM_TRIGGER
            ActionRequestWriteNvM_Core0 (BswMActionListItem):
              BswMAbortOnFail = false
              BswMActionListItemIndex = 0
              BswMErrorIdEnable = false
              UserDefine = false
              BswMActionListItemRef = BswMModeControl/ActionRequestWriteNvM_Core0
            ActionWriteAll_Core0 (BswMActionListItem):
              BswMAbortOnFail = false
              BswMActionListItemIndex = 1
              BswMErrorIdEnable = false
              UserDefine = false
              BswMActionListItemRef = BswMModeControl/ActionWriteAll_Core0
          BswM_ALWriteNvMToSleep_Core0: BswMActionListExecution=BSWM_TRIGGER
            4 x BswMActionListItem, all with BswMAbortOnFail=false, BswMErrorIdEnable=false, UserDefine=false:
              ActionSetEcuMSleep: BswMActionListItemIndex=0, BswMActionListItemRef=BswMModeControl/ActionSetEcuMSleep
              ActionRequestSleep_Core0: BswMActionListItemIndex=1, BswMActionListItemRef=BswMModeControl/ActionRequestSleep_Core0
              ActionClearWakeupEvent_Core0: BswMActionListItemIndex=2, BswMActionListItemRef=BswMModeControl/ActionClearWakeupEvent_Core0
              ActionWriteNvMToSleep_Core0: BswMActionListItemIndex=3, BswMActionListItemRef=BswMModeControl/ActionWriteNvMToSleep_Core0
          BswM_ALWkupToSleep_Core0: BswMActionListExecution=BSWM_TRIGGER
            4 x BswMActionListItem, all with BswMAbortOnFail=false, BswMErrorIdEnable=false, UserDefine=false:
              ActionSetEcuMSleep: BswMActionListItemIndex=0, BswMActionListItemRef=BswMModeControl/ActionSetEcuMSleep
              ActionRequestSleep_Core0: BswMActionListItemIndex=1, BswMActionListItemRef=BswMModeControl/ActionRequestSleep_Core0
              ActionClearWakeupEvent_Core0: BswMActionListItemIndex=2, BswMActionListItemRef=BswMModeControl/ActionClearWakeupEvent_Core0
              ActionWakeupToSleep_Core0: BswMActionListItemIndex=3, BswMActionListItemRef=BswMModeControl/ActionWakeupToSleep_Core0
          BswM_ALBODY_LE1_CANTxOff: BswMActionListExecution=BSWM_TRIGGER
            ActionBODY_LE1_CANTxOff (BswMActionListItem):
              BswMAbortOnFail = false
              BswMActionListItemIndex = 0
              BswMErrorIdEnable = false
              UserDefine = false
              BswMActionListItemRef = BswMModeControl/ActionBODY_LE1_CANTxOff
          BswM_ALBODY_LE1_CANTxOn: BswMActionListExecution=BSWM_TRIGGER
            ActionBODY_LE1_CANTxOn (BswMActionListItem):
              BswMAbortOnFail = false
              BswMActionListItemIndex = 0
              BswMErrorIdEnable = false
              UserDefine = false
              BswMActionListItemRef = BswMModeControl/ActionBODY_LE1_CANTxOn
          BswM_ALBODY_LE1_CANRxOff: BswMActionListExecution=BSWM_TRIGGER
            ActionBODY_LE1_CANRxOff (BswMActionListItem):
              BswMAbortOnFail = false
              BswMActionListItemIndex = 0
              BswMErrorIdEnable = false
              UserDefine = false
              BswMActionListItemRef = BswMModeControl/ActionBODY_LE1_CANRxOff
          BswM_ALBODY_LE1_CANRxOn: BswMActionListExecution=BSWM_TRIGGER
            ActionBODY_LE1_CANRxOn (BswMActionListItem):
              BswMAbortOnFail = false
              BswMActionListItemIndex = 0
              BswMErrorIdEnable = false
              UserDefine = false
              BswMActionListItemRef = BswMModeControl/ActionBODY_LE1_CANRxOn
    Cfg_P (BswMConfig): UserDefine=false
      BswMArbitration
        29 x BswMLogicalExpression, all with UserDefine=false:
          ExpInitBlockII_Core0: BswMLogicalOperator=BSWM_OR, direction=, BswMArgumentRef=SysStateInit_Core0
          ExpWkupToReadNvM_Core0: BswMLogicalOperator=BSWM_AND, direction=, BswMArgumentRef=SysStateWakeup_Core0, BswMArgumentRef=ExpReqToRun
          ExpReadNvMToRun_Core0: BswMLogicalOperator=BSWM_AND, direction=, BswMArgumentRef=SysStateReadNvM_Core0, BswMArgumentRef=ExpNvMReadAllFinished
          ExpReqToRun: BswMLogicalOperator=BSWM_OR, direction=, BswMArgumentRef=EcuMRequestRun, BswMArgumentRef=ComM0FullCom
          ExpPrepToRun_Core0: BswMLogicalOperator=BSWM_AND, direction=, BswMArgumentRef=ExpReqToRun, BswMArgumentRef=SysStatePrepareShutdown_Core0
          ExpWriteNvMToRun_Core0: BswMLogicalOperator=BSWM_AND, direction=, BswMArgumentRef=ExpReqToRun, BswMArgumentRef=SysStateWriteNvM_Core0
          ExpPostRunToRun_Core0: BswMLogicalOperator=BSWM_AND, direction=, BswMArgumentRef=EcuMRequestRun, BswMArgumentRef=SysStateAppPostRun_Core0
          ExpRunToPostRun_Core0: BswMLogicalOperator=BSWM_AND, direction=, BswMArgumentRef=EcuMRequestPostRun, BswMArgumentRef=ComM0NoCom, BswMArgumentRef=SysStateAppRun_Core0, BswMArgumentRef=TimerExpired0
          ExpPostRunToPrep_Core0: BswMLogicalOperator=BSWM_AND, direction=, BswMArgumentRef=EcuMRequestShutdown, BswMArgumentRef=ComM0NoCom, BswMArgumentRef=SysStateAppPostRun_Core0
          ExpRunToPrep_Core0: BswMLogicalOperator=BSWM_AND, direction=, BswMArgumentRef=EcuMRequestShutdown, BswMArgumentRef=ComM0NoCom, BswMArgumentRef=SysStateAppRun_Core0, BswMArgumentRef=TimerExpired0
          ExpPrepToWriteNvM_Core0: BswMLogicalOperator=BSWM_AND, direction=, BswMArgumentRef=EcuMRequestShutdown, BswMArgumentRef=ComM0NoCom, BswMArgumentRef=SysStatePrepareShutdown_Core0
          ExpWriteNvMToSleep_Core0: BswMLogicalOperator=BSWM_AND, direction=, BswMArgumentRef=EcuMRequestShutdown, BswMArgumentRef=ComM0NoCom, BswMArgumentRef=SysStateWriteNvM_Core0, BswMArgumentRef=ExpNvMWriteAllFinished
          ExpWkupToSleep_Core0: BswMLogicalOperator=BSWM_AND, direction=, BswMArgumentRef=EcuMRequestShutdown, BswMArgumentRef=ComM0NoCom, BswMArgumentRef=SysStateWakeup_Core0, BswMArgumentRef=TimerExpired0
          ExpCanSM0AllowRx: BswMLogicalOperator=BSWM_NOT, direction=, BswMArgumentRef=CanSM0NoCom
          ExpCanSM0StopTx: BswMLogicalOperator=BSWM_NOT, direction=, BswMArgumentRef=CanSM0FullCom
          ExpDcmReqComNoRxTx0: BswMLogicalOperator=BSWM_OR, direction=, BswMArgumentRef=DcmReqComNoRxTx0, BswMArgumentRef=DcmReqComNmNoRxTx0
          ExpDcmReqComNoRx0: BswMLogicalOperator=BSWM_OR, direction=, BswMArgumentRef=DcmReqComNoRxTx0, BswMArgumentRef=DcmReqComTxNoRx0, BswMArgumentRef=DcmReqComNmNoRxTx0, BswMArgumentRef=DcmReqComNmTxNoRx0
          ExpDcmReqComNoTx0: BswMLogicalOperator=BSWM_OR, direction=, BswMArgumentRef=DcmReqComNoRxTx0, BswMArgumentRef=DcmReqComRxNoTx0, BswMArgumentRef=DcmReqComNmNoRxTx0, BswMArgumentRef=DcmReqComNmRxNoTx0
          ExpDcmReqComRxTx0: BswMLogicalOperator=BSWM_OR, direction=, BswMArgumentRef=DcmReqComRxTx0, BswMArgumentRef=DcmReqComNmRxTx0
          ExpDcmReqComRx0: BswMLogicalOperator=BSWM_OR, direction=, BswMArgumentRef=DcmReqComRxTx0, BswMArgumentRef=DcmReqComRxNoTx0, BswMArgumentRef=DcmReqComNmRxTx0, BswMArgumentRef=DcmReqComNmRxNoTx0
          ExpDcmReqComTx0: BswMLogicalOperator=BSWM_OR, direction=, BswMArgumentRef=DcmReqComRxTx0, BswMArgumentRef=DcmReqComTxNoRx0, BswMArgumentRef=DcmReqComNmRxTx0, BswMArgumentRef=DcmReqComNmTxNoRx0
          ExpDcmReqComTxNoRx0: BswMLogicalOperator=BSWM_OR, direction=, BswMArgumentRef=DcmReqComTxNoRx0, BswMArgumentRef=DcmReqComNmTxNoRx0
          ExpDcmReqComRxNoTx0: BswMLogicalOperator=BSWM_OR, direction=, BswMArgumentRef=DcmReqComRxNoTx0, BswMArgumentRef=DcmReqComNmRxNoTx0
          ExpBODY_LE1_CANTxOn: BswMLogicalOperator=BSWM_AND, direction=Tx, BswMArgumentRef=ComM0FullCom, BswMArgumentRef=CanSM0FullCom, BswMArgumentRef=ExpDcmReqComTx0
          ExpBODY_LE1_CANTxOff: BswMLogicalOperator=BSWM_OR, direction=Tx, BswMArgumentRef=ComM0NoCom, BswMArgumentRef=ExpCanSM0StopTx, BswMArgumentRef=ExpDcmReqComNoTx0
          ExpBODY_LE1_CANRxOn: BswMLogicalOperator=BSWM_AND, direction=Rx, BswMArgumentRef=ComM0FullCom, BswMArgumentRef=ExpCanSM0AllowRx, BswMArgumentRef=ExpDcmReqComRx0
          ExpBODY_LE1_CANRxOff: BswMLogicalOperator=BSWM_OR, direction=Rx, BswMArgumentRef=ComM0NoCom, BswMArgumentRef=CanSM0NoCom, BswMArgumentRef=ExpDcmReqComNoRx0
          ExpNvMReadAllFinished: BswMLogicalOperator=BSWM_OR, direction=, BswMArgumentRef=NvMReadAllOK, BswMArgumentRef=NvMReadAllNotOK
          ExpNvMWriteAllFinished: BswMLogicalOperator=BSWM_OR, direction=, BswMArgumentRef=NvMWriteAllOK, BswMArgumentRef=NvMWriteAllNotOK
        28 x BswMModeCondition, all with BswMConditionType=BSWM_EQUALS, UserDefine=false:
          SysStateInit_Core0: BswMConditionMode=BswMArbitration/SysState_Core0
            BswMConditionValue
              BswMBswMode: RequestedModeSelect=, BswMBswRequestedMode=BSWM_GENERIC_MODE_INIT
          SysStateWakeup_Core0: BswMConditionMode=BswMArbitration/SysState_Core0
            BswMConditionValue
              BswMBswMode: RequestedModeSelect=, BswMBswRequestedMode=BSWM_GENERIC_MODE_WAKEUP
          SysStateReadNvM_Core0: BswMConditionMode=BswMArbitration/SysState_Core0
            BswMConditionValue
              BswMBswMode: RequestedModeSelect=, BswMBswRequestedMode=BSWM_GENERIC_MODE_READ_NVM
          SysStateAppRun_Core0: BswMConditionMode=BswMArbitration/SysState_Core0
            BswMConditionValue
              BswMBswMode: RequestedModeSelect=, BswMBswRequestedMode=BSWM_GENERIC_MODE_APP_RUN
          EcuMRequestRun: BswMConditionMode=BswMArbitration/EcuMRunRequest
            BswMConditionValue
              BswMBswMode: RequestedModeSelect=ECUM_STATE_APP_RUN, BswMBswRequestedMode=
          EcuMRequestPostRun: BswMConditionMode=BswMArbitration/EcuMRunRequest
            BswMConditionValue
              BswMBswMode: RequestedModeSelect=ECUM_STATE_APP_POST_RUN, BswMBswRequestedMode=
          EcuMRequestShutdown: BswMConditionMode=BswMArbitration/EcuMRunRequest
            BswMConditionValue
              BswMBswMode: RequestedModeSelect=ECUM_STATE_SHUTDOWN, BswMBswRequestedMode=
          CanSM0NoCom: BswMConditionMode=BswMArbitration/CanSM0Mode
            BswMConditionValue
              BswMBswMode: RequestedModeSelect=CANSM_BSWM_NO_COMMUNICATION, BswMBswRequestedMode=
          CanSM0FullCom: BswMConditionMode=BswMArbitration/CanSM0Mode
            BswMConditionValue
              BswMBswMode: RequestedModeSelect=CANSM_BSWM_FULL_COMMUNICATION, BswMBswRequestedMode=
          ComM0NoCom: BswMConditionMode=BswMArbitration/ComM0Mode
            BswMConditionValue
              BswMBswMode: RequestedModeSelect=COMM_NO_COMMUNICATION, BswMBswRequestedMode=
          ComM0FullCom: BswMConditionMode=BswMArbitration/ComM0Mode
            BswMConditionValue
              BswMBswMode: RequestedModeSelect=COMM_FULL_COMMUNICATION, BswMBswRequestedMode=
          SysStateAppPostRun_Core0: BswMConditionMode=BswMArbitration/SysState_Core0
            BswMConditionValue
              BswMBswMode: RequestedModeSelect=, BswMBswRequestedMode=BSWM_GENERIC_MODE_POST_RUN
          SysStatePrepareShutdown_Core0: BswMConditionMode=BswMArbitration/SysState_Core0
            BswMConditionValue
              BswMBswMode: RequestedModeSelect=, BswMBswRequestedMode=BSWM_GENERIC_MODE_PREP_SHUTDOWN
          SysStateWriteNvM_Core0: BswMConditionMode=BswMArbitration/SysState_Core0
            BswMConditionValue
              BswMBswMode: RequestedModeSelect=, BswMBswRequestedMode=BSWM_GENERIC_MODE_WRITE_NVM
          SysStateSleep_Core0: BswMConditionMode=BswMArbitration/SysState_Core0
            BswMConditionValue
              BswMBswMode: RequestedModeSelect=, BswMBswRequestedMode=BSWM_GENERIC_MODE_SLEEP
          TimerExpired0: BswMConditionMode=BswMArbitration/BswMTimer0
            BswMConditionValue
              BswMBswMode: RequestedModeSelect=BSWM_TIMER_EXPIRED, BswMBswRequestedMode=
          DcmReqComNoRxTx0: BswMConditionMode=BswMArbitration/DcmRequestCommunicationMode0
            BswMConditionValue
              BswMBswMode: RequestedModeSelect=DCM_DISABLE_RX_TX_NORMAL, BswMBswRequestedMode=
          DcmReqComRxTx0: BswMConditionMode=BswMArbitration/DcmRequestCommunicationMode0
            BswMConditionValue
              BswMBswMode: RequestedModeSelect=DCM_ENABLE_RX_TX_NORM, BswMBswRequestedMode=
          DcmReqComTxNoRx0: BswMConditionMode=BswMArbitration/DcmRequestCommunicationMode0
            BswMConditionValue
              BswMBswMode: RequestedModeSelect=DCM_DISABLE_RX_ENABLE_TX_NORM, BswMBswRequestedMode=
          DcmReqComRxNoTx0: BswMConditionMode=BswMArbitration/DcmRequestCommunicationMode0
            BswMConditionValue
              BswMBswMode: RequestedModeSelect=DCM_ENABLE_RX_DISABLE_TX_NORM, BswMBswRequestedMode=
          DcmReqComNmNoRxTx0: BswMConditionMode=BswMArbitration/DcmRequestCommunicationMode0
            BswMConditionValue
              BswMBswMode: RequestedModeSelect=DCM_DISABLE_RX_TX_NORM_NM, BswMBswRequestedMode=
          DcmReqComNmRxTx0: BswMConditionMode=BswMArbitration/DcmRequestCommunicationMode0
            BswMConditionValue
              BswMBswMode: RequestedModeSelect=DCM_ENABLE_RX_TX_NORM_NM, BswMBswRequestedMode=
          DcmReqComNmTxNoRx0: BswMConditionMode=BswMArbitration/DcmRequestCommunicationMode0
            BswMConditionValue
              BswMBswMode: RequestedModeSelect=DCM_DISABLE_RX_ENABLE_TX_NORM_NM, BswMBswRequestedMode=
          DcmReqComNmRxNoTx0: BswMConditionMode=BswMArbitration/DcmRequestCommunicationMode0
            BswMConditionValue
              BswMBswMode: RequestedModeSelect=DCM_ENABLE_RX_DISABLE_TX_NORM_NM, BswMBswRequestedMode=
          NvMReadAllOK: BswMConditionMode=BswMArbitration/NvMReadAllMode
            BswMConditionValue
              BswMBswMode: RequestedModeSelect=NVM_REQ_OK, BswMBswRequestedMode=
          NvMReadAllNotOK: BswMConditionMode=BswMArbitration/NvMReadAllMode
            BswMConditionValue
              BswMBswMode: RequestedModeSelect=NVM_REQ_NOT_OK, BswMBswRequestedMode=
          NvMWriteAllOK: BswMConditionMode=BswMArbitration/NvMWriteAllMode
            BswMConditionValue
              BswMBswMode: RequestedModeSelect=NVM_REQ_OK, BswMBswRequestedMode=
          NvMWriteAllNotOK: BswMConditionMode=BswMArbitration/NvMWriteAllMode
            BswMConditionValue
              BswMBswMode: RequestedModeSelect=NVM_REQ_NOT_OK, BswMBswRequestedMode=
        8 x BswMModeRequestPort, all with UserDefine=false:
          SysState_Core0: BswMRequestProcessing=BSWM_IMMEDIATE
            BswMModeRequestSource
              SysState_Core0 (BswMGenericRequest): BswMModeRequesterId=0, BswMModeRequesterLocatedInCoreID=0
            BswMModeInitValue
              BswMSwcModeInitValue: BswMSwcModeInitValueRef=BSWM_GENERIC_MODE_INIT
          EcuMRunRequest: BswMRequestProcessing=BSWM_DEFERRED
            BswMModeRequestSource
              EcuMRunRequest (BswMEcuMRUNRequestIndication): BswMEcuMRUNRequestProtocolPort=POST_RUN
            BswMModeInitValue
              BswMBswModeInitValue: InitValueSelect=ECUM_STATE_SHUTDOWN, BswMBswModeInitValueMode=
          CanSM0Mode: BswMRequestProcessing=BSWM_DEFERRED
            BswMModeRequestSource
              CanSM0Mode (BswMCanSMIndication): BswMCanSMChannelRef=CanSM_BODY_LE1_CAN
            BswMModeInitValue
              BswMBswModeInitValue: InitValueSelect=CANSM_BSWM_NO_COMMUNICATION, BswMBswModeInitValueMode=
          ComM0Mode: BswMRequestProcessing=BSWM_DEFERRED
            BswMModeRequestSource
              ComM0Mode (BswMComMIndication): BswMComMChannelRef=ComM_BODY_LE1_CAN
            BswMModeInitValue
              BswMBswModeInitValue: InitValueSelect=COMM_NO_COMMUNICATION, BswMBswModeInitValueMode=
          BswMTimer0: BswMRequestProcessing=BSWM_DEFERRED
            BswMModeRequestSource
              BswMTimer0 (BswMTimer): BswMTimerLocatedInCoreID=0
            BswMModeInitValue
              BswMBswModeInitValue: InitValueSelect=BSWM_TIMER_STOPPED, BswMBswModeInitValueMode=
          DcmRequestCommunicationMode0: BswMRequestProcessing=BSWM_DEFERRED
            BswMModeRequestSource
              DcmRequestCommunicationMode0 (BswMDcmComModeRequest): BswMDcmComMChannelRef=ComM_BODY_LE1_CAN
            BswMModeInitValue
              BswMBswModeInitValue: InitValueSelect=DCM_ENABLE_RX_TX_NORM_NM, BswMBswModeInitValueMode=
          NvMReadAllMode: BswMRequestProcessing=BSWM_IMMEDIATE
            BswMModeRequestSource
              NvMReadAllMode (BswMNvMJobModeIndication): BswMNvmService=NvmReadAll
            BswMModeInitValue
              BswMBswModeInitValue: InitValueSelect=NVM_REQ_PENDING, BswMBswModeInitValueMode=
          NvMWriteAllMode: BswMRequestProcessing=BSWM_IMMEDIATE
            BswMModeRequestSource
              NvMWriteAllMode (BswMNvMJobModeIndication): BswMNvmService=NvmWriteAll
            BswMModeInitValue
              BswMBswModeInitValue: InitValueSelect=NVM_REQ_PENDING, BswMBswModeInitValueMode=
        16 x BswMRule, all with BswMNestedExecutionOnly=false, BswMRuleInitState=BSWM_FALSE, BswMRuleLocatedInCoreID=BSWM_CORE_0, UserDefine=false:
          BswM_RuleInitBlockII_Core0: BswMRuleExpressionRef=BswMArbitration/ExpInitBlockII_Core0, BswMRuleTrueActionList=BswMModeControl/BswM_ALInitBlockII_Core0
          BswM_RuleWkupToReadNvM_Core0: BswMRuleExpressionRef=BswMArbitration/ExpWkupToReadNvM_Core0, BswMRuleTrueActionList=BswMModeControl/BswM_ALWkupToReadNvM_Core0
          BswM_RuleReadNvMToRun_Core0: BswMRuleExpressionRef=BswMArbitration/ExpReadNvMToRun_Core0, BswMRuleTrueActionList=BswMModeControl/BswM_ALReadNvMToRun_Core0
          BswM_RuleRunToPostRun_Core0: BswMRuleExpressionRef=BswMArbitration/ExpRunToPostRun_Core0, BswMRuleTrueActionList=BswMModeControl/BswM_ALRunToPostRun_Core0
          BswM_RulePostRunToRun_Core0: BswMRuleExpressionRef=BswMArbitration/ExpPostRunToRun_Core0, BswMRuleTrueActionList=BswMModeControl/BswM_ALPostRunToRun_Core0
          BswM_RulePostRunToPrep_Core0: BswMRuleExpressionRef=BswMArbitration/ExpPostRunToPrep_Core0, BswMRuleTrueActionList=BswMModeControl/BswM_ALPostRunToPrep_Core0
          BswM_RuleRunToPrep_Core0: BswMRuleExpressionRef=BswMArbitration/ExpRunToPrep_Core0, BswMRuleTrueActionList=BswMModeControl/BswM_ALRunToPrep_Core0
          BswM_RulePrepToRun_Core0: BswMRuleExpressionRef=BswMArbitration/ExpPrepToRun_Core0, BswMRuleTrueActionList=BswMModeControl/BswM_ALPrepToRun_Core0
          BswM_RulePrepToWriteNvM_Core0: BswMRuleExpressionRef=BswMArbitration/ExpPrepToWriteNvM_Core0, BswMRuleTrueActionList=BswMModeControl/BswM_ALPrepToWriteNvM_Core0
          BswM_RuleWriteNvMToRun_Core0: BswMRuleExpressionRef=BswMArbitration/ExpWriteNvMToRun_Core0, BswMRuleTrueActionList=BswMModeControl/BswM_ALPrepToRun_Core0
          BswM_RuleWriteNvMToSleep_Core0: BswMRuleExpressionRef=BswMArbitration/ExpWriteNvMToSleep_Core0, BswMRuleTrueActionList=BswMModeControl/BswM_ALWriteNvMToSleep_Core0
          BswM_RuleWkupToSleep_Core0: BswMRuleExpressionRef=BswMArbitration/ExpWkupToSleep_Core0, BswMRuleTrueActionList=BswMModeControl/BswM_ALWkupToSleep_Core0
          BswM_RuleBODY_LE1_CANTxOn: BswMRuleExpressionRef=BswMArbitration/ExpBODY_LE1_CANTxOn, BswMRuleTrueActionList=BswMModeControl/BswM_ALBODY_LE1_CANTxOn
          BswM_RuleBODY_LE1_CANTxOff: BswMRuleExpressionRef=BswMArbitration/ExpBODY_LE1_CANTxOff, BswMRuleTrueActionList=BswMModeControl/BswM_ALBODY_LE1_CANTxOff
          BswM_RuleBODY_LE1_CANRxOn: BswMRuleExpressionRef=BswMArbitration/ExpBODY_LE1_CANRxOn, BswMRuleTrueActionList=BswMModeControl/BswM_ALBODY_LE1_CANRxOn
          BswM_RuleBODY_LE1_CANRxOff: BswMRuleExpressionRef=BswMArbitration/ExpBODY_LE1_CANRxOff, BswMRuleTrueActionList=BswMModeControl/BswM_ALBODY_LE1_CANRxOff
      BswMModeControl
        30 x BswMAction, all with UserDefine=false:
          ActionInitBlockII_Core0
            BswMAvailableActions
              ActionInitBlockII_Core0 (BswMUserCallout): BswMUserCalloutFunction=BswM_InitBlockIICallout_Core0()
          ActionStartBswTask_Core0
            BswMAvailableActions
              ActionStartBswTask_Core0 (BswMUserCallout): BswMUserCalloutFunction=BswM_StartBswTaskCallout_Core0()
          ActionPostReadAll_Core0
            BswMAvailableActions
              ActionPostReadAll_Core0 (BswMUserCallout): BswMUserCalloutFunction=BswM_PostReadAllCallout_Core0()
          ActionCom0Allow
            BswMAvailableActions
              ActionCom0Allow (BswMComMAllowCom): BswMComAllowed=true, BswMComMAllowChannelRef=ComM_BODY_LE1_CAN
          ActionRteStart_Core0
            BswMAvailableActions
              ActionRteStart_Core0 (BswMRteStart)
          ActionRequestWakeup_Core0
            BswMAvailableActions
              ActionRequestWakeup_Core0 (BswMGenericRequest): BswMRequestedMode=BSWM_GENERIC_MODE_WAKEUP, BswMModeRequestPort=BswMArbitration/SysState_Core0
          ActionRequestReadNvM_Core0
            BswMAvailableActions
              ActionRequestReadNvM_Core0 (BswMGenericRequest): BswMRequestedMode=BSWM_GENERIC_MODE_READ_NVM, BswMModeRequestPort=BswMArbitration/SysState_Core0
          ActionRequestAppRun_Core0
            BswMAvailableActions
              ActionRequestAppRun_Core0 (BswMGenericRequest): BswMRequestedMode=BSWM_GENERIC_MODE_APP_RUN, BswMModeRequestPort=BswMArbitration/SysState_Core0
          ActionSetEcuMRun
            BswMAvailableActions
              ActionSetEcuMRun (BswMEcuMStateSwitch): BswMEcuMState=RUN
          ActionSetEcuMAppRun
            BswMAvailableActions
              ActionSetEcuMAppRun (BswMEcuMStateSwitch): BswMEcuMState=APP_RUN
          ActionPreShutdown_Core0
            BswMAvailableActions
              ActionPreShutdown_Core0 (BswMUserCallout): BswMUserCalloutFunction=BswM_PreShutdownCallout_Core0()
          ActionWakeupToSleep_Core0
            BswMAvailableActions
              ActionWakeupToSleep_Core0 (BswMUserCallout): BswMUserCalloutFunction=BswM_WakeupToSleepCallout_Core0()
          ActionWriteNvMToSleep_Core0
            BswMAvailableActions
              ActionWriteNvMToSleep_Core0 (BswMUserCallout): BswMUserCalloutFunction=BswM_WriteNvMToSleepCallout_Core0()
          ActionClearWakeupEvent_Core0
            BswMAvailableActions
              ActionClearWakeupEvent_Core0 (BswMUserCallout): BswMUserCalloutFunction=BswM_ClearWakeupEventCallout_Core0()
          ActionRteStop_Core0
            BswMAvailableActions
              ActionRteStop_Core0 (BswMRteStop)
          ActionRequestAppPostRun_Core0
            BswMAvailableActions
              ActionRequestAppPostRun_Core0 (BswMGenericRequest): BswMRequestedMode=BSWM_GENERIC_MODE_POST_RUN, BswMModeRequestPort=BswMArbitration/SysState_Core0
          ActionRequestPrepareShutdown_Core0
            BswMAvailableActions
              ActionRequestPrepareShutdown_Core0 (BswMGenericRequest): BswMRequestedMode=BSWM_GENERIC_MODE_PREP_SHUTDOWN, BswMModeRequestPort=BswMArbitration/SysState_Core0
          ActionRequestWriteNvM_Core0
            BswMAvailableActions
              ActionRequestWriteNvM_Core0 (BswMGenericRequest): BswMRequestedMode=BSWM_GENERIC_MODE_WRITE_NVM, BswMModeRequestPort=BswMArbitration/SysState_Core0
          ActionRequestSleep_Core0
            BswMAvailableActions
              ActionRequestSleep_Core0 (BswMGenericRequest): BswMRequestedMode=BSWM_GENERIC_MODE_SLEEP, BswMModeRequestPort=BswMArbitration/SysState_Core0
          ActionSetTimerAppRunDelay_Core0
            BswMAvailableActions
              ActionSetTimerAppRunDelay_Core0 (BswMSetTimer): BswMTimerAction=BSWM_TIMER_START, BswMTimerValue=10, BswMTimerRef=BswMModeRequestSource/BswMTimer0
          ActionSetTimerWakeUpDelay_Core0
            BswMAvailableActions
              ActionSetTimerWakeUpDelay_Core0 (BswMSetTimer): BswMTimerAction=BSWM_TIMER_START, BswMTimerValue=0, BswMTimerRef=BswMModeRequestSource/BswMTimer0
          ActionStopTimer_Core0
            BswMAvailableActions
              ActionStopTimer_Core0 (BswMSetTimer): BswMTimerAction=BSWM_TIMER_STOP, BswMTimerValue=0, BswMTimerRef=BswMModeRequestSource/BswMTimer0
          ActionSetEcuMAppPostRun
            BswMAvailableActions
              ActionSetEcuMAppPostRun (BswMEcuMStateSwitch): BswMEcuMState=APP_POST_RUN
          ActionSetEcuMSleep
            BswMAvailableActions
              ActionSetEcuMSleep (BswMEcuMStateSwitch): BswMEcuMState=SLEEP
          ActionBODY_LE1_CANTxOn
            BswMAvailableActions
              ActionBODY_LE1_CANTxOn (BswMPduGroupSwitch): BswMPduGroupSwitchReinit=false, BswMEnabledPduGroupRef=BODY_LE1_CANTx
          ActionBODY_LE1_CANTxOff
            BswMAvailableActions
              ActionBODY_LE1_CANTxOff (BswMPduGroupSwitch): BswMPduGroupSwitchReinit=false, BswMDisabledPduGroupRef=BODY_LE1_CANTx
          ActionBODY_LE1_CANRxOn
            BswMAvailableActions
              ActionBODY_LE1_CANRxOn (BswMPduGroupSwitch): BswMPduGroupSwitchReinit=false, BswMEnabledPduGroupRef=BODY_LE1_CANRx
          ActionBODY_LE1_CANRxOff
            BswMAvailableActions
              ActionBODY_LE1_CANRxOff (BswMPduGroupSwitch): BswMPduGroupSwitchReinit=false, BswMDisabledPduGroupRef=BODY_LE1_CANRx
          ActionReadAll_Core0
            BswMAvailableActions
              ActionReadAll_Core0 (BswMUserCallout): BswMUserCalloutFunction=BswM_NvMReadAllCallout_Core0()
          ActionWriteAll_Core0
            BswMAvailableActions
              ActionWriteAll_Core0 (BswMUserCallout): BswMUserCalloutFunction=BswM_NvMWriteAllCallout_Core0()
        15 x BswMActionList, all with BswMActionListPriority=0, UserDefine=false:
          BswM_ALInitBlockII_Core0: BswMActionListExecution=BSWM_CONDITION
            6 x BswMActionListItem, all with BswMAbortOnFail=false, BswMErrorIdEnable=false, UserDefine=false:
              ActionInitBlockII_Core0: BswMActionListItemIndex=0, BswMActionListItemRef=BswMModeControl/ActionInitBlockII_Core0
              ActionSetTimerWakeUpDelay_Core0: BswMActionListItemIndex=1, BswMActionListItemRef=BswMModeControl/ActionSetTimerWakeUpDelay_Core0
              ActionRequestWakeup_Core0: BswMActionListItemIndex=2, BswMActionListItemRef=BswMModeControl/ActionRequestWakeup_Core0
              ActionSetEcuMRun: BswMActionListItemIndex=3, BswMActionListItemRef=BswMModeControl/ActionSetEcuMRun
              ActionCom0Allow: BswMActionListItemIndex=4, BswMActionListItemRef=BswMModeControl/ActionCom0Allow
              ActionStartBswTask_Core0: BswMActionListItemIndex=5, BswMActionListItemRef=BswMModeControl/ActionStartBswTask_Core0
          BswM_ALWkupToReadNvM_Core0: BswMActionListExecution=BSWM_TRIGGER
            3 x BswMActionListItem, all with BswMAbortOnFail=false, BswMErrorIdEnable=false, UserDefine=false:
              ActionStopTimer_Core0: BswMActionListItemIndex=0, BswMActionListItemRef=BswMModeControl/ActionStopTimer_Core0
              ActionRequestReadNvM_Core0: BswMActionListItemIndex=1, BswMActionListItemRef=BswMModeControl/ActionRequestReadNvM_Core0
              ActionReadAll_Core0: BswMActionListItemIndex=2, BswMActionListItemRef=BswMModeControl/ActionReadAll_Core0
          BswM_ALReadNvMToRun_Core0: BswMActionListExecution=BSWM_TRIGGER
            5 x BswMActionListItem, all with BswMAbortOnFail=false, BswMErrorIdEnable=false, UserDefine=false:
              ActionPostReadAll_Core0: BswMActionListItemIndex=0, BswMActionListItemRef=BswMModeControl/ActionPostReadAll_Core0
              ActionSetTimerAppRunDelay_Core0: BswMActionListItemIndex=1, BswMActionListItemRef=BswMModeControl/ActionSetTimerAppRunDelay_Core0
              ActionRequestAppRun_Core0: BswMActionListItemIndex=2, BswMActionListItemRef=BswMModeControl/ActionRequestAppRun_Core0
              ActionSetEcuMAppRun: BswMActionListItemIndex=3, BswMActionListItemRef=BswMModeControl/ActionSetEcuMAppRun
              ActionRteStart_Core0: BswMActionListItemIndex=4, BswMActionListItemRef=BswMModeControl/ActionRteStart_Core0
          BswM_ALRunToPostRun_Core0: BswMActionListExecution=BSWM_TRIGGER
            ActionRequestAppPostRun_Core0 (BswMActionListItem):
              BswMAbortOnFail = false
              BswMActionListItemIndex = 0
              BswMErrorIdEnable = false
              UserDefine = false
              BswMActionListItemRef = BswMModeControl/ActionRequestAppPostRun_Core0
            ActionSetEcuMAppPostRun (BswMActionListItem):
              BswMAbortOnFail = false
              BswMActionListItemIndex = 1
              BswMErrorIdEnable = false
              UserDefine = false
              BswMActionListItemRef = BswMModeControl/ActionSetEcuMAppPostRun
          BswM_ALPostRunToRun_Core0: BswMActionListExecution=BSWM_TRIGGER
            3 x BswMActionListItem, all with BswMAbortOnFail=false, BswMErrorIdEnable=false, UserDefine=false:
              ActionSetTimerAppRunDelay_Core0: BswMActionListItemIndex=0, BswMActionListItemRef=BswMModeControl/ActionSetTimerAppRunDelay_Core0
              ActionSetEcuMAppRun: BswMActionListItemIndex=1, BswMActionListItemRef=BswMModeControl/ActionSetEcuMAppRun
              ActionRequestAppRun_Core0: BswMActionListItemIndex=2, BswMActionListItemRef=BswMModeControl/ActionRequestAppRun_Core0
          BswM_ALPrepToRun_Core0: BswMActionListExecution=BSWM_TRIGGER
            4 x BswMActionListItem, all with BswMAbortOnFail=false, BswMErrorIdEnable=false, UserDefine=false:
              ActionSetTimerAppRunDelay_Core0: BswMActionListItemIndex=0, BswMActionListItemRef=BswMModeControl/ActionSetTimerAppRunDelay_Core0
              ActionSetEcuMAppRun: BswMActionListItemIndex=1, BswMActionListItemRef=BswMModeControl/ActionSetEcuMAppRun
              ActionRequestAppRun_Core0: BswMActionListItemIndex=2, BswMActionListItemRef=BswMModeControl/ActionRequestAppRun_Core0
              ActionRteStart_Core0: BswMActionListItemIndex=3, BswMActionListItemRef=BswMModeControl/ActionRteStart_Core0
          BswM_ALPostRunToPrep_Core0: BswMActionListExecution=BSWM_TRIGGER
            3 x BswMActionListItem, all with BswMAbortOnFail=false, BswMErrorIdEnable=false, UserDefine=false:
              ActionRequestPrepareShutdown_Core0: BswMActionListItemIndex=0, BswMActionListItemRef=BswMModeControl/ActionRequestPrepareShutdown_Core0
              ActionPreShutdown_Core0: BswMActionListItemIndex=1, BswMActionListItemRef=BswMModeControl/ActionPreShutdown_Core0
              ActionRteStop_Core0: BswMActionListItemIndex=2, BswMActionListItemRef=BswMModeControl/ActionRteStop_Core0
          BswM_ALRunToPrep_Core0: BswMActionListExecution=BSWM_TRIGGER
            3 x BswMActionListItem, all with BswMAbortOnFail=false, BswMErrorIdEnable=false, UserDefine=false:
              ActionRequestPrepareShutdown_Core0: BswMActionListItemIndex=0, BswMActionListItemRef=BswMModeControl/ActionRequestPrepareShutdown_Core0
              ActionPreShutdown_Core0: BswMActionListItemIndex=1, BswMActionListItemRef=BswMModeControl/ActionPreShutdown_Core0
              ActionRteStop_Core0: BswMActionListItemIndex=2, BswMActionListItemRef=BswMModeControl/ActionRteStop_Core0
          BswM_ALPrepToWriteNvM_Core0: BswMActionListExecution=BSWM_TRIGGER
            ActionRequestWriteNvM_Core0 (BswMActionListItem):
              BswMAbortOnFail = false
              BswMActionListItemIndex = 0
              BswMErrorIdEnable = false
              UserDefine = false
              BswMActionListItemRef = BswMModeControl/ActionRequestWriteNvM_Core0
            ActionWriteAll_Core0 (BswMActionListItem):
              BswMAbortOnFail = false
              BswMActionListItemIndex = 1
              BswMErrorIdEnable = false
              UserDefine = false
              BswMActionListItemRef = BswMModeControl/ActionWriteAll_Core0
          BswM_ALWriteNvMToSleep_Core0: BswMActionListExecution=BSWM_TRIGGER
            4 x BswMActionListItem, all with BswMAbortOnFail=false, BswMErrorIdEnable=false, UserDefine=false:
              ActionSetEcuMSleep: BswMActionListItemIndex=0, BswMActionListItemRef=BswMModeControl/ActionSetEcuMSleep
              ActionRequestSleep_Core0: BswMActionListItemIndex=1, BswMActionListItemRef=BswMModeControl/ActionRequestSleep_Core0
              ActionClearWakeupEvent_Core0: BswMActionListItemIndex=2, BswMActionListItemRef=BswMModeControl/ActionClearWakeupEvent_Core0
              ActionWriteNvMToSleep_Core0: BswMActionListItemIndex=3, BswMActionListItemRef=BswMModeControl/ActionWriteNvMToSleep_Core0
          BswM_ALWkupToSleep_Core0: BswMActionListExecution=BSWM_TRIGGER
            4 x BswMActionListItem, all with BswMAbortOnFail=false, BswMErrorIdEnable=false, UserDefine=false:
              ActionSetEcuMSleep: BswMActionListItemIndex=0, BswMActionListItemRef=BswMModeControl/ActionSetEcuMSleep
              ActionRequestSleep_Core0: BswMActionListItemIndex=1, BswMActionListItemRef=BswMModeControl/ActionRequestSleep_Core0
              ActionClearWakeupEvent_Core0: BswMActionListItemIndex=2, BswMActionListItemRef=BswMModeControl/ActionClearWakeupEvent_Core0
              ActionWakeupToSleep_Core0: BswMActionListItemIndex=3, BswMActionListItemRef=BswMModeControl/ActionWakeupToSleep_Core0
          BswM_ALBODY_LE1_CANTxOff: BswMActionListExecution=BSWM_TRIGGER
            ActionBODY_LE1_CANTxOff (BswMActionListItem):
              BswMAbortOnFail = false
              BswMActionListItemIndex = 0
              BswMErrorIdEnable = false
              UserDefine = false
              BswMActionListItemRef = BswMModeControl/ActionBODY_LE1_CANTxOff
          BswM_ALBODY_LE1_CANTxOn: BswMActionListExecution=BSWM_TRIGGER
            ActionBODY_LE1_CANTxOn (BswMActionListItem):
              BswMAbortOnFail = false
              BswMActionListItemIndex = 0
              BswMErrorIdEnable = false
              UserDefine = false
              BswMActionListItemRef = BswMModeControl/ActionBODY_LE1_CANTxOn
          BswM_ALBODY_LE1_CANRxOff: BswMActionListExecution=BSWM_TRIGGER
            ActionBODY_LE1_CANRxOff (BswMActionListItem):
              BswMAbortOnFail = false
              BswMActionListItemIndex = 0
              BswMErrorIdEnable = false
              UserDefine = false
              BswMActionListItemRef = BswMModeControl/ActionBODY_LE1_CANRxOff
          BswM_ALBODY_LE1_CANRxOn: BswMActionListExecution=BSWM_TRIGGER
            ActionBODY_LE1_CANRxOn (BswMActionListItem):
              BswMAbortOnFail = false
              BswMActionListItemIndex = 0
              BswMErrorIdEnable = false
              UserDefine = false
              BswMActionListItemRef = BswMModeControl/ActionBODY_LE1_CANRxOn
