AUTOSAR XML (schema 00046)
package /EAS
  ecuc definition collection AUTOSARParameterDefinition: module=Dem
  module config Dem: implementation-config-variant=STD_CONFIG_VARIANTS_POSTBUILD, module_version_def=4.2.0, module_autosar_version=Ar470
    DemGeneral:
      VersionCheck = true
      DemDebounceCounterBasedSupport = true
      DemDebounceTimeBasedSupport = true
      DemDevErrorDetect = false
      DemOBDSupport = DEM_OBD_NO_OBD_SUPPORT
      DemPTOSupport = false
      DemStatusBitStorageTestFailed = false
      DemTriggerFiMReports = false
      DemTriggerMonitorInitBeforeClearOk = false
      DemVersionInfoApi = true
      DemAgingRequieresTestedCycle = true
      DemGeneralInterfaceSupport = false
      DemResetConfirmedBitOnOverflow = true
      DemClearDTCBehavior = DEM_CLRRESP_VOLATILE
      DemEventCombinationSupport = DEM_EVCOMB_DISABLED
      DemStatusBitHandlingTestFailedSinceLastClear = DEM_STATUS_BIT_AGING_AND_DISPLACEMENT
      DemSuppressionSupport = DEM_NO_SUPPRESSION
      DemAvailabilitySupport = DEM_NO_AVAILABILITY
      DemClearDTCLimitation = DEM_ALL_SUPPORTED_DTCS
      DemDataElementDefaultEndianness = opaque
      DemBswErrorBufferSize = 8
      DemMaxNumberPrestoredFF = 0
      DemTaskTime = 10
      MaxNumCaptureDataPerMainCycle = 4
      DemHeaderFileInclusion = 
      DemCmaPlatformEnable = false
      DemNvMSupport = true
      DemDTCLastStatusSupport = false
      DemAgingRequiresNotFailedCycle = false
      DemGeneralCallbackMonitorStatusChangedFnc = 
      DemMultiCoreSupport = false
      DemCoreNumber = 1
      DemMasterCoreId = 0
      OperationCycle_DEM_IGNITION (DemOperationCycle): DemOperationCycleId=0
      OperationCycle_DEM_WARMUP (DemOperationCycle): DemOperationCycleId=1
      12 x DemEnableCondition, all with DemEnableConditionStatus=false:
        PowerVoltage_9V_16V: DemEnableConditionId=0
        ECU_ActiveStatus: DemEnableConditionId=1
        AfterPowerIGN_1s: DemEnableConditionId=2
        EnteringNetworkModeFor3s: DemEnableConditionId=3
        NotInBusoffStatus: DemEnableConditionId=4
        StopMonitoringImmediatelyWhenNotInNetworkMode: DemEnableConditionId=5
        VehState_Driving_or_DrvRdy_for_3seconds: DemEnableConditionId=6
        TheValveIStarted: DemEnableConditionId=7
        TheAirPumpIsStarted: DemEnableConditionId=8
        TheHeatorIStarted: DemEnableConditionId=9
        IGNPowerOn: DemEnableConditionId=10
        OnlyDracoHorizonVersion: DemEnableConditionId=11
      9 x DemEnableConditionGroup:
        DECG_C00B88: DemEnableConditionRef=PowerVoltage_9V_16V, DemEnableConditionRef=ECU_ActiveStatus
        DECG_800117_800116: DemEnableConditionRef=AfterPowerIGN_1s
        DECG_F3A987_F3B287_F1D387_F1D487: DemEnableConditionRef=PowerVoltage_9V_16V, DemEnableConditionRef=VehState_Driving_or_DrvRdy_for_3seconds, DemEnableConditionRef=NotInBusoffStatus
        DECG_9D0119_9D0218: DemEnableConditionRef=TheValveIStarted, DemEnableConditionRef=IGNPowerOn
        DECG_9D0319_9D0418: DemEnableConditionRef=TheAirPumpIsStarted, DemEnableConditionRef=IGNPowerOn
        DECG_9C0119_9C0218: DemEnableConditionRef=TheHeatorIStarted, DemEnableConditionRef=IGNPowerOn
        DECG_9C0311_9C0415_9D0511_9D0615: DemEnableConditionRef=IGNPowerOn
        DECG_9C0511_9C0615: DemEnableConditionRef=IGNPowerOn, DemEnableConditionRef=OnlyDracoHorizonVersion
        DECG_F13C87: DemEnableConditionRef=PowerVoltage_9V_16V, DemEnableConditionRef=EnteringNetworkModeFor3s, DemEnableConditionRef=NotInBusoffStatus, DemEnableConditionRef=StopMonitoringImmediatelyWhenNotInNetworkMode
      DemEventMemorySet_0 (DemEventMemorySet): DemMaxNumberEventEntryPermanent=0, DemTypeOfDTCSupported=DEM_DTC_TRANSLATION_ISO15031_6
        DemPrimaryMemory:
          UserDefine = false
          DemMaxNumberEventEntryPrimary = 20
          DemEventDisplacementStrategy = DEM_DISPLACEMENT_NONE
          DemEventMemoryEntryStorageTrigger = DEM_TRIGGER_ON_TEST_FAILED
          DemOccurrenceCounterProcessing = DEM_PROCESS_OCCCTR_TF
          DemTypeOfFreezeFrameRecordNumeration = DEM_FF_RECNUM_CONFIGURED
          DemDtcStatusAvailabilityMask = 0x9
          20 x DemEventEntryBlock:
            DemEventEntryBlock{0..19}: DemEventEntryBlockRef=NVM_PrimaryDataEntry_0_{0..19}
      DemClient_0 (DemClient): DemClientFunctionality=DEM_CLIENT_USES_FULL_FUNCTIONALITY, DemClientId=0, DemClientUsesRte=true, DemEventMemorySetRef=DemEventMemorySet_0
      10 x DemDataElementClass, all with UserDefine=true:
        DataElement0_OCC
          DataElement0_OCC_InternalData0 (DemInternalDataElementClass): DemInternalDataElement=DEM_OCCCTR, DemDataElementDataSize=1
        DataElement1_Year
          DataElement1_Year_ExternalCSData (DemExternalCSDataElementClass):
            DemDataElementUsePort = true
            DemDataElementReadFnc = ReadDataElement
            DemDataElementArraySize = 1
            DemDataElementDataType = UINT8
            DemDataElementProvideMonitorData = false
        DataElement2_Month
          DataElement2_Month_ExternalCSData (DemExternalCSDataElementClass):
            DemDataElementUsePort = true
            DemDataElementReadFnc = ReadDataElement
            DemDataElementArraySize = 1
            DemDataElementDataType = UINT8
            DemDataElementProvideMonitorData = false
        DataElement3_Day
          DataElement3_Day_ExternalCSData0 (DemExternalCSDataElementClass):
            DemDataElementUsePort = true
            DemDataElementReadFnc = ReadDataElement
            DemDataElementArraySize = 1
            DemDataElementDataType = UINT8
            DemDataElementProvideMonitorData = false
        DataElement4_Hour
          DataElement4_Hour_ExternalCSData0 (DemExternalCSDataElementClass):
            DemDataElementUsePort = true
            DemDataElementReadFnc = ReadDataElement
            DemDataElementArraySize = 1
            DemDataElementDataType = UINT8
            DemDataElementProvideMonitorData = false
        DataElement5_Minute
          DataElement5_Minute_ExternalCSData0 (DemExternalCSDataElementClass):
            DemDataElementUsePort = true
            DemDataElementReadFnc = ReadDataElement
            DemDataElementArraySize = 1
            DemDataElementDataType = UINT8
            DemDataElementProvideMonitorData = false
        DataElement6_Second
          DataElement6_Second_ExternalCSData0 (DemExternalCSDataElementClass):
            DemDataElementUsePort = true
            DemDataElementReadFnc = ReadDataElement
            DemDataElementArraySize = 1
            DemDataElementDataType = UINT8
            DemDataElementProvideMonitorData = false
        DataElement7_Odometer
          DataElement7_Odometer_ExternalCSData0 (DemExternalCSDataElementClass):
            DemDataElementUsePort = true
            DemDataElementReadFnc = ReadDataElement
            DemDataElementArraySize = 3
            DemDataElementDataType = UINT8_N
            DemDataElementProvideMonitorData = false
        DataElement8_LV_Battery_Voltage
          DataElement8_LV_Battery_Voltage_ExternalCSData0 (DemExternalCSDataElementClass):
            DemDataElementUsePort = true
            DemDataElementReadFnc = ReadDataElement
            DemDataElementArraySize = 1
            DemDataElementDataType = UINT8
            DemDataElementProvideMonitorData = false
        DataElement9_VehicleSpeed
          DataElement9_VehicleSpeed_ExternalCSData0 (DemExternalCSDataElementClass):
            DemDataElementUsePort = true
            DemDataElementReadFnc = ReadDataElement
            DemDataElementArraySize = 2
            DemDataElementDataType = UINT8_N
            DemDataElementProvideMonitorData = false
      DemExtendedDataRecordClass0 (DemExtendedDataRecordClass):
        DemExtendedDataRecordNumber = 0x1
        DemExtendedDataRecordUpdate = DEM_UPDATE_RECORD_NO
        DemExtendedDataRecordTrigger = DEM_TRIGGER_ON_CONFIRMED
        UserDefine = true
        DemDataElementClassRef = DataElement0_OCC_InternalData0
        DemDataElementClassRef = DataElement1_Year_ExternalCSData
        DemDataElementClassRef = DataElement2_Month_ExternalCSData
        DemDataElementClassRef = DataElement3_Day_ExternalCSData0
        DemDataElementClassRef = DataElement4_Hour_ExternalCSData0
        DemDataElementClassRef = DataElement5_Minute_ExternalCSData0
        DemDataElementClassRef = DataElement6_Second_ExternalCSData0
        DemDataElementClassRef = DataElement7_Odometer_ExternalCSData0
        DemDataElementClassRef = DataElement8_LV_Battery_Voltage_ExternalCSData0
        DemDataElementClassRef = DataElement9_VehicleSpeed_ExternalCSData0
      DemExtendedDataClass0 (DemExtendedDataClass): DemExtendedDataRecordClassRef=DemExtendedDataRecordClass0
      NVM_BLOCKID (DemNvRamBlockId): DemNvRamBlockIdRef=NVM_Dem_StorageMem
      DemGeneralJ1939:
        DemJ1939ClearDtcSupport = false
        DemJ1939Dm31Support = false
        DemJ1939ExpandedFreezeFrameSupport = false
        DemJ1939FreezeFrameSupport = false
        DemJ1939RatioSupport = false
        DemJ1939Readiness{1..3}Support = false
        DemJ1939ReadingDtcSupport = false
        DTCStatus (DemCallbackJ1939DTCStatusChanged): DemCallbackDTCStatusChangedFnc=CallbackDTCStatusChange
      DemGeneralOBD:
        UserDefine = false
        DemOBDCentralizedPID21Handling = false
        DemOBDCentralizedPID31Handling = false
        DemOBDCompliancy = 0
        DemOBDEngineType = DEM_IGNITION_COMPRESSION
        DemOBDEventDisplacement = false
        DemSupportedObdUdsDtcSeparation = false
        DemOBDDelayedDCYConfirmedAndMIL = false
    Cfg_D (DemConfigSet): UserDefine=false
      DemDTCClassTable_0 (DemDTC)
        20 x DemDTCRow, all with DemDTCSeverity=DEM_SEVERITY_NO_SEVERITY, DemDTCFunctionalUnit=0, DemWWHOBDDTCClass=DEM_DTC_WWHOBD_CLASS_C, DemNvStorageStrategy=DURING_SHUTDOWN, UserDefine=false:
          DTC_0x800116: DemDtcValue=0x800116, DemDTCAttributesRef=Cfg_D/DemDTCAttribute_0
          DTC_0x800117: DemDtcValue=0x800117, DemDTCAttributesRef=Cfg_D/DemDTCAttribute_0
          DTC_0x9C0119: DemDtcValue=0x9C0119, DemDTCAttributesRef=Cfg_D/DemDTCAttribute_0
          DTC_0x9C0218: DemDtcValue=0x9C0218, DemDTCAttributesRef=Cfg_D/DemDTCAttribute_0
          DTC_0x9C0311: DemDtcValue=0x9C0311, DemDTCAttributesRef=Cfg_D/DemDTCAttribute_0
          DTC_0x9C0415: DemDtcValue=0x9C0415, DemDTCAttributesRef=Cfg_D/DemDTCAttribute_0
          DTC_0x9C0511: DemDtcValue=0x9C0511, DemDTCAttributesRef=Cfg_D/DemDTCAttribute_0
          DTC_0x9C0615: DemDtcValue=0x9C0615, DemDTCAttributesRef=Cfg_D/DemDTCAttribute_0
          DTC_0x9D0119: DemDtcValue=0x9D0119, DemDTCAttributesRef=Cfg_D/DemDTCAttribute_0
          DTC_0x9D0218: DemDtcValue=0x9D0218, DemDTCAttributesRef=Cfg_D/DemDTCAttribute_0
          DTC_0x9D0319: DemDtcValue=0x9D0319, DemDTCAttributesRef=Cfg_D/DemDTCAttribute_0
          DTC_0x9D0418: DemDtcValue=0x9D0418, DemDTCAttributesRef=Cfg_D/DemDTCAttribute_0
          DTC_0x9D0511: DemDtcValue=0x9D0511, DemDTCAttributesRef=Cfg_D/DemDTCAttribute_0
          DTC_0x9D0615: DemDtcValue=0x9D0615, DemDTCAttributesRef=Cfg_D/DemDTCAttribute_0
          DTC_0xC00B88: DemDtcValue=0xC00B88, DemDTCAttributesRef=Cfg_D/DemDTCAttribute_0
          DTC_0xF13C87: DemDtcValue=0xF13C87, DemDTCAttributesRef=Cfg_D/DemDTCAttribute_0
          DTC_0xF1D187: DemDtcValue=0xF1D187, DemDTCAttributesRef=Cfg_D/DemDTCAttributes1
          DTC_0xF1D287: DemDtcValue=0xF1D287, DemDTCAttributesRef=Cfg_D/DemDTCAttributes1
          DTC_0xF3A987: DemDtcValue=0xF3A987, DemDTCAttributesRef=Cfg_D/DemDTCAttribute_0
          DTC_0xF3B287: DemDtcValue=0xF3B287, DemDTCAttributesRef=Cfg_D/DemDTCAttribute_0
      DemDTCAttribute_0 (DemDTCAttributes):
        DemDTCSignificance = FAULT
        DemAgingCycleCounterThreshold = 40
        DemAgingCycleCounterThresholdForTFSLC = 1
        DemDTCPriority = 1
        DemMaxNumberFreezeFrameRecords = 0
        DemAgingCycleRef = OperationCycle_DEM_IGNITION
        DemExtendedDataClassRef = DemExtendedDataClass0
        DemMemoryDestinationRef = DemPrimaryMemory
      DemDTCAttributes1 (DemDTCAttributes):
        DemDTCSignificance = FAULT
        DemAgingCycleCounterThreshold = 40
        DemAgingCycleCounterThresholdForTFSLC = 1
        DemDTCPriority = 1
        DemMaxNumberFreezeFrameRecords = 0
        DemAgingCycleRef = OperationCycle_DEM_WARMUP
        DemExtendedDataClassRef = DemExtendedDataClass0
        DemMemoryDestinationRef = DemPrimaryMemory
      DemEventParameterTable_0 (DemEventParameter)
        20 x DemEventParameterRow, all with DemEventAvailable=true, DemFFPrestorageSupported=false, DemEventKind=DEM_EVENT_KIND_SWC, DemReportBehavior=REPORT_AFTER_INIT, DemComponentPriority=0, CallbackClearEventAllowedEnable=false, CallbackInitMForEEnable=false, CallbackEventDataChangedEnable=false, CallbackEventUdsStatusChangedEnable=false, CallbackMonitorStatusChangedEnable=false, DemEventConfirmationThreshold=1, DemCausalityDelayTime=0, DemEventRecoverableInSameOperationCycle=true, DemFFPrestorageInNvm=false, DemEventReportingType=STANDARD_REPORTING, DemEventAvailableInVariant=true, DemEventAssociatedIdentification=0, DemEventConfirmationThresholdCounterAdaptable=false, DemOperationCycleRef=OperationCycle_DEM_IGNITION:
          Event_0x800116: DemEventId=0, DemDTCRef=DemDTCClassTable_0/DTC_0x800116, DemEnableConditionGroupRef=DECG_800117_800116
            DemDebounceAlgorithmClass: DemCallbackGetFDCFnc=false, DemDebounceTimeBaseRef=Cfg_D/DemDebounceTimeBaseClass1_1000ms_1000ms
          Event_0x800117: DemEventId=1, DemDTCRef=DemDTCClassTable_0/DTC_0x800117, DemEnableConditionGroupRef=DECG_800117_800116
            DemDebounceAlgorithmClass: DemCallbackGetFDCFnc=false, DemDebounceTimeBaseRef=Cfg_D/DemDebounceTimeBaseClass1_1000ms_1000ms
          Event_0x9C0119: DemEventId=2, DemDTCRef=DemDTCClassTable_0/DTC_0x9C0119, DemEnableConditionGroupRef=DECG_9D0119_9D0218
            DemDebounceAlgorithmClass: DemCallbackGetFDCFnc=false, DemDebounceTimeBaseRef=Cfg_D/DemDebounceTimeBaseClass2_1000ms_0ms
          Event_0x9C0218: DemEventId=3, DemDTCRef=DemDTCClassTable_0/DTC_0x9C0218, DemEnableConditionGroupRef=DECG_9D0119_9D0218
            DemDebounceAlgorithmClass: DemCallbackGetFDCFnc=false, DemDebounceTimeBaseRef=Cfg_D/DemDebounceTimeBaseClass3_1000ms_2000ms
          Event_0x9C0311: DemEventId=4, DemDTCRef=DemDTCClassTable_0/DTC_0x9C0311, DemEnableConditionGroupRef=DECG_9C0311_9C0415_9D0511_9D0615
            DemDebounceAlgorithmClass: DemCallbackGetFDCFnc=false, DemDebounceTimeBaseRef=Cfg_D/DemDebounceTimeBaseClass4_40000ms_2000ms
          Event_0x9C0415: DemEventId=5, DemDTCRef=DemDTCClassTable_0/DTC_0x9C0415, DemEnableConditionGroupRef=DECG_9C0311_9C0415_9D0511_9D0615
            DemDebounceAlgorithmClass: DemCallbackGetFDCFnc=false, DemDebounceTimeBaseRef=Cfg_D/DemDebounceTimeBaseClass4_40000ms_2000ms
          Event_0x9C0511: DemEventId=6, DemDTCRef=DemDTCClassTable_0/DTC_0x9C0511, DemEnableConditionGroupRef=DECG_9C0311_9C0415_9D0511_9D0615
            DemDebounceAlgorithmClass: DemCallbackGetFDCFnc=false, DemDebounceTimeBaseRef=Cfg_D/DemDebounceTimeBaseClass5_0ms_2000ms
          Event_0x9C0615: DemEventId=7, DemDTCRef=DemDTCClassTable_0/DTC_0x9C0615, DemEnableConditionGroupRef=DECG_9C0311_9C0415_9D0511_9D0615
            DemDebounceAlgorithmClass: DemCallbackGetFDCFnc=false, DemDebounceTimeBaseRef=Cfg_D/DemDebounceTimeBaseClass5_0ms_2000ms
          Event_0x9D0119: DemEventId=8, DemDTCRef=DemDTCClassTable_0/DTC_0x9D0119, DemEnableConditionGroupRef=DECG_9D0119_9D0218
            DemDebounceAlgorithmClass: DemCallbackGetFDCFnc=false, DemDebounceTimeBaseRef=Cfg_D/DemDebounceTimeBaseClass2_1000ms_0ms
          Event_0x9D0218: DemEventId=9, DemDTCRef=DemDTCClassTable_0/DTC_0x9D0218, DemEnableConditionGroupRef=DECG_9D0119_9D0218
            DemDebounceAlgorithmClass: DemCallbackGetFDCFnc=false, DemDebounceTimeBaseRef=Cfg_D/DemDebounceTimeBaseClass2_1000ms_0ms
          Event_0x9D0319: DemEventId=10, DemDTCRef=DemDTCClassTable_0/DTC_0x9D0319, DemEnableConditionGroupRef=DECG_9D0319_9D0418
            DemDebounceAlgorithmClass: DemCallbackGetFDCFnc=false, DemDebounceTimeBaseRef=Cfg_D/DemDebounceTimeBaseClass2_1000ms_0ms
          Event_0x9D0418: DemEventId=11, DemDTCRef=DemDTCClassTable_0/DTC_0x9D0418, DemEnableConditionGroupRef=DECG_9D0319_9D0418
            DemDebounceAlgorithmClass: DemCallbackGetFDCFnc=false, DemDebounceTimeBaseRef=Cfg_D/DemDebounceTimeBaseClass2_1000ms_0ms
          Event_0x9D0511: DemEventId=12, DemDTCRef=DemDTCClassTable_0/DTC_0x9D0511, DemEnableConditionGroupRef=DECG_9C0511_9C0615
            DemDebounceAlgorithmClass: DemCallbackGetFDCFnc=true
          Event_0x9D0615: DemEventId=13, DemDTCRef=DemDTCClassTable_0/DTC_0x9D0615, DemEnableConditionGroupRef=DECG_9C0511_9C0615
            DemDebounceAlgorithmClass: DemCallbackGetFDCFnc=true
          Event_0xC00B88: DemEventId=14, DemDTCRef=DemDTCClassTable_0/DTC_0xC00B88, DemEnableConditionGroupRef=DECG_C00B88
            DemDebounceAlgorithmClass: DemCallbackGetFDCFnc=false, DemDebounceTimeBaseRef=Cfg_D/DemDebounceTimeBaseClass0_250ms_0ms
          Event_0xF13C87: DemEventId=15, DemDTCRef=DemDTCClassTable_0/DTC_0xF13C87, DemEnableConditionGroupRef=DECG_F13C87
            DemDebounceAlgorithmClass: DemCallbackGetFDCFnc=true
          Event_0xF1D187: DemEventId=16, DemDTCRef=DTC_0xF1D187, DemEnableConditionGroupRef=DECG_F3A987_F3B287_F1D387_F1D487
            DemDebounceAlgorithmClass: DemCallbackGetFDCFnc=true
          Event_0xF1D287: DemEventId=17, DemDTCRef=DTC_0xF1D287, DemEnableConditionGroupRef=DECG_F3A987_F3B287_F1D387_F1D487
            DemDebounceAlgorithmClass: DemCallbackGetFDCFnc=true
          Event_0xF3A987: DemEventId=18, DemDTCRef=DemDTCClassTable_0/DTC_0xF3A987, DemEnableConditionGroupRef=DECG_F3A987_F3B287_F1D387_F1D487
            DemDebounceAlgorithmClass: DemCallbackGetFDCFnc=true
          Event_0xF3B287: DemEventId=19, DemDTCRef=DemDTCClassTable_0/DTC_0xF3B287, DemEnableConditionGroupRef=DECG_F3A987_F3B287_F1D387_F1D487
            DemDebounceAlgorithmClass: DemCallbackGetFDCFnc=true
      6 x DemDebounceTimeBaseClass, all with DemDebounceBehavior=DEM_DEBOUNCE_FREEZE:
        DemDebounceTimeBaseClass0_250ms_0ms: DemDebounceTimeFailedThreshold=250, DemDebounceTimePassedThreshold=10, DemTimeBasedFdcThresholdStorageValue=250
        DemDebounceTimeBaseClass1_1000ms_1000ms: DemDebounceTimeFailedThreshold=1000, DemDebounceTimePassedThreshold=1000, DemTimeBasedFdcThresholdStorageValue=1000
        DemDebounceTimeBaseClass2_1000ms_0ms: DemDebounceTimeFailedThreshold=1000, DemDebounceTimePassedThreshold=10, DemTimeBasedFdcThresholdStorageValue=1000
        DemDebounceTimeBaseClass3_1000ms_2000ms: DemDebounceTimeFailedThreshold=1000, DemDebounceTimePassedThreshold=2000, DemTimeBasedFdcThresholdStorageValue=1000
        DemDebounceTimeBaseClass4_40000ms_2000ms: DemDebounceTimeFailedThreshold=40000, DemDebounceTimePassedThreshold=2000, DemTimeBasedFdcThresholdStorageValue=40000
        DemDebounceTimeBaseClass5_0ms_2000ms: DemDebounceTimeFailedThreshold=10, DemDebounceTimePassedThreshold=2000, DemTimeBasedFdcThresholdStorageValue=10
    Cfg_P (DemConfigSet): UserDefine=false
      DemDTCClassTable_0 (DemDTC)
        20 x DemDTCRow, all with DemDTCSeverity=DEM_SEVERITY_NO_SEVERITY, DemDTCFunctionalUnit=0, DemWWHOBDDTCClass=DEM_DTC_WWHOBD_CLASS_C, DemNvStorageStrategy=DURING_SHUTDOWN, UserDefine=false:
          DTC_0x800116: DemDtcValue=0x800116, DemDTCAttributesRef=Cfg_P/DemDTCAttribute_0
          DTC_0x800117: DemDtcValue=0x800117, DemDTCAttributesRef=Cfg_P/DemDTCAttribute_0
          DTC_0x9C0119: DemDtcValue=0x9C0119, DemDTCAttributesRef=Cfg_P/DemDTCAttribute_0
          DTC_0x9C0218: DemDtcValue=0x9C0218, DemDTCAttributesRef=Cfg_P/DemDTCAttribute_0
          DTC_0x9C0311: DemDtcValue=0x9C0311, DemDTCAttributesRef=Cfg_P/DemDTCAttribute_0
          DTC_0x9C0415: DemDtcValue=0x9C0415, DemDTCAttributesRef=Cfg_P/DemDTCAttribute_0
          DTC_0x9C0511: DemDtcValue=0x9C0511, DemDTCAttributesRef=Cfg_P/DemDTCAttribute_0
          DTC_0x9C0615: DemDtcValue=0x9C0615, DemDTCAttributesRef=Cfg_P/DemDTCAttribute_0
          DTC_0x9D0119: DemDtcValue=0x9D0119, DemDTCAttributesRef=Cfg_P/DemDTCAttribute_0
          DTC_0x9D0218: DemDtcValue=0x9D0218, DemDTCAttributesRef=Cfg_P/DemDTCAttribute_0
          DTC_0x9D0319: DemDtcValue=0x9D0319, DemDTCAttributesRef=Cfg_P/DemDTCAttribute_0
          DTC_0x9D0418: DemDtcValue=0x9D0418, DemDTCAttributesRef=Cfg_P/DemDTCAttribute_0
          DTC_0x9D0511: DemDtcValue=0x9D0511, DemDTCAttributesRef=Cfg_P/DemDTCAttribute_0
          DTC_0x9D0615: DemDtcValue=0x9D0615, DemDTCAttributesRef=Cfg_P/DemDTCAttribute_0
          DTC_0xC00B88: DemDtcValue=0xC00B88, DemDTCAttributesRef=Cfg_P/DemDTCAttribute_0
          DTC_0xF13C87: DemDtcValue=0xF13C87, DemDTCAttributesRef=Cfg_P/DemDTCAttribute_0
          DTC_0xF1D387: DemDtcValue=0xF1D387, DemDTCAttributesRef=Cfg_P/DemDTCAttributes1
          DTC_0xF1D487: DemDtcValue=0xF1D487, DemDTCAttributesRef=Cfg_P/DemDTCAttributes1
          DTC_0xF3A987: DemDtcValue=0xF3A987, DemDTCAttributesRef=Cfg_P/DemDTCAttribute_0
          DTC_0xF3B287: DemDtcValue=0xF3B287, DemDTCAttributesRef=Cfg_P/DemDTCAttribute_0
      DemDTCAttribute_0 (DemDTCAttributes):
        DemDTCSignificance = FAULT
        DemAgingCycleCounterThreshold = 40
        DemAgingCycleCounterThresholdForTFSLC = 1
        DemDTCPriority = 1
        DemMaxNumberFreezeFrameRecords = 0
        DemAgingCycleRef = OperationCycle_DEM_IGNITION
        DemExtendedDataClassRef = DemExtendedDataClass0
        DemMemoryDestinationRef = DemPrimaryMemory
      DemDTCAttributes1 (DemDTCAttributes):
        DemDTCSignificance = FAULT
        DemAgingCycleCounterThreshold = 40
        DemAgingCycleCounterThresholdForTFSLC = 1
        DemDTCPriority = 1
        DemMaxNumberFreezeFrameRecords = 0
        DemAgingCycleRef = OperationCycle_DEM_WARMUP
        DemExtendedDataClassRef = DemExtendedDataClass0
        DemMemoryDestinationRef = DemPrimaryMemory
      DemEventParameterTable_0 (DemEventParameter)
        20 x DemEventParameterRow, all with DemEventAvailable=true, DemFFPrestorageSupported=false, DemEventKind=DEM_EVENT_KIND_SWC, DemReportBehavior=REPORT_AFTER_INIT, DemComponentPriority=0, CallbackClearEventAllowedEnable=false, CallbackInitMForEEnable=false, CallbackEventDataChangedEnable=false, CallbackEventUdsStatusChangedEnable=false, CallbackMonitorStatusChangedEnable=false, DemEventConfirmationThreshold=1, DemCausalityDelayTime=0, DemEventRecoverableInSameOperationCycle=true, DemFFPrestorageInNvm=false, DemEventReportingType=STANDARD_REPORTING, DemEventAvailableInVariant=true, DemEventAssociatedIdentification=0, DemEventConfirmationThresholdCounterAdaptable=false, DemOperationCycleRef=OperationCycle_DEM_IGNITION:
          Event_0x800116: DemEventId=0, DemDTCRef=DemDTCClassTable_0/DTC_0x800116, DemEnableConditionGroupRef=DECG_800117_800116
            DemDebounceAlgorithmClass: DemCallbackGetFDCFnc=false, DemDebounceTimeBaseRef=Cfg_P/DemDebounceTimeBaseClass1_1000ms_1000ms
          Event_0x800117: DemEventId=1, DemDTCRef=DemDTCClassTable_0/DTC_0x800117, DemEnableConditionGroupRef=DECG_800117_800116
            DemDebounceAlgorithmClass: DemCallbackGetFDCFnc=false, DemDebounceTimeBaseRef=Cfg_P/DemDebounceTimeBaseClass1_1000ms_1000ms
          Event_0x9C0119: DemEventId=2, DemDTCRef=DemDTCClassTable_0/DTC_0x9C0119, DemEnableConditionGroupRef=DECG_9C0119_9C0218
            DemDebounceAlgorithmClass: DemCallbackGetFDCFnc=false, DemDebounceTimeBaseRef=Cfg_P/DemDebounceTimeBaseClass2_1000ms_0ms
          Event_0x9C0218: DemEventId=3, DemDTCRef=DemDTCClassTable_0/DTC_0x9C0218, DemEnableConditionGroupRef=DECG_9C0119_9C0218
            DemDebounceAlgorithmClass: DemCallbackGetFDCFnc=false, DemDebounceTimeBaseRef=Cfg_P/DemDebounceTimeBaseClass3_1000ms_2000ms
          Event_0x9C0311: DemEventId=4, DemDTCRef=DemDTCClassTable_0/DTC_0x9C0311, DemEnableConditionGroupRef=DECG_9C0311_9C0415_9D0511_9D0615
            DemDebounceAlgorithmClass: DemCallbackGetFDCFnc=false, DemDebounceTimeBaseRef=Cfg_P/DemDebounceTimeBaseClass4_40000ms_2000ms
          Event_0x9C0415: DemEventId=5, DemDTCRef=DemDTCClassTable_0/DTC_0x9C0415, DemEnableConditionGroupRef=DECG_9C0311_9C0415_9D0511_9D0615
            DemDebounceAlgorithmClass: DemCallbackGetFDCFnc=false, DemDebounceTimeBaseRef=Cfg_P/DemDebounceTimeBaseClass4_40000ms_2000ms
          Event_0x9C0511: DemEventId=6, DemDTCRef=DemDTCClassTable_0/DTC_0x9C0511, DemEnableConditionGroupRef=DECG_9C0511_9C0615
            DemDebounceAlgorithmClass: DemCallbackGetFDCFnc=false, DemDebounceTimeBaseRef=Cfg_P/DemDebounceTimeBaseClass5_0ms_2000ms
          Event_0x9C0615: DemEventId=7, DemDTCRef=DemDTCClassTable_0/DTC_0x9C0615, DemEnableConditionGroupRef=DECG_9C0511_9C0615
            DemDebounceAlgorithmClass: DemCallbackGetFDCFnc=false, DemDebounceTimeBaseRef=Cfg_P/DemDebounceTimeBaseClass5_0ms_2000ms
          Event_0x9D0119: DemEventId=8, DemDTCRef=DemDTCClassTable_0/DTC_0x9D0119, DemEnableConditionGroupRef=DECG_9D0119_9D0218
            DemDebounceAlgorithmClass: DemCallbackGetFDCFnc=false, DemDebounceTimeBaseRef=Cfg_P/DemDebounceTimeBaseClass2_1000ms_0ms
          Event_0x9D0218: DemEventId=9, DemDTCRef=DemDTCClassTable_0/DTC_0x9D0218, DemEnableConditionGroupRef=DECG_9D0119_9D0218
            DemDebounceAlgorithmClass: DemCallbackGetFDCFnc=false, DemDebounceTimeBaseRef=Cfg_P/DemDebounceTimeBaseClass2_1000ms_0ms
          Event_0x9D0319: DemEventId=10, DemDTCRef=DemDTCClassTable_0/DTC_0x9D0319, DemEnableConditionGroupRef=DECG_9D0319_9D0418
            DemDebounceAlgorithmClass: DemCallbackGetFDCFnc=false, DemDebounceTimeBaseRef=Cfg_P/DemDebounceTimeBaseClass2_1000ms_0ms
          Event_0x9D0418: DemEventId=11, DemDTCRef=DemDTCClassTable_0/DTC_0x9D0418, DemEnableConditionGroupRef=DECG_9D0319_9D0418
            DemDebounceAlgorithmClass: DemCallbackGetFDCFnc=false, DemDebounceTimeBaseRef=Cfg_P/DemDebounceTimeBaseClass2_1000ms_0ms
          Event_0x9D0511: DemEventId=12, DemDTCRef=DemDTCClassTable_0/DTC_0x9D0511, DemEnableConditionGroupRef=DECG_9C0311_9C0415_9D0511_9D0615
            DemDebounceAlgorithmClass: DemCallbackGetFDCFnc=true
          Event_0x9D0615: DemEventId=13, DemDTCRef=DemDTCClassTable_0/DTC_0x9D0615, DemEnableConditionGroupRef=DECG_9C0311_9C0415_9D0511_9D0615
            DemDebounceAlgorithmClass: DemCallbackGetFDCFnc=true
          Event_0xC00B88: DemEventId=14, DemDTCRef=DemDTCClassTable_0/DTC_0xC00B88, DemEnableConditionGroupRef=DECG_C00B88
            DemDebounceAlgorithmClass: DemCallbackGetFDCFnc=false, DemDebounceTimeBaseRef=Cfg_P/DemDebounceTimeBaseClass0_250ms_0ms
          Event_0xF13C87: DemEventId=15, DemDTCRef=DemDTCClassTable_0/DTC_0xF13C87, DemEnableConditionGroupRef=DECG_F13C87
            DemDebounceAlgorithmClass: DemCallbackGetFDCFnc=true
          Event_0xF1D387: DemEventId=16, DemDTCRef=DTC_0xF1D387, DemEnableConditionGroupRef=DECG_F3A987_F3B287_F1D387_F1D487
            DemDebounceAlgorithmClass: DemCallbackGetFDCFnc=true
          Event_0xF1D487: DemEventId=17, DemDTCRef=DTC_0xF1D487, DemEnableConditionGroupRef=DECG_F3A987_F3B287_F1D387_F1D487
            DemDebounceAlgorithmClass: DemCallbackGetFDCFnc=true
          Event_0xF3A987: DemEventId=18, DemDTCRef=DemDTCClassTable_0/DTC_0xF3A987, DemEnableConditionGroupRef=DECG_F3A987_F3B287_F1D387_F1D487
            DemDebounceAlgorithmClass: DemCallbackGetFDCFnc=true
          Event_0xF3B287: DemEventId=19, DemDTCRef=DemDTCClassTable_0/DTC_0xF3B287, DemEnableConditionGroupRef=DECG_F3A987_F3B287_F1D387_F1D487
            DemDebounceAlgorithmClass: DemCallbackGetFDCFnc=true
      6 x DemDebounceTimeBaseClass, all with DemDebounceBehavior=DEM_DEBOUNCE_FREEZE:
        DemDebounceTimeBaseClass0_250ms_0ms: DemDebounceTimeFailedThreshold=250, DemDebounceTimePassedThreshold=10, DemTimeBasedFdcThresholdStorageValue=250
        DemDebounceTimeBaseClass1_1000ms_1000ms: DemDebounceTimeFailedThreshold=1000, DemDebounceTimePassedThreshold=1000, DemTimeBasedFdcThresholdStorageValue=1000
        DemDebounceTimeBaseClass2_1000ms_0ms: DemDebounceTimeFailedThreshold=1000, DemDebounceTimePassedThreshold=10, DemTimeBasedFdcThresholdStorageValue=1000
        DemDebounceTimeBaseClass3_1000ms_2000ms: DemDebounceTimeFailedThreshold=1000, DemDebounceTimePassedThreshold=2000, DemTimeBasedFdcThresholdStorageValue=1000
        DemDebounceTimeBaseClass4_40000ms_2000ms: DemDebounceTimeFailedThreshold=40000, DemDebounceTimePassedThreshold=2000, DemTimeBasedFdcThresholdStorageValue=40000
        DemDebounceTimeBaseClass5_0ms_2000ms: DemDebounceTimeFailedThreshold=10, DemDebounceTimePassedThreshold=2000, DemTimeBasedFdcThresholdStorageValue=10
