AUTOSAR XML (schema 00046)
package /EAS
  ecuc definition collection AUTOSARParameterDefinition: module=NvM
  module config NvM: implementation-config-variant=STD_CONFIG_VARIANTS_PRECOMPILE, module_version_def=4.2.0, module_autosar_version=Ar470
    NvMCommon:
      NvMApiConfigClass = NVM_API_CONFIG_CLASS_3
      NvMBswMMultiBlockJobStatusInformation = true
      NvMCompiledConfigId = 38942
      NvMCrcNumOfBytes = 10
      NvMDatasetSelectionBits = 0
      NvMDevErrorDetect = true
      NvMDrvModeSwitch = false
      NvMDynamicConfiguration = false
      NvMJobPrioritization = false
      NvMMultiBlockCallback = NVM_NULL
      NvMPollingMode = false
      NvMRepeatMirrorOperations = 0
      NvMSetRamBlockStatusApi = false
      NvMSizeImmediateJobQueue = 1
      NvMSizeStandardJobQueue = 10
      NvMVersionInfoApi = false
      NvMEraseApi = false
      NvMInvalidApi = false
      NvMCancelJobApi = false
      VersionCheck = true
      NvMImplicitRestoreApi = false
      NvMLowBlockIdSaved = false
      NvMReadOpBytes = 0
      NvMSpecialReadRom = false
      NvMSetBlockLockApi = false
      NvMWriteProtectedSupport = false
      NvMMultiCoreSupport = false
      NvMBlockAgentBufferSize = 50
      NvMCsmRetryCounter = 0
    26 x NvMBlockDescriptor, all with NvMBlockCrcType=NVM_CRC8, NvMBlockJobPriority=1, NvMBlockManagementType=NVM_BLOCK_NATIVE, NvMBlockUseSyncMechanism=false, NvMBlockWriteProt=false, NvMBswMBlockStatusInformation=false, NvMCalcRamBlockCrc=false, NvMInitBlockCallback=NVM_NULL, NvMMaxNumOfReadRetries=0, NvMMaxNumOfWriteRetries=0, NvMNvBlockNum=1, NvMNvramDeviceId=0, NvMRomBlockNum=0, NvMSelectBlockForFirstInitAll=false, NvMSingleBlockCallback=NVM_NULL, NvMWriteBlockOnce=false, NvMBlockUseCrc=false, NvMSelectBlockForReadAll=true, NvMSelectBlockForWriteAll=true, NvMWriteVerification=false, NvMWriteVerificationDataSize=10, NvMStaticBlockIDCheck=false, NvMResistantToChangedSw=false, NvMReadRamBlockFromNvCallback=NVM_NULL, NvMWriteRamBlockToNvCallback=NVM_NULL, NvMBlockUseAutoValidation=false, NvMBlockUseCRCCompMechanism=false, NvMBlockUseSetRamBlockStatus=false, NvMBlockUseCompression=false, NvMBlockUsePort=false, NvMBlockCompressionLength=1:
      Block0: NvMNvBlockBaseNumber=0, NvMNvBlockLength=1, NvMNvramBlockIdentifier=0, NvMRamBlockDataAddress=NVM_NULL, NvMRomBlockDataAddress=NVM_NULL, NvMBlockHeaderInclude=, UserDefine=false
      Block_CfgID: NvMNvBlockBaseNumber=1, NvMNvBlockLength=2, NvMNvramBlockIdentifier=1, NvMRamBlockDataAddress=NvM_CfgIDBuffer, NvMRomBlockDataAddress=NvM_CompiledConfigId, NvMBlockHeaderInclude=, UserDefine=false
        NvMTargetBlockReference
      NVM_PrimaryDataEntry_0_0: NvMNvBlockBaseNumber=2, NvMNvBlockLength=19, NvMNvramBlockIdentifier=2, NvMRamBlockDataAddress=&PrimaryDataEntry_0_0, NvMRomBlockDataAddress=NVM_NULL, NvMBlockHeaderInclude=BSW_APP, UserDefine=true
        NvMTargetBlockReference
      NVM_PrimaryDataEntry_0_1: NvMNvBlockBaseNumber=3, NvMNvBlockLength=19, NvMNvramBlockIdentifier=3, NvMRamBlockDataAddress=&PrimaryDataEntry_0_1, NvMRomBlockDataAddress=NVM_NULL, NvMBlockHeaderInclude=Dem, UserDefine=true
        NvMTargetBlockReference
      NVM_PrimaryDataEntry_0_2: NvMNvBlockBaseNumber=4, NvMNvBlockLength=19, NvMNvramBlockIdentifier=4, NvMRamBlockDataAddress=&PrimaryDataEntry_0_2, NvMRomBlockDataAddress=NVM_NULL, NvMBlockHeaderInclude=, UserDefine=true
        NvMTargetBlockReference
      NVM_PrimaryDataEntry_0_3: NvMNvBlockBaseNumber=5, NvMNvBlockLength=19, NvMNvramBlockIdentifier=5, NvMRamBlockDataAddress=&PrimaryDataEntry_0_3, NvMRomBlockDataAddress=NVM_NULL, NvMBlockHeaderInclude=, UserDefine=true
        NvMTargetBlockReference
      NVM_PrimaryDataEntry_0_4: NvMNvBlockBaseNumber=6, NvMNvBlockLength=19, NvMNvramBlockIdentifier=6, NvMRamBlockDataAddress=&PrimaryDataEntry_0_4, NvMRomBlockDataAddress=NVM_NULL, NvMBlockHeaderInclude=, UserDefine=true
        NvMTargetBlockReference
      NVM_PrimaryDataEntry_0_5: NvMNvBlockBaseNumber=7, NvMNvBlockLength=19, NvMNvramBlockIdentifier=7, NvMRamBlockDataAddress=&PrimaryDataEntry_0_5, NvMRomBlockDataAddress=NVM_NULL, NvMBlockHeaderInclude=, UserDefine=true
        NvMTargetBlockReference
      NVM_PrimaryDataEntry_0_6: NvMNvBlockBaseNumber=8, NvMNvBlockLength=19, NvMNvramBlockIdentifier=8, NvMRamBlockDataAddress=&PrimaryDataEntry_0_6, NvMRomBlockDataAddress=NVM_NULL, NvMBlockHeaderInclude=, UserDefine=true
        NvMTargetBlockReference
      NVM_PrimaryDataEntry_0_7: NvMNvBlockBaseNumber=9, NvMNvBlockLength=19, NvMNvramBlockIdentifier=9, NvMRamBlockDataAddress=&PrimaryDataEntry_0_7, NvMRomBlockDataAddress=NVM_NULL, NvMBlockHeaderInclude=, UserDefine=true
        NvMTargetBlockReference
      NVM_PrimaryDataEntry_0_8: NvMNvBlockBaseNumber=10, NvMNvBlockLength=19, NvMNvramBlockIdentifier=10, NvMRamBlockDataAddress=&PrimaryDataEntry_0_8, NvMRomBlockDataAddress=NVM_NULL, NvMBlockHeaderInclude=, UserDefine=true
        NvMTargetBlockReference
      NVM_PrimaryDataEntry_0_9: NvMNvBlockBaseNumber=11, NvMNvBlockLength=19, NvMNvramBlockIdentifier=11, NvMRamBlockDataAddress=&PrimaryDataEntry_0_9, NvMRomBlockDataAddress=NVM_NULL, NvMBlockHeaderInclude=, UserDefine=true
        NvMTargetBlockReference
      NVM_PrimaryDataEntry_0_10: NvMNvBlockBaseNumber=12, NvMNvBlockLength=19, NvMNvramBlockIdentifier=12, NvMRamBlockDataAddress=&PrimaryDataEntry_0_10, NvMRomBlockDataAddress=NVM_NULL, NvMBlockHeaderInclude=, UserDefine=true
        NvMTargetBlockReference
      NVM_PrimaryDataEntry_0_11: NvMNvBlockBaseNumber=13, NvMNvBlockLength=19, NvMNvramBlockIdentifier=13, NvMRamBlockDataAddress=&PrimaryDataEntry_0_11, NvMRomBlockDataAddress=NVM_NULL, NvMBlockHeaderInclude=, UserDefine=true
        NvMTargetBlockReference
      NVM_PrimaryDataEntry_0_12: NvMNvBlockBaseNumber=14, NvMNvBlockLength=19, NvMNvramBlockIdentifier=14, NvMRamBlockDataAddress=&PrimaryDataEntry_0_12, NvMRomBlockDataAddress=NVM_NULL, NvMBlockHeaderInclude=, UserDefine=true
        NvMTargetBlockReference
      NVM_PrimaryDataEntry_0_13: NvMNvBlockBaseNumber=15, NvMNvBlockLength=19, NvMNvramBlockIdentifier=15, NvMRamBlockDataAddress=&PrimaryDataEntry_0_13, NvMRomBlockDataAddress=NVM_NULL, NvMBlockHeaderInclude=, UserDefine=true
        NvMTargetBlockReference
      NVM_PrimaryDataEntry_0_14: NvMNvBlockBaseNumber=16, NvMNvBlockLength=19, NvMNvramBlockIdentifier=16, NvMRamBlockDataAddress=&PrimaryDataEntry_0_14, NvMRomBlockDataAddress=NVM_NULL, NvMBlockHeaderInclude=, UserDefine=true
        NvMTargetBlockReference
      NVM_PrimaryDataEntry_0_15: NvMNvBlockBaseNumber=17, NvMNvBlockLength=19, NvMNvramBlockIdentifier=17, NvMRamBlockDataAddress=&PrimaryDataEntry_0_15, NvMRomBlockDataAddress=NVM_NULL, NvMBlockHeaderInclude=, UserDefine=true
        NvMTargetBlockReference
      NVM_PrimaryDataEntry_0_16: NvMNvBlockBaseNumber=18, NvMNvBlockLength=19, NvMNvramBlockIdentifier=18, NvMRamBlockDataAddress=&PrimaryDataEntry_0_16, NvMRomBlockDataAddress=NVM_NULL, NvMBlockHeaderInclude=, UserDefine=true
        NvMTargetBlockReference
      NVM_PrimaryDataEntry_0_17: NvMNvBlockBaseNumber=19, NvMNvBlockLength=19, NvMNvramBlockIdentifier=19, NvMRamBlockDataAddress=&PrimaryDataEntry_0_17, NvMRomBlockDataAddress=NVM_NULL, NvMBlockHeaderInclude=, UserDefine=true
        NvMTargetBlockReference
      NVM_PrimaryDataEntry_0_18: NvMNvBlockBaseNumber=20, NvMNvBlockLength=19, NvMNvramBlockIdentifier=20, NvMRamBlockDataAddress=&PrimaryDataEntry_0_18, NvMRomBlockDataAddress=NVM_NULL, NvMBlockHeaderInclude=, UserDefine=true
        NvMTargetBlockReference
      NVM_PrimaryDataEntry_0_19: NvMNvBlockBaseNumber=21, NvMNvBlockLength=19, NvMNvramBlockIdentifier=21, NvMRamBlockDataAddress=&PrimaryDataEntry_0_19, NvMRomBlockDataAddress=NVM_NULL, NvMBlockHeaderInclude=, UserDefine=true
        NvMTargetBlockReference
      NVM_Dem_StorageMem: NvMNvBlockBaseNumber=22, NvMNvBlockLength=156, NvMNvramBlockIdentifier=22, NvMRamBlockDataAddress=&Dem_StorageMem, NvMRomBlockDataAddress=NVM_NULL, NvMBlockHeaderInclude=, UserDefine=true
        NvMTargetBlockReference
      FEE_App_Serial_number: NvMNvBlockBaseNumber=23, NvMNvBlockLength=16, NvMNvramBlockIdentifier=23, NvMRamBlockDataAddress=&serial_number, NvMRomBlockDataAddress=NVM_NULL, NvMBlockHeaderInclude=Memory, UserDefine=true
        NvMTargetBlockReference
      FEE_App_Manufacturing_Date: NvMNvBlockBaseNumber=24, NvMNvBlockLength=3, NvMNvramBlockIdentifier=24, NvMRamBlockDataAddress=&manufacturing_date, NvMRomBlockDataAddress=NVM_NULL, NvMBlockHeaderInclude=Memory, UserDefine=true
        NvMTargetBlockReference
      FEE_App_FAA_Flag: NvMNvBlockBaseNumber=25, NvMNvBlockLength=1, NvMNvramBlockIdentifier=25, NvMRamBlockDataAddress=&faa_flag, NvMRomBlockDataAddress=NVM_NULL, NvMBlockHeaderInclude=Memory, UserDefine=true
        NvMTargetBlockReference
    NvmDemEventParameterRefs
