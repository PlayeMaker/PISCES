AUTOSAR XML (schema 00046)
package /EAS
  ecuc definition collection AUTOSARParameterDefinition: module=MemMap
  module config MemMap: implementation-config-variant=STD_CONFIG_VARIANTS_PRECOMPILE, module_version_def=4.0.0, module_autosar_version=Ar470
    MemMapGeneral: IDE=UserDefine, ChipName=UserDefine, isAuto=false
