AUTOSAR XML (schema 00046)
package /EAS
  ecuc definition collection AUTOSARParameterDefinition: module=Det
  module config Det: implementation-config-variant=STD_CONFIG_VARIANTS_PRECOMPILE, module_version_def=4.0.3, module_autosar_version=Ar470
    DetGeneral:
      DetDebugLoop = false
      DetForwardToDlt = false
      VersionCheck = true
      DetVersionApi = false
      DetErrorHook = 
      CddHeaderFile = 
      DetReportRuntimeErrorCallout = 
      DetReportTransientFaultCallout = 
    DetConfigSet (DetModuleInstance)
