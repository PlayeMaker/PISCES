AUTOSAR XML (schema 00046)
package /EAS
  ecuc definition collection AUTOSARParameterDefinition: module=CanTp
  module config CanTp: implementation-config-variant=STD_CONFIG_VARIANTS_POSTBUILD, module_version_def=4.0.5, module_autosar_version=Ar470
    CanTpGeneral:
      VersionCheck = true
      CanTpChangeParameterApi = false
      CanTpDevErrorDetect = false
      CanTpPaddingByte = 0xAA
      CanTpReadParameterApi = false
      CanTpVersionInfoApi = false
      CanTpTc = false
      CanTpRc = false
      MaxBlockSize = 3
      CanTpDynIdSupport = false
      CanTpFlexibleDataRateSupport = true
      CanTpGenericConnectionSupport = false
      SupportLongFF = false
      CanTpMultiCoreSupport = false
      CanTpCarPlatform = CANTP_NIO_PLATFORM
    Cfg_D (CanTpConfig): CanTpMainFunctionPeriod=10, UserDefine=false
      Ch_BODY_LE1_CAN_0_DiagPhy_Default (CanTpChannel): CanTpChannelMode=CANTP_MODE_HALF_DUPLEX, UserDefine=false
        RxNSdu_DIAG_REQ_MCM_D (CanTpRxNSdu):
          CanTpBs = 0
          CanTpNar = 1000
          CanTpNbr = 65
          CanTpNcr = 1000
          CanTpRxAddressingFormat = CANTP_STANDARD
          CanTpNTa = 0
          CanTpNSa = 0
          CanTpNAe = 0
          CanTpRxNSduId = 0
          CanTpRxPaddingActivation = CanTp_ON
          CanTpRxTaType = CANTP_PHYSICAL
          CanTpRxWftMax = 0
          CanTpSTmin = 20
          ModuleType = DCM
          isGW = false
          UserDefine = false
          RxMaxCanLen = 8
          CanTpRxNSduRef = Cfg_D_Rx_BODY_LE1_CAN_DIAG_REQ_MCM_D
          CanTpRxNPdu: CanTpRxNPduId=19, UserDefine=false, CanTpRxNPduRef=Cfg_D_Rx_BODY_LE1_CAN_DIAG_REQ_MCM_D
          CanTpTxFcNPdu: CanTpTxFcNPduConfirmationPduId=6, UserDefine=false, CanTpTxFcNPduRef=Cfg_D_Tx_BODY_LE1_CAN_DIAG_RESP_MCM_D
        TxNSdu_DIAG_RESP_MCM_D (CanTpTxNSdu):
          CanTpNas = 1000
          CanTpNbs = 1000
          CanTpNcs = 65
          CanTpTxAddressingFormat = CANTP_STANDARD
          CanTpNTa = 0
          CanTpNSa = 0
          CanTpNAe = 0
          CanTpTxNSduId = 0
          CanTpTxPaddingActivation = CanTp_ON
          CanTpTxTaType = CANTP_PHYSICAL
          TxMaxCanLen = 8
          ModuleType = DCM
          isGW = false
          UserDefine = false
          CanTpTxNSduRef = Cfg_D_Tx_BODY_LE1_CAN_DIAG_RESP_MCM_D
          CanTpTxNPdu: CanTpTxNPduConfirmationPduId=6, UserDefine=false, CanTpTxNPduRef=Cfg_D_Tx_BODY_LE1_CAN_DIAG_RESP_MCM_D
          CanTpRxFcNPdu: CanTpRxFcNPduId=19, CanTpRxFcNPduRef=Cfg_D_Rx_BODY_LE1_CAN_DIAG_REQ_MCM_D
      Ch_BODY_LE1_CAN_0_DiagFun_Default (CanTpChannel): CanTpChannelMode=CANTP_MODE_HALF_DUPLEX, UserDefine=false
        RxNSdu_DIAG_REQ_AllECU (CanTpRxNSdu):
          CanTpBs = 0
          CanTpNar = 1000
          CanTpNbr = 65
          CanTpNcr = 1000
          CanTpRxAddressingFormat = CANTP_STANDARD
          CanTpNTa = 0
          CanTpNSa = 0
          CanTpNAe = 0
          CanTpRxNSduId = 1
          CanTpRxPaddingActivation = CanTp_ON
          CanTpRxTaType = CANTP_FUNCTIONAL
          CanTpRxWftMax = 0
          CanTpSTmin = 20
          ModuleType = DCM
          isGW = false
          UserDefine = false
          RxMaxCanLen = 8
          CanTpRxNSduRef = Cfg_D_Rx_BODY_LE1_CAN_DIAG_REQ_AllECU
          CanTpRxNPdu: CanTpRxNPduId=18, UserDefine=false, CanTpRxNPduRef=Cfg_D_Rx_BODY_LE1_CAN_DIAG_REQ_AllECU
    Cfg_P (CanTpConfig): CanTpMainFunctionPeriod=10, UserDefine=false
      Ch_BODY_LE1_CAN_0_DiagPhy_Default (CanTpChannel): CanTpChannelMode=CANTP_MODE_HALF_DUPLEX, UserDefine=false
        RxNSdu_DIAG_REQ_MCM_P (CanTpRxNSdu):
          CanTpBs = 0
          CanTpNar = 1000
          CanTpNbr = 65
          CanTpNcr = 1000
          CanTpRxAddressingFormat = CANTP_STANDARD
          CanTpNTa = 0
          CanTpNSa = 0
          CanTpNAe = 0
          CanTpRxNSduId = 0
          CanTpRxPaddingActivation = CanTp_ON
          CanTpRxTaType = CANTP_PHYSICAL
          CanTpRxWftMax = 0
          CanTpSTmin = 20
          ModuleType = DCM
          isGW = false
          UserDefine = false
          RxMaxCanLen = 8
          CanTpRxNSduRef = Cfg_P_Rx_BODY_LE1_CAN_DIAG_REQ_MCM_P
          CanTpRxNPdu: CanTpRxNPduId=39, UserDefine=false, CanTpRxNPduRef=Cfg_P_Rx_BODY_LE1_CAN_DIAG_REQ_MCM_P
          CanTpTxFcNPdu: CanTpTxFcNPduConfirmationPduId=26, UserDefine=false, CanTpTxFcNPduRef=Cfg_P_Tx_BODY_LE1_CAN_DIAG_RESP_MCM_P
        TxNSdu_DIAG_RESP_MCM_P (CanTpTxNSdu):
          CanTpNas = 1000
          CanTpNbs = 1000
          CanTpNcs = 65
          CanTpTxAddressingFormat = CANTP_STANDARD
          CanTpNTa = 0
          CanTpNSa = 0
          CanTpNAe = 0
          CanTpTxNSduId = 0
          CanTpTxPaddingActivation = CanTp_ON
          CanTpTxTaType = CANTP_PHYSICAL
          TxMaxCanLen = 8
          ModuleType = DCM
          isGW = false
          UserDefine = false
          CanTpTxNSduRef = Cfg_P_Tx_BODY_LE1_CAN_DIAG_RESP_MCM_P
          CanTpTxNPdu: CanTpTxNPduConfirmationPduId=26, UserDefine=false, CanTpTxNPduRef=Cfg_P_Tx_BODY_LE1_CAN_DIAG_RESP_MCM_P
          CanTpRxFcNPdu: CanTpRxFcNPduId=39, CanTpRxFcNPduRef=Cfg_P_Rx_BODY_LE1_CAN_DIAG_REQ_MCM_P
      Ch_BODY_LE1_CAN_0_DiagFun_Default (CanTpChannel): CanTpChannelMode=CANTP_MODE_HALF_DUPLEX, UserDefine=false
        RxNSdu_DIAG_REQ_AllECU (CanTpRxNSdu):
          CanTpBs = 0
          CanTpNar = 1000
          CanTpNbr = 65
          CanTpNcr = 1000
          CanTpRxAddressingFormat = CANTP_STANDARD
          CanTpNTa = 0
          CanTpNSa = 0
          CanTpNAe = 0
          CanTpRxNSduId = 1
          CanTpRxPaddingActivation = CanTp_ON
          CanTpRxTaType = CANTP_FUNCTIONAL
          CanTpRxWftMax = 0
          CanTpSTmin = 20
          ModuleType = DCM
          isGW = false
          UserDefine = false
          RxMaxCanLen = 8
          CanTpRxNSduRef = Cfg_P_Rx_BODY_LE1_CAN_DIAG_REQ_AllECU
          CanTpRxNPdu: CanTpRxNPduId=38, UserDefine=false, CanTpRxNPduRef=Cfg_P_Rx_BODY_LE1_CAN_DIAG_REQ_AllECU
