AUTOSAR XML (schema 00046)
package /EAS
  ecuc definition collection AUTOSARParameterDefinition: module=EcuC
  module config EcuC: implementation-config-variant=STD_CONFIG_VARIANTS_PRECOMPILE, module_version_def=4.0.0, module_autosar_version=Ar470
    EcucVariationResolver
    EcucPduCollection: PduIdTypeEnum=uint8, PduLengthTypeEnum=uint16
      40 x Pdu, all with PduLength=8, DynamicLength=false, J1939Requestable=false, UserDefine=false, PduType=DBC, isExcel=false, EcucPduDefaultPartitionRef=EcucPartition0:
        Cfg_D_Tx_BODY_LE1_CAN_MCM_D_1B6: SysTPduToFrameMappingRef=Cfg_D_Tx_BODY_LE1_CAN_MCM_D_1B6
        Cfg_D_Tx_BODY_LE1_CAN_MCM_D_1DF: SysTPduToFrameMappingRef=Cfg_D_Tx_BODY_LE1_CAN_MCM_D_1DF
        Cfg_D_Tx_BODY_LE1_CAN_MCM_D_1E0: SysTPduToFrameMappingRef=Cfg_D_Tx_BODY_LE1_CAN_MCM_D_1E0
        Cfg_D_Tx_BODY_LE1_CAN_MCM_D_1E1: SysTPduToFrameMappingRef=Cfg_D_Tx_BODY_LE1_CAN_MCM_D_1E1
        Cfg_D_Tx_BODY_LE1_CAN_MCM_D_1E8: SysTPduToFrameMappingRef=Cfg_D_Tx_BODY_LE1_CAN_MCM_D_1E8
        Cfg_D_Tx_BODY_LE1_CAN_MCM_D_1EC: SysTPduToFrameMappingRef=Cfg_D_Tx_BODY_LE1_CAN_MCM_D_1EC
        Cfg_D_Tx_BODY_LE1_CAN_DIAG_RESP_MCM_D: SysTPduToFrameMappingRef=Cfg_D_Tx_BODY_LE1_CAN_DIAG_RESP_MCM_D
        Cfg_D_Rx_BODY_LE1_CAN_BCU_11E: SysTPduToFrameMappingRef=Cfg_D_Rx_BODY_LE1_CAN_BCU_11E
        Cfg_D_Rx_BODY_LE1_CAN_ZONE_13C: SysTPduToFrameMappingRef=Cfg_D_Rx_BODY_LE1_CAN_ZONE_13C
        Cfg_D_Rx_BODY_LE1_CAN_ZONE_MCM_05: SysTPduToFrameMappingRef=Cfg_D_Rx_BODY_LE1_CAN_ZONE_MCM_05
        Cfg_D_Rx_BODY_LE1_CAN_ZONE_1C9: SysTPduToFrameMappingRef=Cfg_D_Rx_BODY_LE1_CAN_ZONE_1C9
        Cfg_D_Rx_BODY_LE1_CAN_Zone_FL_MCM_01: SysTPduToFrameMappingRef=Cfg_D_Rx_BODY_LE1_CAN_Zone_FL_MCM_01
        Cfg_D_Rx_BODY_LE1_CAN_Zone_FL_MCM_02: SysTPduToFrameMappingRef=Cfg_D_Rx_BODY_LE1_CAN_Zone_FL_MCM_02
        Cfg_D_Rx_BODY_LE1_CAN_ZONE_2EF: SysTPduToFrameMappingRef=Cfg_D_Rx_BODY_LE1_CAN_ZONE_2EF
        Cfg_D_Rx_BODY_LE1_CAN_ZONE_3A9: SysTPduToFrameMappingRef=Cfg_D_Rx_BODY_LE1_CAN_ZONE_3A9
        Cfg_D_Rx_BODY_LE1_CAN_ZONE_3B2: SysTPduToFrameMappingRef=Cfg_D_Rx_BODY_LE1_CAN_ZONE_3B2
        Cfg_D_Rx_BODY_LE1_CAN_ZONE_PNC: SysTPduToFrameMappingRef=Cfg_D_Rx_BODY_LE1_CAN_ZONE_PNC
        Cfg_D_Rx_BODY_LE1_CAN_VC_Data_5E0: SysTPduToFrameMappingRef=Cfg_D_Rx_BODY_LE1_CAN_VC_Data_5E0
        Cfg_D_Rx_BODY_LE1_CAN_DIAG_REQ_AllECU: SysTPduToFrameMappingRef=Cfg_D_Rx_BODY_LE1_CAN_DIAG_REQ_AllECU
        Cfg_D_Rx_BODY_LE1_CAN_DIAG_REQ_MCM_D: SysTPduToFrameMappingRef=Cfg_D_Rx_BODY_LE1_CAN_DIAG_REQ_MCM_D
        Cfg_P_Tx_BODY_LE1_CAN_MCM_P_1B7: SysTPduToFrameMappingRef=Cfg_P_Tx_BODY_LE1_CAN_MCM_P_1B7
        Cfg_P_Tx_BODY_LE1_CAN_MCM_P_1E{2..4}: SysTPduToFrameMappingRef=Cfg_P_Tx_BODY_LE1_CAN_MCM_P_1E{2..4}
        Cfg_P_Tx_BODY_LE1_CAN_MCM_P_1EB: SysTPduToFrameMappingRef=Cfg_P_Tx_BODY_LE1_CAN_MCM_P_1EB
        Cfg_P_Tx_BODY_LE1_CAN_MCM_P_1ED: SysTPduToFrameMappingRef=Cfg_P_Tx_BODY_LE1_CAN_MCM_P_1ED
        Cfg_P_Tx_BODY_LE1_CAN_DIAG_RESP_MCM_P: SysTPduToFrameMappingRef=Cfg_P_Tx_BODY_LE1_CAN_DIAG_RESP_MCM_P
        Cfg_P_Rx_BODY_LE1_CAN_BCU_11E: SysTPduToFrameMappingRef=Cfg_P_Rx_BODY_LE1_CAN_BCU_11E
        Cfg_P_Rx_BODY_LE1_CAN_ZONE_13C: SysTPduToFrameMappingRef=Cfg_P_Rx_BODY_LE1_CAN_ZONE_13C
        Cfg_P_Rx_BODY_LE1_CAN_ZONE_MCM_06: SysTPduToFrameMappingRef=Cfg_P_Rx_BODY_LE1_CAN_ZONE_MCM_06
        Cfg_P_Rx_BODY_LE1_CAN_ZONE_1CF: SysTPduToFrameMappingRef=Cfg_P_Rx_BODY_LE1_CAN_ZONE_1CF
        Cfg_P_Rx_BODY_LE1_CAN_Zone_FL_MCM_03: SysTPduToFrameMappingRef=Cfg_P_Rx_BODY_LE1_CAN_Zone_FL_MCM_03
        Cfg_P_Rx_BODY_LE1_CAN_Zone_FL_MCM_04: SysTPduToFrameMappingRef=Cfg_P_Rx_BODY_LE1_CAN_Zone_FL_MCM_04
        Cfg_P_Rx_BODY_LE1_CAN_ZONE_2EF: SysTPduToFrameMappingRef=Cfg_P_Rx_BODY_LE1_CAN_ZONE_2EF
        Cfg_P_Rx_BODY_LE1_CAN_ZONE_3A9: SysTPduToFrameMappingRef=Cfg_P_Rx_BODY_LE1_CAN_ZONE_3A9
        Cfg_P_Rx_BODY_LE1_CAN_ZONE_3B2: SysTPduToFrameMappingRef=Cfg_P_Rx_BODY_LE1_CAN_ZONE_3B2
        Cfg_P_Rx_BODY_LE1_CAN_ZONE_PNC: SysTPduToFrameMappingRef=Cfg_P_Rx_BODY_LE1_CAN_ZONE_PNC
        Cfg_P_Rx_BODY_LE1_CAN_VC_Data_5E0: SysTPduToFrameMappingRef=Cfg_P_Rx_BODY_LE1_CAN_VC_Data_5E0
        Cfg_P_Rx_BODY_LE1_CAN_DIAG_REQ_AllECU: SysTPduToFrameMappingRef=Cfg_P_Rx_BODY_LE1_CAN_DIAG_REQ_AllECU
        Cfg_P_Rx_BODY_LE1_CAN_DIAG_REQ_MCM_P: SysTPduToFrameMappingRef=Cfg_P_Rx_BODY_LE1_CAN_DIAG_REQ_MCM_P
    EcucHardware: EcucCoreNum=1, EcucCoreMasterId=0
      EcucCoreDefinition0 (EcucCoreDefinition): EcucCoreId=0
    EcucPartitionCollection
      EcucPartition0 (EcucPartition): EcucPartitionBswModuleExecution=false, PartitionCanBeRestarted=false, EcucDefaultBswPartition=false, EcuCCoreRef=EcucCoreDefinition0
