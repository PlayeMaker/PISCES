AUTOSAR XML (schema 00046)
package /EAS
  ecuc definition collection AUTOSARParameterDefinition: module=MemIf
  module config MemIf: implementation-config-variant=STD_CONFIG_VARIANTS_PRECOMPILE, module_version_def=4.0.2, module_autosar_version=Ar470
    MemIfGeneral: MemIfDevErrorDetect=false, MemIfVersionInfoApi=false, VersionCheck=true, MemIfNumberOfDevices=1
    Device0 (MemIfDevice):
      DeviceId = 0
      DeviceHeaderFile = Fee
      DeviceType = Fee
      Mode = Fee_SetMode
      Read = Fee_Read
      Write = Fee_Write
      Cancel = Fee_Cancel
      Status = Fee_GetStatus
      InvalidateBlock = Fee_InvalidateBlock
      JobResult = Fee_GetJobResult
      EraseBlock = Fee_EraseImmediateBlock
